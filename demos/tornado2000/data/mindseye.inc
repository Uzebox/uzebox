/*
Uzebox module v1.0
File: C:\work\uzebox\trunk\demos\MusicDemo_Tempest2000\data\mindseye.inc
Data size:1813
*/
const char mindseye[]  __attribute__ ((section (".freeflash"))) = {
0x07,0x05,0x2a,0x10,0x05,0x58,0x00,0x00,0x01,0x01,0x01,0x01,0x02,0x01,0x01,0x01,0x01,0x03,0x01,0x01,0x01,0x01,0x04,0x01,0x01,0x05,0x01,0x00,0x01,0x01,0x06,0x01,
0x02,0x01,0x01,0x06,0x01,0x03,0x01,0x01,0x06,0x01,0x07,0x01,0x01,0x08,0x09,0x00,0x0a,0x01,0x06,0x01,0x02,0x0b,0x01,0x06,0x01,0x03,0x0a,0x01,0x06,0x01,0x04,0x0c,
0x01,0x06,0x01,0x00,0x0a,0x01,0x06,0x01,0x02,0x0b,0x01,0x06,0x01,0x03,0x0a,0x01,0x06,0x01,0x04,0x0c,0x01,0x05,0x01,0x0d,0x00,0x0a,0x06,0x01,0x0e,0x02,0x0b,0x06,
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0x20,0xc6,0x60,0x04,0xb8,0x20,0x00,0xb8,0x60,0x08,0xc4,0x20,0xb8,0x60,0x04,0xb8,0x20,0xc4,0x20,0xb7,0x20 
};

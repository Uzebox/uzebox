/*
 *  Uzebox Default Patches
 *  Copyright (C) 2008  Alec Bourque
 *
 *  This program is free software: you can redistribute it and/or modify
 *  it under the terms of the GNU General Public License as published by
 *  the Free Software Foundation, either version 3 of the License, or
 *  (at your option) any later version.
 *
 *  This program is distributed in the hope that it will be useful,
 *  but WITHOUT ANY WARRANTY; without even the implied warranty of
 *  MERCHANTABILITY or FITNESS FOR A PARTICULAR PURPOSE.  See the
 *  GNU General Public License for more details.
 *
 *  You should have received a copy of the GNU General Public License
 *  along with this program.  If not, see <http://www.gnu.org/licenses/>.
*/

#ifndef PATCHES_INC_
#define PATCHES_INC_


/*
	Patches are made of a command stream made of 3 bytes per command:
		1=delta time
		2=command
		3=command parameter

	Patches must start with 1 byte describing the sound type:
		0=wave channel (i.e.; channel 0,1 and 2)
		1=noise channel (channel 3)
		2=PCM (channel 3)
		->For type=2 two more byte follows in order: sample adress low byte, sample adress hi byte

	It must end with <0,PATCH_END> and this command takes
	only two bytes (no parameter).
*/

/*These define references the waves indexes in the sounds.inc file*/
extern const char waves[];

#define W_HOLLOW	0
#define W_SAW		1
#define W_TRI		2
#define W_SQ25		3
#define W_SQ50		4
#define W_SQ75		5
#define W_SIND1		6
#define W_SIND2		7
#define W_SIND3		8
#define W_SQFLT		9

#include "play.inc"
//#include "pcmdat.inc"

const char inst1[] PROGMEM ={	
0,PC_WAVE,W_SIND3, 
0,PC_NOTE_UP,12,
0,PC_ENV_VOL,255, 
0,PC_ENV_SPEED,-20,
1,PATCH_END
};


//b-drum (noise)
const char basedrum[] PROGMEM ={	
0,PC_ENV_VOL,128, 		//0,PC_ENV_VOL,255,
0,PC_NOISE_PARAMS,(2<<1),
0,PC_ENV_SPEED,-30, 	//0,PC_ENV_SPEED,-60, 
1,PC_NOISE_PARAMS,(3<<1),
1,PC_NOISE_PARAMS,(4<<1),
1,PC_NOISE_PARAMS,(5<<1),
1,PC_NOISE_PARAMS,(6<<1),
0,PATCH_END
};

//hi-hat close (noise)
const char hihat[] PROGMEM ={	
0,PC_ENV_VOL,100, 		//0,PC_ENV_VOL,200,
0,PC_NOISE_PARAMS,(1<<1)+(1<<0),
1,PC_NOISE_PARAMS,(0<<1)+(1<<0),
0,PC_ENV_VOL,50,		//0,PC_ENV_VOL,100,
1,PC_ENV_SPEED,-25, 	//1,PC_ENV_SPEED,-50, 
0,PATCH_END
};

//Inst: hit-hat partially open
const char hithat_open[] PROGMEM ={	
0,PC_ENV_VOL,125,		//0,PC_ENV_VOL,250,
0,PC_NOISE_PARAMS,(1<<1)+(1<<0),
1,PC_ENV_VOL,110,		//1,PC_ENV_VOL,220,
0,PC_NOISE_PARAMS,(0<<1)+(1<<0),
1,PC_ENV_SPEED,-25, 	//1,PC_ENV_SPEED,-50, 
2,PC_ENV_SPEED,-10, 	//2,PC_ENV_SPEED,-20
0,PATCH_END
};

//Crash cymbal (noise)
const char crash_cymbal[] PROGMEM ={//Megatris
0,PC_ENV_VOL,80,		//0,PC_ENV_VOL,160,
0,PC_NOISE_PARAMS,0,
0,PC_ENV_SPEED,-10, 	//0,PC_ENV_SPEED,-20, 
1,PC_ENV_SPEED,-2,		//1,PC_ENV_SPEED,-2,
0,PC_NOISE_PARAMS,1,
0,PATCH_END
};


const char inst6[] PROGMEM ={	
0,PC_WAVE,W_SQ75, 
0,PC_ENV_VOL,255, 
0,PC_TREMOLO_LEVEL,0x60,     
0,PC_TREMOLO_RATE,30, 
0,PC_ENV_SPEED,-8,
1,PATCH_END
};

const char inst7[] PROGMEM ={	
0,PC_WAVE,W_SQ50,
0,PC_NOTE_DOWN,12, 
0,PC_ENV_VOL,255, 
0,PC_ENV_SPEED,-30,
2,PC_ENV_SPEED,-20,
1,PATCH_END
};

const char inst8[] PROGMEM ={	
0,PC_WAVE,W_SAW, 
0,PC_NOTE_DOWN,12,
0,PC_ENV_VOL,255, 
0,PC_ENV_SPEED,-30,
2,PC_ENV_SPEED,-20,
1,PATCH_END
};

const char inst9[] PROGMEM ={	
0,PC_WAVE,W_SQ75, 
0,PC_NOTE_DOWN,12,
0,PC_ENV_VOL,255,
0,PC_ENV_SPEED,-30,
2,PC_ENV_SPEED,-20,
1,PATCH_END
};

const char inst10[] PROGMEM ={	
0,PC_WAVE,W_SAW, 
0,PC_NOTE_UP,12,
0,PC_ENV_VOL,200, 
0,PC_ENV_SPEED,-6,
1,PATCH_END
};

//play sample
const char inst11[] PROGMEM ={	
0,PC_NOTE_DOWN,31,
1,PATCH_END
};

//baseline
const char inst12[] PROGMEM ={	
0,PC_WAVE,W_SIND3, 
0,PC_ENV_VOL,192, 
0,PC_ENV_SPEED,30,
2,PC_ENV_SPEED,-7,
7,PC_ENV_SPEED,-30,
4,PC_ENV_SPEED,-7,
1,PATCH_END
};

//hollow
const char inst13[] PROGMEM ={	
0,PC_ENV_VOL,255, 
0,PC_ENV_SPEED,-40,
2,PC_ENV_SPEED,7,
6,PC_ENV_SPEED,0,
2,PC_ENV_SPEED,-10,
7,PC_ENV_SPEED,-4,
16,PC_ENV_SPEED,-2,

1,PATCH_END
};


//deep base
const char inst14[] PROGMEM ={	
0,PC_WAVE,W_SAW, 
0,PC_NOTE_DOWN,12, 
0,PC_ENV_VOL,255, 
0,PC_ENV_SPEED,-2,
30,PC_ENV_SPEED,-1,
1,PATCH_END
};

//Tom
const char inst15[] PROGMEM ={	
0,PC_WAVE,W_SQ50, 
0,PC_ENV_VOL,255, 
0,PC_NOTE_UP,12, 
0,PC_SLIDE_SPEED,0x10,
0,PC_SLIDE,-48,
1,PC_ENV_VOL,208, 
0,PC_ENV_SPEED,-30,
3,PC_ENV_SPEED,-10,
1,PATCH_END
};


//chord
const char inst16[] PROGMEM ={	
0,PC_WAVE,W_SAW, 
0,PC_ENV_VOL,0, 
0,PC_ENV_SPEED,15,
20,PC_ENV_SPEED,-3,
23,PC_ENV_SPEED,-1,
1,PATCH_END
};




//////////end of Alec's song patches, start of Lee's sfx patches
////////////////////////////////////////////////////////////////
////////////////////////////////////////////////////////////////
const char SfxPatch0[] PROGMEM = {//DUMMY
2,PC_NOTE_CUT,0,
0,PATCH_END
};

const char SfxPatch1[] PROGMEM ={//player bullet 1 of 2
0,PC_ENV_VOL,182,//old 122
//0,PC_WAVE,W_SINE,//can't use this command on PCM chan yet?
0,PC_ENV_SPEED,-8,
0,PC_TREMOLO_LEVEL,122,
0,PC_TREMOLO_RATE,44,
//1,PC_PITCH,61,
//2,PC_PITCH,57,
0,PC_PITCH,60,
1,PC_PITCH,52,
//1,PC_PITCH,49,
1,PC_PITCH,43,
2,PC_NOTE_CUT,0,
0,PATCH_END
};

const char SfxPatch2[] PROGMEM ={//player bullet 2 of 2
0,PC_ENV_VOL,182,//old 122
//0,PC_WAVE,W_SINE,
0,PC_ENV_SPEED,-8,
0,PC_TREMOLO_LEVEL,122,
0,PC_TREMOLO_RATE,44,
//1,PC_PITCH,61,
//2,PC_PITCH,57,
0,PC_PITCH,60,
2,PC_PITCH,52,
//1,PC_PITCH,49,
1,PC_PITCH,43,
2,PC_NOTE_CUT,0,
0,PATCH_END
};


const char SfxPatch3[] PROGMEM ={//particle laser 1 of 2
/*
0,PC_ENV_VOL,171,//old 111
0,PC_WAVE,W_SQ75,
0,PC_TREMOLO_LEVEL,120,
0,PC_TREMOLO_RATE,109,
0,PC_PITCH,79,
1,PC_PITCH,91,
//1,PC_PITCH,89,
1,PC_PITCH,87,
//1,PC_PITCH,85,
//1,PC_PITCH,84,
1,PC_PITCH,82,
1,PC_PITCH,79,
//1,PC_PITCH,77,
//1,PC_PITCH,75,
1,PC_PITCH,73,
//1,PC_PITCH,72,
//1,PC_PITCH,70,
1,PC_PITCH,69,
//1,PC_PITCH,67,
0,PC_ENV_SPEED,-8,
1,PC_PITCH,65,
1,PC_PITCH,63,
1,PC_PITCH,61,
1,PC_PITCH,59,
1,PC_PITCH,60,
1,PC_PITCH,58,
4,PC_NOTE_CUT,0,
0,PATCH_END
*/


0,PC_ENV_VOL,129,//old 89
//0,PC_WAVE,W_SQ75,//Can't use this command on PCM chan yet?
0,PC_TREMOLO_LEVEL,120,
0,PC_TREMOLO_RATE,109,
0,PC_PITCH,79,
1,PC_PITCH,91,
//1,PC_PITCH,89,
1,PC_PITCH,87,
1,PC_PITCH,85,
//1,PC_PITCH,84,
1,PC_PITCH,82,
1,PC_PITCH,79,
//1,PC_PITCH,77,
1,PC_PITCH,75,
1,PC_PITCH,73,
//1,PC_PITCH,72,
1,PC_PITCH,70,
1,PC_PITCH,69,
//1,PC_PITCH,67,
0,PC_ENV_SPEED,-8,
2,PC_PITCH,65,
2,PC_PITCH,63,
2,PC_PITCH,61,
2,PC_PITCH,59,
1,PC_PITCH,60,
1,PC_PITCH,58,
4,PC_NOTE_CUT,0,
0,PATCH_END

/*
0,PC_ENV_VOL,99,
0,PC_TREMOLO_LEVEL,228,
0,PC_TREMOLO_RATE,55,
0,PC_WAVE,W_SQ75,
0,PC_ENV_SPEED,-2,
0,PC_PITCH,90,
1,PC_SLIDE_SPEED,16,
0,PC_SLIDE,-32,
9,PC_TREMOLO_LEVEL,192,
0,PC_TREMOLO_RATE,30,
0,PC_ENV_SPEED,-11,
0,PC_WAVE,W_SIND1,
7,PC_NOTE_CUT,0,
0,PATCH_END
*/
};

const char SfxPatch4[] PROGMEM ={//particle laser 2 of 2

0,PC_ENV_VOL,129,//old 99
0,PC_TREMOLO_LEVEL,199,//121
0,PC_TREMOLO_RATE,99,
1,PC_WAVE,W_SQ75,
0,PC_ENV_SPEED,-2,
0,PC_PITCH,88,
1,PC_SLIDE_SPEED,16,
0,PC_SLIDE,-32,
7,PC_TREMOLO_LEVEL,192,
0,PC_TREMOLO_RATE,30,
0,PC_ENV_SPEED,-11,
0,PC_WAVE,W_SIND1,
7,PC_NOTE_CUT,0,
0,PATCH_END

};

const char SfxPatch5[] PROGMEM = {//powerup sound 1 of 2


0,PC_ENV_VOL,55,//old 30
0,PC_ENV_SPEED,4,
0,PC_WAVE,W_SQ50,
0,PC_TREMOLO_LEVEL,199,
0,PC_TREMOLO_RATE,101,

1,PC_PITCH,53,
//1,PC_PITCH,57,
1,PC_PITCH,56,
//1,PC_PITCH,60,
1,PC_PITCH,59,
//1,PC_PITCH,63,
1,PC_PITCH,68,
//1,PC_PITCH,62,
1,PC_PITCH,66,
//1,PC_PITCH,71,
1,PC_PITCH,65,
//1,PC_PITCH,69,
1,PC_PITCH,74,
//1,PC_PITCH,68,
1,PC_PITCH,72,
//1,PC_PITCH,77,
1,PC_PITCH,71,
//1,PC_PITCH,75,
1,PC_PITCH,80,
//1,PC_PITCH,74,
1,PC_PITCH,78,
1,PC_PITCH,83,
1,PC_PITCH,77,
//1,PC_PITCH,81,
1,PC_PITCH,86,
//1,PC_PITCH,80,
1,PC_PITCH,84,
1,PC_PITCH,89,
1,PC_PITCH,83,
/*
1,PC_PITCH,87,
1,PC_PITCH,92,
1,PC_PITCH,85,
1,PC_PITCH,90,
1,PC_PITCH,95,
1,PC_PITCH,89,
1,PC_PITCH,94,
1,PC_PITCH,99,
1,PC_PITCH,92,
1,PC_PITCH,97,
1,PC_PITCH,102,
1,PC_PITCH,92,
1,PC_PITCH,97,
1,PC_PITCH,102,
*/

1,PC_PITCH,52,
1,PC_PITCH,57,
1,PC_PITCH,62,
1,PC_PITCH,66,
1,PC_PITCH,71,
0,PC_ENV_SPEED,-2,
1,PC_PITCH,76,
1,PC_PITCH,80,
1,PC_PITCH,85,
1,PC_PITCH,90,
1,PC_PITCH,95,
1,PC_PITCH,58,
1,PC_PITCH,63,
1,PC_PITCH,68,
1,PC_PITCH,72,
1,PC_PITCH,77,
1,PC_PITCH,82,
1,PC_PITCH,87,
1,PC_PITCH,92,
1,PC_PITCH,96,
1,PC_PITCH,101,
1,PC_PITCH,107,
1,PC_PITCH,112,
1,PC_PITCH,58,
1,PC_PITCH,63,
1,PC_PITCH,68,
1,PC_PITCH,72,
1,PC_PITCH,77,
1,PC_PITCH,82,
1,PC_PITCH,87,
1,PC_PITCH,92,
1,PC_PITCH,96,
1,PC_PITCH,101,
1,PC_PITCH,107,
1,PC_PITCH,112,
1,PC_PITCH,58,
1,PC_PITCH,63,
1,PC_PITCH,68,
1,PC_PITCH,72,
1,PC_PITCH,77,
1,PC_PITCH,82,
1,PC_PITCH,87,
1,PC_PITCH,92,
1,PC_PITCH,96,
1,PC_PITCH,101,
1,PC_PITCH,107,
1,PC_PITCH,112,
1,PC_PITCH,58,
1,PC_PITCH,63,
1,PC_PITCH,68,
1,PC_PITCH,72,
1,PC_PITCH,77,
1,PC_PITCH,82,
1,PC_PITCH,87,
1,PC_PITCH,92,
1,PC_PITCH,96,
1,PC_PITCH,101,
1,PC_PITCH,107,
1,PC_PITCH,112,
1,PC_PITCH,58,
1,PC_PITCH,63,
1,PC_PITCH,68,
1,PC_PITCH,72,
1,PC_PITCH,77,
1,PC_PITCH,82,
1,PC_PITCH,87,
1,PC_PITCH,92,
1,PC_PITCH,96,
1,PC_PITCH,101,
1,PC_PITCH,107,
1,PC_PITCH,112,
1,PC_PITCH,58,
1,PC_PITCH,63,
1,PC_PITCH,68,
1,PC_PITCH,72,
1,PC_PITCH,77,
1,PC_PITCH,82,
1,PC_PITCH,87,
1,PC_PITCH,92,
1,PC_PITCH,96,
1,PC_PITCH,101,
1,PC_PITCH,107,
1,PC_PITCH,112,

1,PC_NOTE_CUT,0,
0,PATCH_END,0,
/*
0,PC_ENV_VOL,77,
0,PC_ENV_SPEED,9,
0,PC_WAVE,W_SQ50,
0,PC_TREMOLO_LEVEL,199,
0,PC_TREMOLO_RATE,101,
1,PC_PITCH,99,
1,PC_PITCH,93,
1,PC_PITCH,99,
1,PC_PITCH,93,
1,PC_PITCH,99,
1,PC_PITCH,93,
1,PC_PITCH,99,
1,PC_PITCH,93,
1,PC_PITCH,99,
1,PC_PITCH,93,


1,PC_PITCH,105,
1,PC_PITCH,93,
1,PC_PITCH,105,
1,PC_PITCH,93,

//0,PC_ENV_VOL,77,

0,PC_TREMOLO_LEVEL,100,
0,PC_TREMOLO_RATE,180,
//0,PC_ENV_SPEED,-5,
0,PC_WAVE,W_SIND1,
1,PC_PITCH,102,
1,PC_PITCH,96,
1,PC_PITCH,103,
1,PC_PITCH,97,
1,PC_PITCH,104,
1,PC_PITCH,98,
1,PC_PITCH,104,
1,PC_PITCH,98,
1,PC_PITCH,106,
1,PC_PITCH,99,
1,PC_PITCH,106,
1,PC_PITCH,98,
1,PC_PITCH,108,
1,PC_PITCH,100,
1,PC_PITCH,108,
1,PC_PITCH,100,




1,PC_TREMOLO_LEVEL,122,
0,PC_TREMOLO_RATE,34,
1,PC_PITCH,99,
1,PC_PITCH,93,
1,PC_PITCH,99,
1,PC_PITCH,93,

0,PC_TREMOLO_LEVEL,100,
0,PC_TREMOLO_RATE,180,
0,PC_ENV_SPEED,-2,
1,PC_PITCH,102,
1,PC_PITCH,96,
1,PC_PITCH,103,
1,PC_PITCH,97,
1,PC_PITCH,104,
1,PC_PITCH,98,
1,PC_PITCH,106,
1,PC_PITCH,99,
1,PC_PITCH,106,
1,PC_PITCH,98,
1,PC_PITCH,108,
1,PC_PITCH,100,
1,PC_PITCH,108,
1,PC_PITCH,100,



*/
1,PC_NOTE_CUT,0,
0,PATCH_END
};

const char SfxPatch6[] PROGMEM = {//powerup sound 2 of 2
0,PC_ENV_VOL,55,//old 42
//0,PC_ENV_SPEED,4,
//0,PC_WAVE,W_SQ50,
0,PC_TREMOLO_LEVEL,199,
0,PC_TREMOLO_RATE,101/2,

1,PC_PITCH,53,

1,PC_PITCH,57,

1,PC_PITCH,56,
//1,PC_PITCH,60,
1,PC_PITCH,59,
//1,PC_PITCH,63,
1,PC_PITCH,68,
//1,PC_PITCH,62,
1,PC_PITCH,66,
//1,PC_PITCH,71,
1,PC_PITCH,65,
//1,PC_PITCH,69,
1,PC_PITCH,74,
//1,PC_PITCH,68,
1,PC_PITCH,72,
//1,PC_PITCH,77,
1,PC_PITCH,71,
//1,PC_PITCH,75,
1,PC_PITCH,80,
//1,PC_PITCH,74,
1,PC_PITCH,78,
1,PC_PITCH,83,
1,PC_PITCH,77,
//1,PC_PITCH,81,
1,PC_PITCH,86,
//1,PC_PITCH,80,
1,PC_PITCH,84,
1,PC_PITCH,89,
1,PC_PITCH,83,
/*
1,PC_PITCH,87,
1,PC_PITCH,92,
1,PC_PITCH,85,
1,PC_PITCH,90,
1,PC_PITCH,95,
1,PC_PITCH,89,
1,PC_PITCH,94,
1,PC_PITCH,99,
1,PC_PITCH,92,
1,PC_PITCH,97,
1,PC_PITCH,102,
1,PC_PITCH,92,
1,PC_PITCH,97,
1,PC_PITCH,102,
*/

1,PC_PITCH,52,
1,PC_PITCH,57,
1,PC_PITCH,62,
1,PC_PITCH,66,
1,PC_PITCH,71,
//0,PC_ENV_SPEED,-2,
1,PC_PITCH,76,
1,PC_PITCH,80,
1,PC_PITCH,85,
1,PC_PITCH,90,
1,PC_PITCH,95,
1,PC_PITCH,58,
1,PC_PITCH,63,
1,PC_PITCH,68,
1,PC_PITCH,72,
1,PC_PITCH,77,
1,PC_PITCH,82,
1,PC_PITCH,87,
1,PC_PITCH,92,
1,PC_PITCH,96,
1,PC_PITCH,101,
1,PC_PITCH,107,
1,PC_PITCH,112,
1,PC_PITCH,58,
1,PC_PITCH,63,
1,PC_PITCH,68,
1,PC_PITCH,72,
1,PC_PITCH,77,
1,PC_PITCH,82,
1,PC_PITCH,87,
1,PC_PITCH,92,
1,PC_PITCH,96,
1,PC_PITCH,101,
1,PC_PITCH,107,
1,PC_PITCH,112,
1,PC_PITCH,58,
1,PC_PITCH,63,
1,PC_PITCH,68,
1,PC_PITCH,72,
1,PC_PITCH,77,
1,PC_PITCH,82,
1,PC_PITCH,87,
1,PC_PITCH,92,
1,PC_PITCH,96,
1,PC_PITCH,101,
1,PC_PITCH,107,
1,PC_PITCH,112,
1,PC_PITCH,58,
1,PC_PITCH,63,
1,PC_PITCH,68,
1,PC_PITCH,72,
1,PC_PITCH,77,
1,PC_PITCH,82,
0,PC_ENV_SPEED,-1,
1,PC_PITCH,87,
1,PC_PITCH,92,
1,PC_PITCH,96,
1,PC_PITCH,101,
1,PC_PITCH,107,
1,PC_PITCH,112,
1,PC_PITCH,58,
1,PC_PITCH,63,
1,PC_PITCH,68,
1,PC_PITCH,72,
1,PC_PITCH,77,
1,PC_PITCH,82,
1,PC_PITCH,87,
1,PC_PITCH,92,
1,PC_PITCH,96,
1,PC_PITCH,101,
1,PC_PITCH,107,
1,PC_PITCH,112,
1,PC_PITCH,58,
1,PC_PITCH,63,
1,PC_PITCH,68,
1,PC_PITCH,72,
1,PC_PITCH,77,
1,PC_PITCH,82,
1,PC_PITCH,87,
1,PC_PITCH,92,
1,PC_PITCH,96,
1,PC_PITCH,101,
1,PC_PITCH,107,
1,PC_PITCH,112,

1,PC_NOTE_CUT,0,
0,PATCH_END,0,
};

const char SfxPatch7[] PROGMEM = {//player super zapper 1 of 2

0,PC_WAVE,W_SQ50,
0,PC_ENV_VOL,67,//old 33
0,PC_ENV_SPEED,6,
0,PC_TREMOLO_LEVEL,122,
0,PC_TREMOLO_RATE,200,

/*
0,PC_PITCH,38,
1,PC_PITCH,39,
1,PC_PITCH,40,
1,PC_PITCH,42,
2,PC_PITCH,44,
1,PC_PITCH,45,
1,PC_PITCH,46,

0,PC_PITCH,47,
1,PC_PITCH,48,
1,PC_PITCH,49,
1,PC_PITCH,50,
1,PC_PITCH,51,
1,PC_PITCH,52,
1,PC_PITCH,53,
1,PC_PITCH,54,
1,PC_PITCH,55,
1,PC_PITCH,56,
1,PC_PITCH,57,
1,PC_PITCH,58,
1,PC_PITCH,59,
*/
0,PC_PITCH,60,
//1,PC_PITCH,61,
//1,PC_PITCH,62,
1,PC_PITCH,63,
1,PC_PITCH,64,
//1,PC_PITCH,65,
//1,PC_PITCH,66,
1,PC_PITCH,67,
//1,PC_PITCH,68,
1,PC_PITCH,69,
2,PC_PITCH,70,
//1,PC_PITCH,71,
1,PC_PITCH,72,
1,PC_PITCH,73,
//1,PC_PITCH,74,
//1,PC_PITCH,75,
2,PC_PITCH,76,
2,PC_PITCH,77,
1,PC_PITCH,78,

0,PC_ENV_SPEED,0,


2,PC_PITCH,79,
1,PC_PITCH,80,
//1,PC_PITCH,81,
1,PC_PITCH,82,
1,PC_PITCH,83,
//1,PC_PITCH,84,
1,PC_PITCH,85,
1,PC_PITCH,86,
//1,PC_PITCH,87,
1,PC_PITCH,88,
1,PC_PITCH,89,

0,PC_ENV_SPEED,-6,

//1,PC_PITCH,91,
1,PC_PITCH,92,
1,PC_PITCH,94,
//1,PC_PITCH,96,
1,PC_PITCH,98,
1,PC_PITCH,101,
1,PC_PITCH,104,
1,PC_PITCH,107,


40,PC_ENV_SPEED,0,
0,PC_ENV_VOL,128,



//////////////////////////////////////////////
0,PC_ENV_VOL,198,//old 138
0,PC_WAVE,W_TRI, 
0,PC_ENV_SPEED,-1, 
0,PC_PITCH,67,
1,PC_NOTE_DOWN,4,
1,PC_NOTE_DOWN,4,
1,PC_NOTE_DOWN,4,
1,PC_NOTE_DOWN,4,
1,PC_NOTE_DOWN,4,
1,PC_NOTE_DOWN,4,
1,PC_NOTE_DOWN,4,
1,PC_NOTE_DOWN,4,
1,PC_NOTE_DOWN,4,
1,PC_NOTE_DOWN,4,
2,PC_ENV_VOL,100,
0,PC_PITCH,60,
1,PC_NOTE_DOWN,4,
1,PC_NOTE_DOWN,4,
1,PC_NOTE_DOWN,4,
1,PC_NOTE_DOWN,4,
1,PC_NOTE_DOWN,4,
1,PC_NOTE_DOWN,4,
1,PC_NOTE_DOWN,4,
1,PC_NOTE_DOWN,4,
1,PC_NOTE_DOWN,4,
1,PC_NOTE_DOWN,4,
2,PC_ENV_VOL,70,
0,PC_PITCH,60,
1,PC_NOTE_DOWN,4,
1,PC_NOTE_DOWN,4,
1,PC_NOTE_DOWN,4,
1,PC_NOTE_DOWN,4,
1,PC_NOTE_DOWN,4,
1,PC_NOTE_DOWN,4,
1,PC_NOTE_DOWN,4,
1,PC_NOTE_DOWN,4,
1,PC_NOTE_DOWN,4,
1,PC_NOTE_DOWN,4,
2,PC_ENV_VOL,40,
0,PC_PITCH,60,
1,PC_NOTE_DOWN,4,
1,PC_NOTE_DOWN,4,
1,PC_NOTE_DOWN,4,
1,PC_NOTE_DOWN,4,
1,PC_NOTE_DOWN,4,
1,PC_NOTE_DOWN,4,
1,PC_NOTE_DOWN,4,
1,PC_NOTE_DOWN,4,
1,PC_NOTE_DOWN,4,
1,PC_NOTE_DOWN,4,
2,PC_ENV_VOL,20,
0,PC_PITCH,60,
1,PC_NOTE_DOWN,4,
1,PC_NOTE_DOWN,4,
1,PC_NOTE_DOWN,4,
1,PC_NOTE_DOWN,4,
1,PC_NOTE_DOWN,4,
1,PC_NOTE_DOWN,4,
1,PC_NOTE_DOWN,4,
1,PC_NOTE_DOWN,4,
1,PC_NOTE_DOWN,4,
1,PC_NOTE_DOWN,4,
1,PC_NOTE_CUT,0,
0,PATCH_END 

};

const char SfxPatch8[] PROGMEM = {//player super zapper 2 of 2
0,PC_ENV_VOL,63,//old 43
0,PC_NOISE_PARAMS,11,
1,PC_NOISE_PARAMS,14,
6,PC_ENV_SPEED,-1,
15,PC_NOISE_PARAMS,22,

1,PC_ENV_VOL,69,//old 53
0,PC_NOISE_PARAMS,32,
//4,PC_ENV_VOL,0xa0,
12,PC_ENV_SPEED,-2,
 
29,PC_ENV_VOL,100,//old 77
3,PC_NOISE_PARAMS,45,
//33,PC_ENV_SPEED,-2,
33,PC_NOISE_PARAMS,44,
22,PC_ENV_SPEED,-1,


60,PC_NOTE_CUT,0,
0,PATCH_END

};

const char SfxPatch9[] PROGMEM = {//player caught 1 of 2

0,PC_WAVE,W_SIND1,
0,PC_TREMOLO_RATE,155,
0,PC_TREMOLO_LEVEL,200,
0,PC_ENV_VOL,188,//old 122
0,PC_ENV_SPEED,1,
0,PC_PITCH,40,
2,PC_PITCH,42,
2,PC_PITCH,44,
2,PC_PITCH,46,
2,PC_PITCH,48,
2,PC_PITCH,50,
2,PC_PITCH,52,
2,PC_PITCH,53,
2,PC_PITCH,54,
2,PC_PITCH,55,
2,PC_PITCH,56,
2,PC_PITCH,57,
2,PC_PITCH,58,
0,PC_ENV_SPEED,-2,
6,PC_PITCH,59,
6,PC_PITCH,60,
6,PC_PITCH,61,
6,PC_PITCH,62,
6,PC_PITCH,63,
6,PC_PITCH,64,
6,PC_PITCH,65,
6,PC_PITCH,66,
6,PC_PITCH,67,
8,PC_PITCH,68,
10,PC_PITCH,69,
11,PC_PITCH,70,

6,PC_NOTE_CUT,0,
0,PATCH_END

};


const char SfxPatch10[] PROGMEM = {//player caught 2 of 2

//0,PC_WAVE,W_SQ75,
0,PC_ENV_VOL,188,//old 122
0,PC_TREMOLO_RATE,155,
0,PC_TREMOLO_LEVEL,200,

0,PC_ENV_SPEED,-2,
0,PC_PITCH,40,
3,PC_PITCH,42,
2,PC_PITCH,44,
2,PC_PITCH,46,
2,PC_PITCH,48,
2,PC_PITCH,50,
2,PC_PITCH,52,
2,PC_PITCH,53,
2,PC_PITCH,54,
2,PC_PITCH,55,
2,PC_PITCH,56,
2,PC_PITCH,57,
2,PC_PITCH,58,
0,PC_ENV_SPEED,-1,
6,PC_PITCH,59,
6,PC_PITCH,60,
6,PC_PITCH,61,
6,PC_PITCH,62,
6,PC_PITCH,63,
6,PC_PITCH,64,
6,PC_PITCH,65,
6,PC_PITCH,66,
6,PC_PITCH,67,
6,PC_NOTE_CUT,0,
0,PATCH_END
};


const char SfxPatch11[] PROGMEM ={//player got shot 1 of 2
/*
0,PC_ENV_VOL,90,
0,PC_ENV_SPEED,5,

0,PC_NOISE_PARAMS,22,
2,PC_NOISE_PARAMS,14,
4,PC_NOISE_PARAMS,11,
2,PC_NOISE_PARAMS,14,
3,PC_NOISE_PARAMS,11,
7,PC_ENV_SPEED,-5,
2,PC_NOISE_PARAMS,14,
5,PC_NOISE_PARAMS,11,


2,PC_NOISE_PARAMS,14,
10,PC_ENV_SPEED,-5,
5,PC_NOISE_PARAMS,11,


6,PC_ENV_VOL,80,
0,PC_NOISE_PARAMS,22,
//5,PC_ENV_VOL,0xa0,
//20,PC_ENV_SPEED,-2, 

0,PC_ENV_SPEED,-1,
0,PC_NOISE_PARAMS,11,


80,PC_NOTE_CUT,0,
0,PATCH_END

*/
0,PC_ENV_VOL,123,//old 77
0,PC_ENV_SPEED,9,
0,PC_WAVE,W_SQ50,
1,PC_TREMOLO_LEVEL,100,
0,PC_TREMOLO_RATE,111,
1,PC_PITCH,87,
1,PC_PITCH,81,
1,PC_PITCH,87,
1,PC_PITCH,81,
1,PC_PITCH,87,
1,PC_PITCH,81,
1,PC_PITCH,87,
1,PC_PITCH,81,
1,PC_PITCH,87,
1,PC_PITCH,81,
1,PC_TREMOLO_LEVEL,100,
0,PC_TREMOLO_RATE,180,
0,PC_ENV_SPEED,-2,
1,PC_PITCH,95,
1,PC_PITCH,94,
1,PC_PITCH,93,
1,PC_PITCH,92,
1,PC_PITCH,91,
1,PC_PITCH,90,
1,PC_PITCH,95,
1,PC_PITCH,94,
1,PC_PITCH,93,
1,PC_PITCH,92,
1,PC_PITCH,91,
1,PC_PITCH,90,
1,PC_PITCH,95,
1,PC_PITCH,94,
1,PC_PITCH,93,
1,PC_PITCH,92,
1,PC_PITCH,91,
1,PC_PITCH,90,
1,PC_PITCH,95,
1,PC_PITCH,94,
1,PC_PITCH,93,
1,PC_PITCH,92,
1,PC_PITCH,91,
1,PC_PITCH,90,
1,PC_PITCH,95,
1,PC_PITCH,94,
1,PC_PITCH,93,
1,PC_PITCH,92,
1,PC_PITCH,91,
1,PC_PITCH,90,
1,PC_PITCH,95,
1,PC_PITCH,94,
1,PC_PITCH,93,
1,PC_PITCH,92,
1,PC_PITCH,91,
1,PC_PITCH,90,
1,PC_PITCH,95,
1,PC_PITCH,94,
1,PC_PITCH,93,
1,PC_PITCH,92,
1,PC_PITCH,91,
1,PC_PITCH,90,
1,PC_PITCH,95,
1,PC_PITCH,94,
1,PC_PITCH,93,
1,PC_PITCH,92,
1,PC_PITCH,91,
1,PC_PITCH,90,
1,PC_PITCH,95,
1,PC_PITCH,94,
1,PC_PITCH,93,
1,PC_PITCH,92,
1,PC_PITCH,91,
1,PC_PITCH,90,
1,PC_PITCH,95,
1,PC_PITCH,94,
1,PC_PITCH,93,
1,PC_PITCH,92,
1,PC_PITCH,91,
1,PC_PITCH,90,
1,PC_PITCH,95,
1,PC_PITCH,94,
1,PC_PITCH,93,
1,PC_PITCH,92,
1,PC_PITCH,91,
1,PC_PITCH,90,
1,PC_PITCH,95,
1,PC_PITCH,94,
1,PC_PITCH,93,
1,PC_PITCH,92,
1,PC_PITCH,91,
1,PC_PITCH,90,
1,PC_PITCH,95,
1,PC_PITCH,94,
1,PC_PITCH,93,
1,PC_PITCH,92,
1,PC_PITCH,91,
1,PC_PITCH,90,
1,PC_PITCH,95,
1,PC_PITCH,94,
1,PC_PITCH,93,
1,PC_PITCH,92,
1,PC_PITCH,91,
1,PC_PITCH,90,
1,PC_PITCH,95,
1,PC_PITCH,94,
1,PC_PITCH,93,
1,PC_PITCH,92,
1,PC_PITCH,91,
1,PC_PITCH,90,
1,PC_PITCH,95,
1,PC_PITCH,94,
1,PC_PITCH,93,
1,PC_PITCH,92,
1,PC_PITCH,91,
1,PC_PITCH,90,
1,PC_PITCH,95,
1,PC_PITCH,94,
1,PC_PITCH,93,
1,PC_PITCH,92,
1,PC_PITCH,91,
1,PC_PITCH,90,
1,PC_PITCH,95,
1,PC_PITCH,94,
1,PC_PITCH,93,
1,PC_PITCH,92,
1,PC_PITCH,91,
1,PC_PITCH,90,
1,PC_PITCH,95,
1,PC_PITCH,94,
1,PC_PITCH,93,
1,PC_PITCH,92,
1,PC_PITCH,91,
1,PC_PITCH,90,
1,PC_NOTE_CUT,0,
0,PATCH_END
};


const char SfxPatch12[] PROGMEM ={//player got shot 2 of 2

/*
0,PC_ENV_VOL,90,
0,PC_ENV_SPEED,5,

0,PC_NOISE_PARAMS,22,
2,PC_NOISE_PARAMS,14,
4,PC_NOISE_PARAMS,11,
2,PC_NOISE_PARAMS,14,
3,PC_NOISE_PARAMS,11,
7,PC_ENV_SPEED,-5,
2,PC_NOISE_PARAMS,14,
5,PC_NOISE_PARAMS,11,


2,PC_NOISE_PARAMS,14,
10,PC_ENV_SPEED,-5,
5,PC_NOISE_PARAMS,11,


6,PC_ENV_VOL,80,
0,PC_NOISE_PARAMS,22,
//5,PC_ENV_VOL,0xa0,
//20,PC_ENV_SPEED,-2, 

0,PC_ENV_SPEED,-1,
0,PC_NOISE_PARAMS,11,


80,PC_NOTE_CUT,0,
0,PATCH_END


*/
0,PC_ENV_VOL,123,//old 77
0,PC_ENV_SPEED,9,
0,PC_WAVE,W_SQ50,
1,PC_TREMOLO_LEVEL,100,
0,PC_TREMOLO_RATE,111,
1,PC_PITCH,87,
1,PC_PITCH,81,
1,PC_PITCH,87,
1,PC_PITCH,81,
1,PC_PITCH,87,
1,PC_PITCH,81,
1,PC_PITCH,87,
1,PC_PITCH,81,
1,PC_PITCH,87,
1,PC_PITCH,81,
1,PC_TREMOLO_LEVEL,100,
0,PC_TREMOLO_RATE,180,
0,PC_ENV_SPEED,-2,
1,PC_PITCH,95,
1,PC_PITCH,94,
1,PC_PITCH,93,
1,PC_PITCH,92,
1,PC_PITCH,91,
1,PC_PITCH,90,
1,PC_PITCH,95,
1,PC_PITCH,94,
1,PC_PITCH,93,
1,PC_PITCH,92,
1,PC_PITCH,91,
1,PC_PITCH,90,
1,PC_PITCH,95,
1,PC_PITCH,94,
1,PC_PITCH,93,
1,PC_PITCH,92,
1,PC_PITCH,91,
1,PC_PITCH,90,
1,PC_PITCH,95,
1,PC_PITCH,94,
1,PC_PITCH,93,
1,PC_PITCH,92,
1,PC_PITCH,91,
1,PC_PITCH,90,
1,PC_PITCH,95,
1,PC_PITCH,94,
1,PC_PITCH,93,
1,PC_PITCH,92,
1,PC_PITCH,91,
1,PC_PITCH,90,
1,PC_PITCH,95,
1,PC_PITCH,94,
1,PC_PITCH,93,
1,PC_PITCH,92,
1,PC_PITCH,91,
1,PC_PITCH,90,
1,PC_PITCH,95,
1,PC_PITCH,94,
1,PC_PITCH,93,
1,PC_PITCH,92,
1,PC_PITCH,91,
1,PC_PITCH,90,
1,PC_PITCH,95,
1,PC_PITCH,94,
1,PC_PITCH,93,
1,PC_PITCH,92,
1,PC_PITCH,91,
1,PC_PITCH,90,
1,PC_PITCH,95,
1,PC_PITCH,94,
1,PC_PITCH,93,
1,PC_PITCH,92,
1,PC_PITCH,91,
1,PC_PITCH,90,
1,PC_PITCH,95,
1,PC_PITCH,94,
1,PC_PITCH,93,
1,PC_PITCH,92,
1,PC_PITCH,91,
1,PC_PITCH,90,
1,PC_PITCH,95,
1,PC_PITCH,94,
1,PC_PITCH,93,
1,PC_PITCH,92,
1,PC_PITCH,91,
1,PC_PITCH,90,
1,PC_PITCH,95,
1,PC_PITCH,94,
1,PC_PITCH,93,
1,PC_PITCH,92,
1,PC_PITCH,91,
1,PC_PITCH,90,
1,PC_PITCH,95,
1,PC_PITCH,94,
1,PC_PITCH,93,
1,PC_PITCH,92,
1,PC_PITCH,91,
1,PC_PITCH,90,
1,PC_PITCH,95,
1,PC_PITCH,94,
1,PC_PITCH,93,
1,PC_PITCH,92,
1,PC_PITCH,91,
1,PC_PITCH,90,
1,PC_PITCH,95,
1,PC_PITCH,94,
1,PC_PITCH,93,
1,PC_PITCH,92,
1,PC_PITCH,91,
1,PC_PITCH,90,
1,PC_PITCH,95,
1,PC_PITCH,94,
1,PC_PITCH,93,
1,PC_PITCH,92,
1,PC_PITCH,91,
1,PC_PITCH,90,
1,PC_PITCH,95,
1,PC_PITCH,94,
1,PC_PITCH,93,
1,PC_PITCH,92,
1,PC_PITCH,91,
1,PC_PITCH,90,
1,PC_PITCH,95,
1,PC_PITCH,94,
1,PC_PITCH,93,
1,PC_PITCH,92,
1,PC_PITCH,91,
1,PC_PITCH,90,
1,PC_PITCH,95,
1,PC_PITCH,94,
1,PC_PITCH,93,
1,PC_PITCH,92,
1,PC_PITCH,91,
1,PC_PITCH,90,
1,PC_NOTE_CUT,0,
0,PATCH_END
};

const char SfxPatch13[] PROGMEM ={//player jump
0,PC_ENV_VOL,119,//old 72
0,PC_WAVE,W_TRI,
0,PC_TREMOLO_LEVEL,167,
0,PC_TREMOLO_RATE,110,
0,PC_PITCH,38,
1,PC_PITCH,39,
1,PC_PITCH,40,
1,PC_PITCH,41,
2,PC_PITCH,42,
0,PC_ENV_SPEED,-2,
0,PC_TREMOLO_LEVEL,128,
0,PC_TREMOLO_RATE,199,
2,PC_PITCH,44,
2,PC_PITCH,45,
0,PC_WAVE,W_SQ50,
0,PC_ENV_SPEED,-5,
//0,PC_TREMOLO_LEVEL,255,
0,PC_TREMOLO_RATE,88,
3,PC_PITCH,47,
4,PC_PITCH,49,
5,PC_PITCH,51,
25,PC_NOTE_CUT,0,
0,PATCH_END
};

const char SfxPatch14[] PROGMEM ={//web zoom 1 of 2
0,PC_WAVE,W_SQ50,
0,PC_ENV_VOL,192,//old 111
0,PC_TREMOLO_RATE,155,
0,PC_TREMOLO_LEVEL,200,

0,PC_ENV_SPEED,1,
0,PC_PITCH,67,

1,PC_PITCH,59,

1,PC_PITCH,67-12,
1,PC_PITCH,59-12,
1,PC_PITCH,68-12,
1,PC_PITCH,60-12,
1,PC_PITCH,68-12,
1,PC_PITCH,60-12,
1,PC_PITCH,68-12,
1,PC_PITCH,61-12,
1,PC_PITCH,69-12,
1,PC_PITCH,61-12,
1,PC_PITCH,69-12,
1,PC_PITCH,62-12,
1,PC_PITCH,70-12,
1,PC_PITCH,62-12,
1,PC_PITCH,70-12,
1,PC_PITCH,62-12,
1,PC_PITCH,71-12,
1,PC_PITCH,63-12,
1,PC_PITCH,71-12,
1,PC_PITCH,63-12,
1,PC_PITCH,71-12,
1,PC_PITCH,64-12,
1,PC_PITCH,72-12,
1,PC_PITCH,64-12,
1,PC_PITCH,72-12,
1,PC_PITCH,64-12,
1,PC_PITCH,72-12,
1,PC_PITCH,65-12,
1,PC_PITCH,73-12,
1,PC_PITCH,65-12,
1,PC_PITCH,73-12,
1,PC_PITCH,66-12,
1,PC_PITCH,74-12,
1,PC_PITCH,66-12,
1,PC_PITCH,74-12,
1,PC_PITCH,66-12,
1,PC_PITCH,75-12,
1,PC_PITCH,67-12,
1,PC_PITCH,75-12,
1,PC_PITCH,67-12,
1,PC_PITCH,75-12,
1,PC_PITCH,68-12,
1,PC_PITCH,76-12,
1,PC_PITCH,68-12,
1,PC_PITCH,76-12,
1,PC_PITCH,68-12,
1,PC_PITCH,76-12,
1,PC_PITCH,69-12,
1,PC_PITCH,77-12,
1,PC_PITCH,69-12,
1,PC_PITCH,77-12,
1,PC_PITCH,70-12,
1,PC_PITCH,78-12,
1,PC_PITCH,70-12,

0,PC_ENV_SPEED,-1,

1,PC_PITCH,78-12,
1,PC_PITCH,71-12,
1,PC_PITCH,79-12,
2,PC_PITCH,71-12,
1,PC_PITCH,80-12,
1,PC_PITCH,72-12,
1,PC_PITCH,80-12,
2,PC_PITCH,73-12,
1,PC_PITCH,81-12,
1,PC_PITCH,73-12,
2,PC_PITCH,82-12,
1,PC_PITCH,74-12,
1,PC_PITCH,82-12,
2,PC_PITCH,75-12,
1,PC_PITCH,83-12,
1,PC_PITCH,75-12,
2,PC_PITCH,84-12,
1,PC_PITCH,76-12,
1,PC_PITCH,84-12,
2,PC_PITCH,77-12,
1,PC_PITCH,85-12,
2,PC_PITCH,77-12,
1,PC_PITCH,85-12,
2,PC_PITCH,78-12,
1,PC_PITCH,86-12,
2,PC_PITCH,78-12,
1,PC_PITCH,87-12,
2,PC_PITCH,79-12,
1,PC_PITCH,87-12,
2,PC_PITCH,79-12,
1,PC_PITCH,87-12,
2,PC_PITCH,80-12,
2,PC_PITCH,74-12,
2,PC_PITCH,66-12,
2,PC_NOTE_CUT,0,
0,PATCH_END

};

const char SfxPatch15[] PROGMEM ={//web zoom 2 of 2
0,PC_ENV_VOL,0,
13,PC_ENV_VOL,123,//old 77
0,PC_TREMOLO_RATE,189,
0,PC_TREMOLO_LEVEL,120,

0,PC_ENV_SPEED,1,
0,PC_PITCH,67-12-12,
1,PC_PITCH,59-12-12,
1,PC_PITCH,67-12-12,
1,PC_PITCH,59-12-12,
1,PC_PITCH,68-12-12,
1,PC_PITCH,60-12-12,
1,PC_PITCH,68-12-12,
1,PC_PITCH,60-12-12,
1,PC_PITCH,68-12-12,
1,PC_PITCH,61-12-12,
1,PC_PITCH,69-12-12,
1,PC_PITCH,61-12-12,
1,PC_PITCH,69-12-12,
1,PC_PITCH,62-12-12,
1,PC_PITCH,70-12-12,
1,PC_PITCH,62-12-12,
1,PC_PITCH,70-12-12,
1,PC_PITCH,62-12-12,
1,PC_PITCH,71-12-12,
1,PC_PITCH,63-12-12,
1,PC_PITCH,71-12-12,
1,PC_PITCH,63-12-12,
1,PC_PITCH,71-12-12,
1,PC_PITCH,64-12-12,
1,PC_PITCH,72-12-12,
1,PC_PITCH,64-12-12,
1,PC_PITCH,72-12-12,
1,PC_PITCH,64-12-12,
1,PC_PITCH,72-12-12,
1,PC_PITCH,65-12-12,
1,PC_PITCH,73-12-12,
1,PC_PITCH,65-12-12,
1,PC_PITCH,73-12-12,
1,PC_PITCH,66-12-12,
1,PC_PITCH,74-12-12,
1,PC_PITCH,66-12-12,
1,PC_PITCH,74-12-12,
1,PC_PITCH,66-12-12,
1,PC_PITCH,75-12-12,
1,PC_PITCH,67-12-12,
1,PC_PITCH,75-12-12,
1,PC_PITCH,67-12-12,
1,PC_PITCH,75-12-12,
1,PC_PITCH,68-12-12,
1,PC_PITCH,76-12-12,
1,PC_PITCH,68-12-12,
1,PC_PITCH,76-12-12,
1,PC_PITCH,68-12-12,
1,PC_PITCH,76-12-12,
1,PC_PITCH,69-12-12,
1,PC_PITCH,77-12-12,
1,PC_PITCH,69-12-12,
1,PC_PITCH,77-12-12,
1,PC_PITCH,70-12-12,
1,PC_PITCH,78-12-12,
1,PC_PITCH,70-12-12,

0,PC_ENV_SPEED,-2,

1,PC_PITCH,78-12-12,
1,PC_PITCH,71-12-12,
1,PC_PITCH,79-12-12,
1,PC_PITCH,71-12-12,
1,PC_PITCH,80-12-12,
1,PC_PITCH,72-12-12,
1,PC_PITCH,80-12-12,
1,PC_PITCH,73-12-12,
1,PC_PITCH,81-12-12,
1,PC_PITCH,73-12-12,
1,PC_PITCH,82-12-12,
1,PC_PITCH,74-12-12,
1,PC_PITCH,82-12-12,
1,PC_PITCH,75-12-12,
1,PC_PITCH,83-12-12,
1,PC_PITCH,75-12-12,
1,PC_PITCH,84-12-12,
1,PC_PITCH,76-12-12,
1,PC_PITCH,84-12-12,
1,PC_PITCH,77-12-12,
1,PC_PITCH,85-12-12,
1,PC_PITCH,77-12-12,
1,PC_PITCH,85-12-12,
1,PC_PITCH,78-12-12,
1,PC_PITCH,86-12-12,
1,PC_PITCH,78-12-12,
1,PC_PITCH,87-12-12,
1,PC_PITCH,79-12-12,
1,PC_PITCH,87-12-12,
1,PC_PITCH,79-12-12,
1,PC_PITCH,87-12-12,
1,PC_PITCH,80-12-12,
1,PC_PITCH,74-12-12,
1,PC_PITCH,66-12-12,
1,PC_NOTE_CUT,0,
0,PATCH_END
};


const char SfxPatch16[] PROGMEM = {//enemy zapper
/*
0,PC_WAVE,W_SQ75,
0,PC_ENV_VOL,88,
1,PC_PITCH,85,
1,PC_PITCH,89,
1,PC_PITCH,94,
1,PC_PITCH,99,
1,PC_PITCH,80,
1,PC_PITCH,84,
1,PC_PITCH,89,
1,PC_PITCH,94,
1,PC_PITCH,82,
1,PC_PITCH,86,
1,PC_PITCH,91,
1,PC_PITCH,96,
1,PC_PITCH,80,
1,PC_PITCH,84,
1,PC_PITCH,89,
1,PC_PITCH,94,
1,PC_PITCH,77,
1,PC_PITCH,81,
1,PC_PITCH,86,
1,PC_PITCH,91,
0,PC_ENV_SPEED,-15,
1,PC_PITCH,75,
1,PC_PITCH,79,
1,PC_PITCH,84,
1,PC_PITCH,89,
1,PC_PITCH,75,
0,PC_ENV_SPEED,-30,
1,PC_PITCH,79,
1,PC_PITCH,84,
1,PC_PITCH,89,

*/



0,PC_WAVE,W_SIND1,
0,PC_ENV_VOL,151,//old 88
1,PC_PITCH,75,
1,PC_PITCH,79,
1,PC_PITCH,84,
1,PC_PITCH,89,
1,PC_PITCH,75,
1,PC_PITCH,79,
1,PC_PITCH,84,
1,PC_PITCH,89,
1,PC_PITCH,75,
1,PC_PITCH,79,
1,PC_PITCH,84,
1,PC_PITCH,89,
1,PC_PITCH,75,
1,PC_PITCH,79,
1,PC_PITCH,84,
1,PC_PITCH,89,
1,PC_PITCH,75,
1,PC_PITCH,79,
1,PC_PITCH,84,
1,PC_PITCH,89,
0,PC_ENV_SPEED,-15,
1,PC_PITCH,75,
1,PC_PITCH,79,
1,PC_PITCH,84,
1,PC_PITCH,89,
1,PC_PITCH,75,
0,PC_ENV_SPEED,-30,
1,PC_PITCH,79,
1,PC_PITCH,84,
1,PC_PITCH,89,


1,PC_NOTE_CUT,0,
0,PATCH_END

};


const char SfxPatch17[] PROGMEM ={//enemy explosion

0,PC_ENV_VOL,145,//old 90
0,PC_NOISE_PARAMS,32,
1,PC_NOISE_PARAMS,14,
6,PC_ENV_SPEED,-5,
3,PC_NOISE_PARAMS,11,

0,PC_ENV_VOL,80,//old 50
0,PC_NOISE_PARAMS,22,
1,PC_ENV_VOL,0xc0,//old 0xa0
4,PC_ENV_SPEED,-15, 

6,PC_ENV_SPEED,-2,
3,PC_NOISE_PARAMS,11,
2,PC_ENV_SPEED,-2,

12,PC_NOTE_CUT,0,
0,PATCH_END

};

const char SfxPatch18[] PROGMEM ={//flipper on edge web click
0,PC_WAVE,W_TRI,
0,PC_ENV_VOL,158,//old 96
0,PC_ENV_SPEED,-30,
0,PC_PITCH,123,//97
2,PC_PITCH,122,
2,PC_NOTE_CUT,0,
0,PATCH_END

};

const char SfxPatch19[] PROGMEM ={//web click
0,PC_ENV_VOL,152,//old 102
0,PC_WAVE,W_SQ50,
0,PC_ENV_SPEED,-16,
0,PC_PITCH,82,
1,PC_TREMOLO_LEVEL,100,
0,PC_TREMOLO_RATE,111,
1,PC_PITCH,81,
0,PC_ENV_SPEED,-34,
1,PC_NOTE_CUT,0,
0,PATCH_END
};

const char SfxPatch20[] PROGMEM ={//tanker break
0,PC_ENV_VOL,145,//old 90

5,PC_ENV_SPEED,-2,
1,PC_NOISE_PARAMS,11,
1,PC_ENV_SPEED,-7,


0,PC_NOISE_PARAMS,32,
1,PC_NOISE_PARAMS,14,
3,PC_ENV_SPEED,-9,
1,PC_NOISE_PARAMS,11,

0,PC_ENV_VOL,75,//old 50
0,PC_NOISE_PARAMS,22,
0,PC_ENV_VOL,0xc0,//old 0xa0
//4,PC_ENV_SPEED,-9, 

40,PC_NOTE_CUT,0,
0,PATCH_END
};

const char SfxPatch21[] PROGMEM ={//pulsar approach(PLACEHOLDER)
0,PC_ENV_VOL,152,//old 102
0,PC_WAVE,W_SQ50,
0,PC_ENV_SPEED,-16,
0,PC_PITCH,82,
1,PC_TREMOLO_LEVEL,100,
0,PC_TREMOLO_RATE,111,
1,PC_PITCH,81,
0,PC_ENV_SPEED,-34,
1,PC_NOTE_CUT,0,
0,PATCH_END
};




const char SfxPatch22[] PROGMEM ={//spike shot by player
0,PC_WAVE,W_SIND1,//2
0,PC_ENV_VOL,145,//old 96
0,PC_ENV_SPEED,-4,
0,PC_TREMOLO_RATE,45,//97
0,PC_TREMOLO_LEVEL,145,
1,PC_NOTE_UP,4,
//1,PC_NOTE_DOWN,2,
1,PC_NOTE_UP,3,
0,PC_ENV_SPEED,-30,
6,PC_NOTE_CUT,0,
0,PATCH_END

};





const char SfxPatch23[] PROGMEM = {//player gets powerup sound 1 of 2


0,PC_ENV_VOL,45,//old 30
0,PC_ENV_SPEED,4,
0,PC_WAVE,W_SQ50,
0,PC_TREMOLO_LEVEL,199,
0,PC_TREMOLO_RATE,101,

1,PC_PITCH,53-4,
//1,PC_PITCH,57,
1,PC_PITCH,56-4,
//1,PC_PITCH,60,
1,PC_PITCH,59-4,
//1,PC_PITCH,63,
1,PC_PITCH,68-4,
//1,PC_PITCH,62,
1,PC_PITCH,66-4,
//1,PC_PITCH,71,
1,PC_PITCH,65-4,
//1,PC_PITCH,69,
1,PC_PITCH,74-4,
//1,PC_PITCH,68,
1,PC_PITCH,72-4,
//1,PC_PITCH,77,
1,PC_PITCH,71-4,
//1,PC_PITCH,75,
1,PC_PITCH,80-4,
//1,PC_PITCH,74,
1,PC_PITCH,78-4,
1,PC_PITCH,83-4,
1,PC_PITCH,77-4,
//1,PC_PITCH,81,
1,PC_PITCH,86-4,
//1,PC_PITCH,80,
1,PC_PITCH,84-4,
1,PC_PITCH,89-4,
1,PC_PITCH,83-4,
/*
1,PC_PITCH,87,
1,PC_PITCH,92,
1,PC_PITCH,85,
1,PC_PITCH,90,
1,PC_PITCH,95,
1,PC_PITCH,89,
1,PC_PITCH,94,
1,PC_PITCH,99,
1,PC_PITCH,92,
1,PC_PITCH,97,
1,PC_PITCH,102,
1,PC_PITCH,92,
1,PC_PITCH,97,
1,PC_PITCH,102,
*/

1,PC_PITCH,52-4,
1,PC_PITCH,57-4,
1,PC_PITCH,62-4,
1,PC_PITCH,66-4,
1,PC_PITCH,71-4,
0,PC_ENV_SPEED,-2,
1,PC_PITCH,76-4,
1,PC_PITCH,80-4,
1,PC_PITCH,85-4,
1,PC_PITCH,90-4,
1,PC_PITCH,95-4,
1,PC_PITCH,58-4,
1,PC_PITCH,63-4,
1,PC_PITCH,68-4,
1,PC_PITCH,72-4,
1,PC_PITCH,77-4,
1,PC_PITCH,82-4,
1,PC_PITCH,87-4,
1,PC_PITCH,92-4,
1,PC_PITCH,96-4,
1,PC_PITCH,101-4,
1,PC_PITCH,107-4,
1,PC_PITCH,112-4,
1,PC_PITCH,58-4,
1,PC_PITCH,63-4,
1,PC_PITCH,68-4,
1,PC_PITCH,72-4,
1,PC_PITCH,77-4,
1,PC_PITCH,82-4,
1,PC_PITCH,87-4,
1,PC_PITCH,92-4,
1,PC_PITCH,96-4,
1,PC_PITCH,101-4,
1,PC_PITCH,107-4,
1,PC_PITCH,112-4,
1,PC_PITCH,58-4,
1,PC_PITCH,63-4,
1,PC_PITCH,68-4,
1,PC_PITCH,72-4,
1,PC_PITCH,77-4,
1,PC_PITCH,82-4,
1,PC_PITCH,87-4,
1,PC_PITCH,92-4,
1,PC_PITCH,96-4,
1,PC_PITCH,101-4,
1,PC_PITCH,107-4,
1,PC_PITCH,112-4,
1,PC_PITCH,58-4,
1,PC_PITCH,63-4,
1,PC_PITCH,68-4,
1,PC_PITCH,72-4,
1,PC_PITCH,77-4,
1,PC_PITCH,82-4,
1,PC_PITCH,87-4,
1,PC_PITCH,92-4,
1,PC_PITCH,96-4,
1,PC_PITCH,101-4,
1,PC_PITCH,107-4,
1,PC_PITCH,112-4,
1,PC_PITCH,58-4,
1,PC_PITCH,63-4,
1,PC_PITCH,68-4,
1,PC_PITCH,72-4,
1,PC_PITCH,77-4,
1,PC_PITCH,82-4,
1,PC_PITCH,87-4,
1,PC_PITCH,92-4,
1,PC_PITCH,96-4,
1,PC_PITCH,101-4,
1,PC_PITCH,107-4,
1,PC_PITCH,112-4,
1,PC_PITCH,58-4,
1,PC_PITCH,63-4,
1,PC_PITCH,68-4,
1,PC_PITCH,72-4,
1,PC_PITCH,77-4,
1,PC_PITCH,82-4,
1,PC_PITCH,87-4,
1,PC_PITCH,92-4,
1,PC_PITCH,96-4,
1,PC_PITCH,101-4,
1,PC_PITCH,107-4,
1,PC_PITCH,112-4,

1,PC_NOTE_CUT,0,
0,PATCH_END,0,
/*
0,PC_ENV_VOL,77,
0,PC_ENV_SPEED,9,
0,PC_WAVE,W_SQ50,
0,PC_TREMOLO_LEVEL,199,
0,PC_TREMOLO_RATE,101,
1,PC_PITCH,99,
1,PC_PITCH,93,
1,PC_PITCH,99,
1,PC_PITCH,93,
1,PC_PITCH,99,
1,PC_PITCH,93,
1,PC_PITCH,99,
1,PC_PITCH,93,
1,PC_PITCH,99,
1,PC_PITCH,93,


1,PC_PITCH,105,
1,PC_PITCH,93,
1,PC_PITCH,105,
1,PC_PITCH,93,

//0,PC_ENV_VOL,77,

0,PC_TREMOLO_LEVEL,100,
0,PC_TREMOLO_RATE,180,
//0,PC_ENV_SPEED,-5,
0,PC_WAVE,W_SIND1,
1,PC_PITCH,102,
1,PC_PITCH,96,
1,PC_PITCH,103,
1,PC_PITCH,97,
1,PC_PITCH,104,
1,PC_PITCH,98,
1,PC_PITCH,104,
1,PC_PITCH,98,
1,PC_PITCH,106,
1,PC_PITCH,99,
1,PC_PITCH,106,
1,PC_PITCH,98,
1,PC_PITCH,108,
1,PC_PITCH,100,
1,PC_PITCH,108,
1,PC_PITCH,100,




1,PC_TREMOLO_LEVEL,122,
0,PC_TREMOLO_RATE,34,
1,PC_PITCH,99,
1,PC_PITCH,93,
1,PC_PITCH,99,
1,PC_PITCH,93,

0,PC_TREMOLO_LEVEL,100,
0,PC_TREMOLO_RATE,180,
0,PC_ENV_SPEED,-2,
1,PC_PITCH,102,
1,PC_PITCH,96,
1,PC_PITCH,103,
1,PC_PITCH,97,
1,PC_PITCH,104,
1,PC_PITCH,98,
1,PC_PITCH,106,
1,PC_PITCH,99,
1,PC_PITCH,106,
1,PC_PITCH,98,
1,PC_PITCH,108,
1,PC_PITCH,100,
1,PC_PITCH,108,
1,PC_PITCH,100,



*/
1,PC_NOTE_CUT,0,
0,PATCH_END
};

const char SfxPatch24[] PROGMEM = {//player gets powerup sound 2 of 2
0,PC_ENV_VOL,65,//old 42
//0,PC_ENV_SPEED,4,
//0,PC_WAVE,W_SQ50,
0,PC_TREMOLO_LEVEL,199,
0,PC_TREMOLO_RATE,101/2,

1,PC_PITCH,53-4,
//1,PC_PITCH,57,
1,PC_PITCH,56-4,
//1,PC_PITCH,60,
1,PC_PITCH,59-4,
//1,PC_PITCH,63,
1,PC_PITCH,68-4,
//1,PC_PITCH,62,
1,PC_PITCH,66-4,
//1,PC_PITCH,71,
1,PC_PITCH,65-4,
//1,PC_PITCH,69,
1,PC_PITCH,74-4,
//1,PC_PITCH,68,
1,PC_PITCH,72-4,
//1,PC_PITCH,77,
1,PC_PITCH,71-4,
//1,PC_PITCH,75,
1,PC_PITCH,80-4,
//1,PC_PITCH,74,
1,PC_PITCH,78-4,
1,PC_PITCH,83-4,
1,PC_PITCH,77-4,
//1,PC_PITCH,81,
1,PC_PITCH,86-4,
//1,PC_PITCH,80,
1,PC_PITCH,84-4,
1,PC_PITCH,89-4,
1,PC_PITCH,83-4,
/*
1,PC_PITCH,87,
1,PC_PITCH,92,
1,PC_PITCH,85,
1,PC_PITCH,90,
1,PC_PITCH,95,
1,PC_PITCH,89,
1,PC_PITCH,94,
1,PC_PITCH,99,
1,PC_PITCH,92,
1,PC_PITCH,97,
1,PC_PITCH,102,
1,PC_PITCH,92,
1,PC_PITCH,97,
1,PC_PITCH,102,
*/

1,PC_PITCH,52-4,
1,PC_PITCH,57-4,
1,PC_PITCH,62-4,
1,PC_PITCH,66-4,
1,PC_PITCH,71-4,
0,PC_ENV_SPEED,-2,
1,PC_PITCH,76-4,
1,PC_PITCH,80-4,
1,PC_PITCH,85-4,
1,PC_PITCH,90-4,
1,PC_PITCH,95-4,
1,PC_PITCH,58-4,
1,PC_PITCH,63-4,
1,PC_PITCH,68-4,
1,PC_PITCH,72-4,
1,PC_PITCH,77-4,
1,PC_PITCH,82-4,
1,PC_PITCH,87-4,
1,PC_PITCH,92-4,
1,PC_PITCH,96-4,
1,PC_PITCH,101-4,
1,PC_PITCH,107-4,
1,PC_PITCH,112-4,
1,PC_PITCH,58-4,
1,PC_PITCH,63-4,
1,PC_PITCH,68-4,
1,PC_PITCH,72-4,
1,PC_PITCH,77-4,
1,PC_PITCH,82-4,
1,PC_PITCH,87-4,
1,PC_PITCH,92-4,
1,PC_PITCH,96-4,
1,PC_PITCH,101-4,
1,PC_PITCH,107-4,
1,PC_PITCH,112-4,
1,PC_PITCH,58-4,
1,PC_PITCH,63-4,
1,PC_PITCH,68-4,
1,PC_PITCH,72-4,
1,PC_PITCH,77-4,
1,PC_PITCH,82-4,
1,PC_PITCH,87-4,
1,PC_PITCH,92-4,
1,PC_PITCH,96-4,
1,PC_PITCH,101-4,
1,PC_PITCH,107-4,
1,PC_PITCH,112-4,
1,PC_PITCH,58-4,
1,PC_PITCH,63-4,
1,PC_PITCH,68-4,
1,PC_PITCH,72-4,
1,PC_PITCH,77-4,
1,PC_PITCH,82-4,
1,PC_PITCH,87-4,
1,PC_PITCH,92-4,
1,PC_PITCH,96-4,
1,PC_PITCH,101-4,
1,PC_PITCH,107-4,
1,PC_PITCH,112-4,
1,PC_PITCH,58-4,
1,PC_PITCH,63-4,
1,PC_PITCH,68-4,
1,PC_PITCH,72-4,
1,PC_PITCH,77-4,
1,PC_PITCH,82-4,
1,PC_PITCH,87-4,
1,PC_PITCH,92-4,
1,PC_PITCH,96-4,
1,PC_PITCH,101-4,
1,PC_PITCH,107-4,
1,PC_PITCH,112-4,
1,PC_PITCH,58-4,
1,PC_PITCH,63-4,
1,PC_PITCH,68-4,
1,PC_PITCH,72-4,
1,PC_PITCH,77-4,
1,PC_PITCH,82-4,
1,PC_PITCH,87-4,
1,PC_PITCH,92-4,
1,PC_PITCH,96-4,
1,PC_PITCH,101-4,
1,PC_PITCH,107-4,
1,PC_PITCH,112-4,


1,PC_NOTE_CUT,0,
0,PATCH_END,0,
};




#define SFX_FIRST_PATCH 16
#define SFX_DUMMY			0
#define SFX_BULLET			1
#define SFX_BULLET2			2//do not call directly
#define SFX_LASER			3
#define SFX_LASER2			4
#define SFX_POWERUP			5
#define SFX_POWERUP2			6//do not call directly
#define SFX_SUPER_ZAP			7
#define SFX_SUPER_ZAP2		8//do not call directly
#define SFX_CLAW_CAUGHT		9
#define SFX_CLAW_CAUGHT2		10//do not call directly
#define SFX_CLAW_EXPLODE		11
#define SFX_CLAW_EXPLODE2		12//do not call directly
#define SFX_CLAW_JUMP			13
#define SFX_WEB_ZOOM			14
#define SFX_WEB_ZOOM2			15//do not call directly

#define SFX_ENEMY_ZAP			16
#define SFX_ENEMY_EXPLODE		17
#define SFX_FLIPPER_FLIP		18
#define SFX_WEB_CLICK			19
#define SFX_TANKER_BREAK		20
#define SFX_PULSAR_APPROACH	21
#define SFX_SPIKE_SHOT		22
#define SFX_GET_POWERUP		23
#define SFX_GET_POWERUP2		24


//channel types
#define SFX_TYPE_NOT_USED	0
#define SFX_WAVE_PRIMARY	1
#define SFX_WAVE_SECONDARY	2
#define SFX_NOISE_TYPE	3
#define SFX_PCM_TYPE		4

//priorities
#define SFX_PRT_VERY_LO		0
#define SFX_PRT_LO			4
#define SFX_PRT_MED			8
#define SFX_PRT_HI			16
#define SFX_PRT_VERY_HI		32
#define SFX_PRT_ULTRA			64

const u8 sfx_params[] PROGMEM = {
//patch num						, channel			, priority			,note		,has 2 parts
SFX_FIRST_PATCH+0/*SFX_DUMMY*/			,SFX_WAVE_SECONDARY	,SFX_PRT_VERY_LO	,0		,	0,
SFX_FIRST_PATCH+1/*SFX_BULLET*/			,SFX_WAVE_SECONDARY	,SFX_PRT_LO		,0		,	1,
SFX_FIRST_PATCH+2/*SFX_BULLET2*/		,SFX_WAVE_PRIMARY	,SFX_PRT_VERY_LO	,0		,	0,
SFX_FIRST_PATCH+3/*SFX_LASER*/			,SFX_WAVE_SECONDARY	,SFX_PRT_LO		,0		,	1,
SFX_FIRST_PATCH+4/*SFX_LASER2*/			,SFX_WAVE_PRIMARY	,SFX_PRT_VERY_LO	,0		,	0,
SFX_FIRST_PATCH+5/*SFX_POWERUP*/		,SFX_WAVE_PRIMARY	,SFX_PRT_VERY_HI	,0		,	1,
SFX_FIRST_PATCH+6/*SFX_POWERUP2*/		,SFX_WAVE_SECONDARY	,SFX_PRT_LO		,0		,	0,
SFX_FIRST_PATCH+7/*SFX_SUPER_ZAP*/		,SFX_WAVE_PRIMARY	,SFX_PRT_HI		,0		,	1,
SFX_FIRST_PATCH+8/*SFX_SUPER_ZAP2*/		,SFX_NOISE_TYPE		,SFX_PRT_MED		,0		,	0,
SFX_FIRST_PATCH+9/*SFX_CLAW_CAUGHT*/		,SFX_WAVE_PRIMARY	,SFX_PRT_ULTRA		,0		,	1,
SFX_FIRST_PATCH+10/*SFX_CLAW_CAUGHT2*/	,SFX_WAVE_SECONDARY	,SFX_PRT_ULTRA		,0		,	0,
SFX_FIRST_PATCH+11/*SFX_CLAW_EXPLODE*/	,SFX_WAVE_PRIMARY	,SFX_PRT_ULTRA		,0		,	1,
SFX_FIRST_PATCH+12/*SFX_CLAW_EXPLODE2*/	,SFX_WAVE_SECONDARY	,SFX_PRT_ULTRA		,0		,	0,
SFX_FIRST_PATCH+13/*SFX_CLAW_JUMP*/		,SFX_WAVE_PRIMARY	,SFX_PRT_HI		,0		,	0,
SFX_FIRST_PATCH+14/*SFX_WEB_ZOOM*/		,SFX_WAVE_PRIMARY	,SFX_PRT_ULTRA		,0		,	1,
SFX_FIRST_PATCH+15/*SFX_WEB_ZOOM2*/		,SFX_WAVE_SECONDARY	,SFX_PRT_ULTRA		,0		,	0,

SFX_FIRST_PATCH+16/*SFX_ENEMY_ZAP*/		,SFX_WAVE_PRIMARY	,SFX_PRT_VERY_HI	,0		,	0,
SFX_FIRST_PATCH+17/*SFX_ENEMY_EXPLODE*/	,SFX_NOISE_TYPE		,SFX_PRT_HI		,0		,	0,
SFX_FIRST_PATCH+18/*SFX_FLIPPER_FLIP*/	,SFX_WAVE_PRIMARY	,SFX_PRT_MED		,0		,	0,
SFX_FIRST_PATCH+19/*SFX_WEB_CLICK*/		,SFX_WAVE_PRIMARY	,SFX_PRT_MED		,0		,	0,
SFX_FIRST_PATCH+20/*SFX_TANKER_BREAK*/	,SFX_NOISE_TYPE		,SFX_PRT_MED		,0		,	0,
SFX_FIRST_PATCH+21/*SFX_PULSAR_APPROACH*/	,SFX_WAVE_PRIMARY	,SFX_PRT_HI		,0		,	0,
SFX_FIRST_PATCH+22/*SFX_SPIKE_SHOT*/		,SFX_WAVE_PRIMARY	,SFX_PRT_MED		,0		,	0,
SFX_FIRST_PATCH+23/*SFX_GET_POWERUP*/		,SFX_WAVE_PRIMARY	,SFX_PRT_VERY_HI	,0		,	1,
SFX_FIRST_PATCH+24/*SFX_GET_POWERUP2*/	,SFX_WAVE_SECONDARY	,SFX_PRT_LO		,0		,	0,
};


const struct PatchStruct patches[] PROGMEM = {
{0,NULL,inst1,0,0},
{1,NULL,basedrum,0,0},
{1,NULL,hihat,0,0},
{1,NULL,hithat_open,0,0},
{1,NULL,crash_cymbal,0,0},
{0,NULL,inst6,0,0},
{0,NULL,inst7,0,0},
{0,NULL,inst8,0,0},
{0,NULL,inst9,0,0},
{0,NULL,inst10,0,0},
{2,play,inst11,sizeof_play-1,sizeof_play}, //play sample
{0,NULL,inst12,0,0},
{2,waves+(256*W_HOLLOW),inst13,0,256}, //13
{0,NULL,inst14,0,0}, //14
{2,waves+(256*W_SQ50),inst15,0,256}, //15
{2,waves+(256*W_SAW),inst16,0,256}, //16


{0,NULL,SfxPatch0,0,0},//dummy
{0,NULL,SfxPatch1,0,0},//bullet
{2,waves+(256*W_HOLLOW),SfxPatch2,0,256},//bullet 2
{2,waves+(256*W_SQ75),SfxPatch3,0,256},//laser
{0,NULL,SfxPatch4,0,0},//laser2
{0,NULL,SfxPatch5,0,0},//power up appears
{2,waves+(256*W_SAW),SfxPatch6,0,256},////{0,NULL,patch18,0,0},//power up2
{0,NULL,SfxPatch7,0,0},//super zapper
{1,NULL,SfxPatch8,0,0},//super zapper2
{0,NULL,SfxPatch9,0,0},//player caught
{2,waves+(256*W_SQ75),SfxPatch10,0,256},//player caught2
{0,NULL,SfxPatch11,0,0},//player explode
{1,NULL,SfxPatch12,0,0},//player explode2
{0,NULL,SfxPatch13,0,0},//player jump
{0,NULL,SfxPatch14,0,0},//web zoom in
{2,waves+(256*W_TRI),SfxPatch15,0,256},//web zoom in2
{0,NULL,SfxPatch16,0,0},//enemy zap
{1,NULL,SfxPatch17,0,0},//enemy explode
{0,NULL,SfxPatch18,0,0},//enemy flip
{0,NULL,SfxPatch19,0,0},//web click
{1,NULL,SfxPatch20,0,0},//tanker break
{0,NULL,SfxPatch21,0,0},//pulsar approach
{0,NULL,SfxPatch22,0,0},//spike shot
{0,NULL,SfxPatch23,0,0},//player gets powerup
{2,waves+(256*W_SAW),SfxPatch24,0,256},//player gets powerup2

};

#endif /* PATCHES_INC_ */
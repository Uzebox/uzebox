/*
Uzebox module v1.0
File: C:\work\uzebox\trunk\demos\MusicDemo_Tempest2000\data\intro.inc
Data size:1660
*/
const char intro[] __attribute__ ((section (".freeflash"))) = {
0x07,0x05,0x2f,0x10,0x0a,0x18,0x00,0x00,0x01,0x02,0x03,0x04,0x05,0x06,0x07,0x08,0x09,0x00,0x0a,0x0b,0x08,0x09,0x09,0x0c,0x0d,0x0e,0x0f,0x00,0x01,0x02,0x03,0x10,
0x05,0x06,0x07,0x08,0x11,0x00,0x0a,0x0b,0x08,0x12,0x13,0x0c,0x0d,0x0e,0x14,0x15,0x16,0x17,0x03,0x18,0x19,0x1a,0x1b,0x08,0x1c,0x15,0x1d,0x1e,0x08,0x1f,0x09,0x20,
0x21,0x0e,0x22,0x00,0x01,0x02,0x03,0x10,0x05,0x06,0x07,0x08,0x11,0x00,0x0a,0x0b,0x08,0x12,0x13,0x0c,0x0d,0x0e,0x14,0x23,0x24,0x25,0x26,0x27,0x09,0x28,0x29,0x08,
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0x00,0x00,0x00,0x00,0x00,0x00,0x00,0x00,0x00,0xb3,0x6e,0x19,0x00,0xae,0x6e,0x19,0xae,0x6e,0x19,0xaa,0x6e,0x19,0xb0,0x6e,0x19,0xb0,0x6e,0x19 
};

/*
 * fonts.c
 *
 *  Created on: 11/06/2014
 *      Author: Cunning Fellow
 */

#include <stdbool.h>
#include <avr/io.h>
#include <stdlib.h>
#include <stddef.h>
#include <uzebox.h>
#include <kernel.h>
#include <sdSimple.h>

#include "fonts.h"
#include "housekeeping.h"
#include "highscores.h"
#include "t2k.h"

#define strptr(x) (char*)pgm_read_word(&StringPointers[ x ])

#define TM(ascii) (ascii - 55)
#define GM(ascii) ((ascii - 54)<<1)
#define SPACE 0x24

const char  String00[]    __attribute__ ((section (".freeflash3"))) =  {0};
const char  String01[]    __attribute__ ((section (".freeflash3"))) =  {TM('P'), TM('A'), TM('R'), TM('T'), TM('I'), TM('C'), TM('L'), TM('E'), TM('['), TM('L'), TM('A'), TM('S'), TM('E'), TM('R') ,0}; // "PARTICLE LASER\0";
const char  String02[]    __attribute__ ((section (".freeflash3"))) =  {TM('J'), TM('U'), TM('M'), TM('P'), TM('['), TM('E'), TM('N'), TM('A'), TM('B'), TM('L'), TM('E'), TM('D'),0}; //" JUMP ENABLED\0";
const char  String03[]    __attribute__ ((section (".freeflash3"))) =  {TM('['), TM('['), TM('['), TM('A'), TM('I'), TM('['), TM('D'), TM('R'), TM('O'), TM('I'), TM('D'),0};    //"   AI DROID\0";
const char  String04[]    __attribute__ ((section (".freeflash3"))) =  {TM('['), TM('['), TM('E'), TM('X'), TM('C'), TM('E'), TM('L'), TM('L'), TM('E'), TM('N'), TM('T'),0};    //"  EXCELLENT\0";
const char  String05[]    __attribute__ ((section (".freeflash3"))) =  {TM('['), TM('['), TM('['), TM('['), TM('Z'), TM('A'), TM('P'), TM('P'), TM('O'), 0};      //"    ZAPPO\0";
const char  String06[]    __attribute__ ((section (".freeflash3"))) =  {TM('['), TM('['), TM('O'), TM('U'), TM('T'), TM('T'), TM('A'), TM('['), TM('H'), TM('E'), TM('R'), TM('E'), 0};   //"  OUTTA HERE\0";
const char  String07[]    __attribute__ ((section (".freeflash3"))) =  {TM('['), TM('['), TM('G'), TM('A'), TM('M'), TM('E'), TM('['), TM('O'), TM('V'), TM('E'), TM('R'), 0};    //"  GAME OVER\0";

const char  String08[]    __attribute__ ((section (".freeflash3"))) =  {TM('['), TM('['), TM('['), TM('P'), TM('A'), TM('U'), TM('S'), TM('E'), TM('D'), 0};    //"   PAUSED\0";


const char  String09[]    __attribute__ ((section (".freeflash3"))) =  {TM('L'), TM('E'), TM('V'), TM('E'), TM('L'), TM('['), TM('F'), TM('I'), TM('L'), TM('E'), TM('['), TM('N'), TM('O'), TM('T'), TM('['), TM('F'), TM('O'), TM('U'), TM('N'), TM('D'), TM('['), TM('O'), TM('N'), TM('['), TM('S'), TM('D'), TM('['), TM('C'), TM('A'), TM('R'), TM('D'), 0}; //"LEVEL[FILE[NOT[FOUND[ON[SD[CARD\0";
const char  String10[]    __attribute__ ((section (".freeflash3"))) =  {TM('E'), TM('E'), TM('P'), TM('R'), TM('O'), TM('M'), TM('['), TM('E'), TM('R'), TM('R'), TM('O'), TM('R'), 0};    //"[EEPROM[ERROR\0";
const char  String11[]    __attribute__ ((section (".freeflash3"))) =  {GM('T'), GM('O'), GM('P'), GM('['), GM('Z'), GM('A'), GM('P'), GM('P'), GM('E'), GM('R'), GM('S'), 0};
const char  String12[]    __attribute__ ((section (".freeflash3"))) =  {GM('E'), GM('N'), GM('T'), GM('E'), GM('R'), GM('['), GM('I'), GM('N'), GM('I'), GM('T'), GM('I'), GM('A'), GM('L'), GM('S'), 0};

const char  String13[]    __attribute__ ((section (".freeflash3"))) =  {GM('D'), GM('O'), GM('M'), GM('I'), GM('N'), GM('A'), GM('T'), GM('I'), GM('O'), GM('N'), 0};
const char  String14[]    __attribute__ ((section (".freeflash3"))) =  {GM('C'), GM('O'), GM('L'), GM('L'), GM('E'), GM('C'), GM('T'), GM('O'), GM('R'), 0};
const char  String15[]    __attribute__ ((section (".freeflash3"))) =  {GM('Z'), GM('A'), GM('P'), GM('P'), GM('E'), GM('R'), 0};
const char  String16[]    __attribute__ ((section (".freeflash3"))) =  {GM('T'), GM('O'), GM('T'), GM('A'), GM('L'), 0};
const char  String17[]    __attribute__ ((section (".freeflash3"))) =  {GM('B'), GM('O'), GM('N'), GM('U'), GM('S'), 0};


const char* const StringPointers[] __attribute__ ((section (".freeflash"))) = {
String00,
String01,
String02,
String03,
String04,
String05,
String06,
String07,
String08,
String09,
String10,
String11,
String12,
String13,
String14,
String15,
String16,
String17
};


uint8_t printText(uint8_t msgNo, uint16_t pos){

	char *stringAddress;
	uint8_t c;
	uint8_t i = 0;

	stringAddress = strptr(msgNo);

	c = (uint8_t)pgm_read_byte(stringAddress++);

	while (c!=0) {
		i++;
		vram[pos++] = c ;
		c = (uint8_t)pgm_read_byte(stringAddress++);
	}

	return(i);
}

void message(uint8_t msgNo, uint16_t pos){
	uint8_t i;

	i = printText(msgNo, pos);

	while (i < MESSAGE_IN_STATUS_BAR_LENGTH) {
		vram[pos+i] = SPACE;
		i++;
	}

	messageCounter = MESSAGE_COUNTER_MAX;
}

void showRamTileCounts(void){
	static uint8_t hiRamTile = 0;

	vram[30] = (nextFreeRamTile >> 4);
	vram[31] = (nextFreeRamTile & 0x0F);

	if (nextFreeRamTile > hiRamTile) hiRamTile = nextFreeRamTile;

	vram[62] = (hiRamTile >> 4);
	vram[63] = (hiRamTile & 0x0F);
}

const uint8_t FontTable[]  PROGMEM = { // __attribute__ ((section (".freeflash"))) = {
0x3E, 0x22, 0x22, 0x22, 0x22, 0x22, 0x3E, 0x00, // 0x00 0
0x08, 0x08, 0x08, 0x08, 0x08, 0x08, 0x08, 0x00, // 0x01 1
0x3E, 0x02, 0x02, 0x3E, 0x20, 0x20, 0x3E, 0x00, // 0x02 2
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0x00, 0x00, 0x00, 0x00, 0x00, 0x00, 0x7F, 0x00  // 0x3F Underscore

};


void readSDBytes2(uint8_t *dest, uint16_t count, uint8_t span, uint8_t run)
{
	uint8_t thisRun = run;

	while(count != 0) {
		*dest++ = sdCardGetByte();
		thisRun--;
		if (thisRun == 0) {
			thisRun = run;
			dest += span;
		}
		count--;
	}
}

uint16_t j = (16 * 32) - 2;

void readSDBytes(uint8_t *dest, uint16_t count, long startAddress){
	long sectorData;

/*
	uint8_t bob[2][16];

	uint16_t i=0;

	for(i=0; i<16;i++) {
		bob[0][i] = 0;
		bob[1][i] = 0;
	}
*/
	SetHsyncCallback(&BlankingCallback);

	SDCardVideoModeDisable();
	waitNFrames(1);

	sectorData = sectorStart + startAddress;

	sdCardStopTransmission();
	sdCardStopTransmission();
	sdCardStopTransmission();
	sdCardCueSectorAddress(sectorData);
	sdDirectRead(dest, count, 0,1);
/*
	for(i=0; i<16;i++) {
		bob[0][i] = dest[i+j];
	}
*/
/*
	mmc_stoptransmission();
	mmc_stoptransmission();
	mmc_stoptransmission();
	mmc_cuesector(sectorData);
	readSDBytes2(dest, count, 0,1);
*/
/*
	for(i=0; i<16;i++) {
		bob[1][i] = dest[i+j];
	}

	for(i=0; i<16;i++) {
		printhexx(0+i, bob[0][i]);
		printhexx(16+i, bob[1][i]);
	}

	while(1);
*/
/*
	for(i = 0; i < count;){
		*dest++ = mmc_get_byte();
		i++;
	}
*/

//	readSDBytes2( &vram[64], 21, 31,1);
//	mmcDirectRead(&vram[65], 21, 31,1);


	SDCardVideoModeEnable();

}

void blitFont(void){

	uint8_t charNo;
	uint8_t row;
	uint8_t byteRead, byte1, byte2;

	for (charNo = 0; charNo < FONT_TEXT_NUM_TILES; charNo++){
		for (row = 0; row < 8; row++){
			byte1 = 0xFF;
			byte2 = 0xFF;
			byteRead = pgm_read_byte(&FontTable[(charNo<<3)+row]);
			if((byteRead & 0b00000001) != 0) { byte1 &= 0b00111111; }
			if((byteRead & 0b00000010) != 0) { byte1 &= 0b11001111; }
			if((byteRead & 0b00000100) != 0) { byte1 &= 0b11110011; }
			if((byteRead & 0b00001000) != 0) { byte1 &= 0b11111100; }
			if((byteRead & 0b00010000) != 0) { byte2 &= 0b00111111; }
			if((byteRead & 0b00100000) != 0) { byte2 &= 0b11001111; }
			if((byteRead & 0b01000000) != 0) { byte2 &= 0b11110011; }
			if((byteRead & 0b10000000) != 0) { byte2 &= 0b11111100; }
			ramTiles[0x02 + (charNo<<1) + (row<<8) + 0] = byte2;
			ramTiles[0x02 + (charNo<<1) + (row<<8) + 1] = byte1;
		}
	}
}





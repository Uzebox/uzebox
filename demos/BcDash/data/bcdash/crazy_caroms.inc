//*********************************//
// MIDI file: crazy_caroms.inc
//*********************************//
const char crazy_caroms_song[] PROGMEM ={
0x00,0xff,0x06,0x01,0x53,0x00,0xc0,0x06,0x00,0xb0,0x07,0x54,0x00,0x5c,0x01,0x00,0xc1,0x05,0x00,0xb1,0x07,0x50,0x00,0xc2,0x09,0x00,0xb2,0x07,0x66,0x00,0xc3,0x00,
0x00,0xb3,0x07,0x26,0x01,0xc0,0x06,0x00,0x90,0x24,0x7f,0x00,0xc2,0x09,0x00,0x92,0x30,0x7f,0x00,0x93,0x02,0x5e,0x08,0xc1,0x05,0x0d,0x90,0x30,0x7f,0x16,0x24,0x7f,
0x0e,0x2e,0x7f,0x16,0x2e,0x7f,0x07,0x24,0x7f,0x01,0x93,0x02,0x5e,0x0d,0x90,0x30,0x7f,0x08,0x24,0x7f,0x0e,0x2e,0x7f,0x16,0x24,0x7f,0x07,0x26,0x7f,0x0e,0x27,0x7f,
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0x2f,0x00 };


#define mapEgg_Width   (1)
#define mapEgg_Height  (1)

const char mapEgg[1 * 1 + 2] PROGMEM =
{mapEgg_Width,mapEgg_Height,
    28
};

#define mapIcicle_Width   (1)
#define mapIcicle_Height  (1)

const char mapIcicle[1 * 1 + 2] PROGMEM =
{mapIcicle_Width,mapIcicle_Height,
    21
};

#define mapStar_Width   (1)
#define mapStar_Height  (1)

const char mapStar[1 * 1 + 2] PROGMEM=
{mapStar_Width,mapStar_Height,
    2
};

#define mapLogBridge_Width   (1)
#define mapLogBridge_Height  (2)

const char mapLogBridge[1 * 2 + 2] PROGMEM=
{mapLogBridge_Width,mapLogBridge_Height,
    5,
    6
};

#define mapGndMid0_Width   (2)
#define mapGndMid0_Height  (2)

const char mapGndMid0[2 * 2 + 2] PROGMEM=
{mapGndMid0_Width,mapGndMid0_Height,
    7,  8,
    9, 10
};

#define mapGndMid1_Width   (2)
#define mapGndMid1_Height  (2)

const char mapGndMid1[2 * 2 + 2] PROGMEM=
{mapGndMid1_Width,mapGndMid1_Height,
    9, 10,
    7,  8
};

#define mapGndMid2_Width   (2)
#define mapGndMid2_Height  (2)

const char mapGndMid2[2 * 2 + 2] PROGMEM=
{mapGndMid2_Width,mapGndMid2_Height,
    8,  7,
   10,  9
};

#define mapGndMid3_Width   (2)
#define mapGndMid3_Height  (2)

const char mapGndMid3[2 * 2 + 2] PROGMEM=
{mapGndMid3_Width,mapGndMid3_Height,
   10,  9,
    8,  7
};

#define mapGrassLt_Width   (1)
#define mapGrassLt_Height  (2)

const char mapGrassLt[1 * 2 + 2] PROGMEM=
{mapGrassLt_Width,mapGrassLt_Height,
   11,
   12
};

#define mapGrassRt_Width   (1)
#define mapGrassRt_Height  (2)

const char mapGrassRt[1 * 2 + 2] PROGMEM=
{mapGrassRt_Width,mapGrassRt_Height,
   13,
   14
};

#define mapGrassMid_Width   (2)
#define mapGrassMid_Height  (1)

const char mapGrassMid[2 * 1 + 2] PROGMEM=
{mapGrassMid_Width,mapGrassMid_Height,
   15, 16
};

#define mapGndBtm_Width   (2)
#define mapGndBtm_Height  (1)

const char mapGndBtm[2 * 1 + 2] PROGMEM=
{mapGndBtm_Width,mapGndBtm_Height,
   17, 18
};

#define mapGndBtmLt_Width   (1)
#define mapGndBtmLt_Height  (2)

const char mapGndBtmLt[1 * 2 + 2] PROGMEM=
{mapGndBtmLt_Width,mapGndBtmLt_Height,
   19,
   12
};

#define mapGndBtmRt_Width   (1)
#define mapGndBtmRt_Height  (2)

const char mapGndBtmRt[1 * 2 + 2] PROGMEM=
{mapGndBtmRt_Width,mapGndBtmRt_Height,
   20,
   14
};

#define mapGndBtmGrp0_Width   (2)
#define mapGndBtmGrp0_Height  (2)

const char mapGndBtmGrp0[2 * 2 + 2] PROGMEM=
{mapGndBtmGrp0_Width,mapGndBtmGrp0_Height,
    7,  8,
   17, 18
};

#define mapGndBtmGrp1_Width   (2)
#define mapGndBtmGrp1_Height  (2)

const char mapGndBtmGrp1[2 * 2 + 2] PROGMEM=
{mapGndBtmGrp1_Width,mapGndBtmGrp1_Height,
    9, 10,
   17, 18
};

#define mapGndBtmGrp2_Width   (2)
#define mapGndBtmGrp2_Height  (2)

const char mapGndBtmGrp2[2 * 2 + 2] PROGMEM=
{mapGndBtmGrp2_Width,mapGndBtmGrp2_Height,
    8,  7,
   17, 18
};

#define mapGndBtmGrp3_Width   (2)
#define mapGndBtmGrp3_Height  (2)

const char mapGndBtmGrp3[2 * 2 + 2] PROGMEM=
{mapGndBtmGrp3_Width,mapGndBtmGrp3_Height,
   10,  9,
   17, 18
};

#define mapPlant_Width   (2)
#define mapPlant_Height  (1)

const char mapPlant[2 * 1 + 2] PROGMEM=
{mapPlant_Width,mapPlant_Height,
   24, 25
};

#define mapPupLedge_Width   (2)
#define mapPupLedge_Height  (1)

const char mapPupLedge[2 * 1 + 2] PROGMEM=
{mapPupLedge_Width,mapPupLedge_Height,
   26, 27
};

#define mapGndPlat_Width   (4)
#define mapGndPlat_Height  (2)

const char mapGndPlat[4 * 2 + 2] PROGMEM=
{mapGndPlat_Width,mapGndPlat_Height,
   11, 15, 16, 13,
   12, 17, 18, 14
};

#define mapHourGlass_Width   (2)
#define mapHourGlass_Height  (2)

const char mapHourGlass[2 * 2 + 2] PROGMEM=
{mapHourGlass_Width,mapHourGlass_Height,
   30, 31,
   32, 33
};

#define mapBoots_Width   (2)
#define mapBoots_Height  (1)

const char mapBoots[2 * 1 + 2] PROGMEM=
{mapBoots_Width,mapBoots_Height,
   34, 35
};

#define mapBootsWater_Width   (2)
#define mapBootsWater_Height  (1)

const char mapBootsWater[2 * 1 + 2] PROGMEM=
{mapBootsWater_Width,mapBootsWater_Height,
   36, 37
};

#define mapPsn_Width   (2)
#define mapPsn_Height  (2)

const char mapPsn[2 * 2 + 2] PROGMEM=
{mapPsn_Width,mapPsn_Height,
   38, 39,
   40, 41
};

#define mapPsnWater_Width   (2)
#define mapPsnWater_Height  (2)

const char mapPsnWater[2 * 2 + 2] PROGMEM=
{mapPsnWater_Width,mapPsnWater_Height,
   42, 43,
   44, 45
};

#define mapBomb_Width   (2)
#define mapBomb_Height  (2)

const char mapBomb[2 * 2 + 2] PROGMEM=
{mapBomb_Width,mapBomb_Height,
   46, 47,
   48, 49
};

#define mapBuddha_Width   (2)
#define mapBuddha_Height  (2)

const char mapBuddha[2 * 2 + 2] PROGMEM=
{mapBuddha_Width,mapBuddha_Height,
   50, 51,
   52, 53
};

#define mapFlower_Width   (2)
#define mapFlower_Height  (2)

const char mapFlower[2 * 2 + 2] PROGMEM=
{mapFlower_Width,mapFlower_Height,
   54, 55,
   56, 57
};

#define mapPogo_Width   (1)
#define mapPogo_Height  (2)

const char mapPogo[1 * 2 + 2] PROGMEM=
{mapPogo_Width,mapPogo_Height,
   58,
   59
};

#define mapCloud_Width   (3)
#define mapCloud_Height  (2)

const char mapCloud[3 * 2 + 2] PROGMEM=
{mapCloud_Width,mapCloud_Height,
   60, 61, 62,
   63, 64, 65
};

#define mapIceBtmLt_Width   (1)
#define mapIceBtmLt_Height  (2)

const char mapIceBtmLt[1 * 2 + 2] PROGMEM=
{mapIceBtmLt_Width,mapIceBtmLt_Height,
   66,
   67
};

#define mapIceBtmRt_Width   (1)
#define mapIceBtmRt_Height  (2)

const char mapIceBtmRt[1 * 2 + 2] PROGMEM=
{mapIceBtmRt_Width,mapIceBtmRt_Height,
   68,
   69
};

#define mapSnowLt_Width   (1)
#define mapSnowLt_Height  (2)

const char mapSnowLt[1 * 2 + 2] PROGMEM=
{mapSnowLt_Width,mapSnowLt_Height,
   70,
   71
};

#define mapSnowRt_Width   (1)
#define mapSnowRt_Height  (2)

const char mapSnowRt[1 * 2 + 2] PROGMEM=
{mapSnowRt_Width,mapSnowRt_Height,
   72,
   73
};

#define mapSnowMid_Width   (2)
#define mapSnowMid_Height  (1)

const char mapSnowMid[2 * 1 + 2] PROGMEM=
{mapSnowMid_Width,mapSnowMid_Height,
   74, 75
};

#define mapIceBtm_Width   (2)
#define mapIceBtm_Height  (1)

const char mapIceBtm[2 * 1 + 2] PROGMEM=
{mapIceBtm_Width,mapIceBtm_Height,
   76, 77
};

#define mapIceBtmGrp_Width   (2)
#define mapIceBtmGrp_Height  (2)

const char mapIceBtmGrp[2 * 2 + 2] PROGMEM=
{mapIceBtmGrp_Width,mapIceBtmGrp_Height,
   22, 22,
   76, 77
};

#define mapSnowPlat_Width   (4)
#define mapSnowPlat_Height  (2)

const char mapSnowPlat[4 * 2 + 2] PROGMEM=
{mapSnowPlat_Width,mapSnowPlat_Height,
   70, 74, 75, 72,
   71, 76, 77, 73
};

#define mapMoon_Width   (2)
#define mapMoon_Height  (2)

const char mapMoon[2 * 2 + 2] PROGMEM=
{mapMoon_Width,mapMoon_Height,
   78, 79,
   80, 81
};

#define mapFont_Width   (12)
#define mapFont_Height  (1)

const char mapFont[12 * 1 + 2] PROGMEM=
{mapFont_Width,mapFont_Height,
   82, 83, 84, 85, 86, 87, 88, 89, 90, 91, 92, 93
};

#define mapMushroom_Width   (6)
#define mapMushroom_Height  (2)

const char mapMushroom[6 * 2 + 2] PROGMEM=
{mapMushroom_Width,mapMushroom_Height,
   94, 95, 96, 97, 98, 99,
    0,100,101,102,  0,  0
};

#define mapGndTopLtWater_Width   (1)
#define mapGndTopLtWater_Height  (2)

const char mapGndTopLtWater[1 * 2 + 2] PROGMEM=
{mapGndTopLtWater_Width,mapGndTopLtWater_Height,
  103,
  104
};

#define mapGndTopRtWater_Width   (1)
#define mapGndTopRtWater_Height  (2)

const char mapGndTopRtWater[1 * 2 + 2] PROGMEM=
{mapGndTopRtWater_Width,mapGndTopRtWater_Height,
  105,
  106
};

#define mapGndBtmLtWater_Width   (1)
#define mapGndBtmLtWater_Height  (2)

const char mapGndBtmLtWater[1 * 2 + 2] PROGMEM=
{mapGndBtmLtWater_Width,mapGndBtmLtWater_Height,
   26,
  107
};

#define mapGndBtmRtWater_Width   (1)
#define mapGndBtmRtWater_Height  (2)

const char mapGndBtmRtWater[1 * 2 + 2] PROGMEM=
{mapGndBtmRtWater_Width,mapGndBtmRtWater_Height,
   27,
  108
};

#define mapGndBtmWater_Width   (2)
#define mapGndBtmWater_Height  (1)

const char mapGndBtmWater[2 * 1 + 2] PROGMEM=
{mapGndBtmWater_Width,mapGndBtmWater_Height,
  109,110
};

#define mapGndConeTopWater_Width   (2)
#define mapGndConeTopWater_Height  (2)

const char mapGndConeTopWater[2 * 2 + 2] PROGMEM=
{mapGndConeTopWater_Width,mapGndConeTopWater_Height,
  103,105,
  104,106
};

#define mapGndConeBtmWater_Width   (2)
#define mapGndConeBtmWater_Height  (2)

const char mapGndConeBtmWater[2 * 2 + 2] PROGMEM=
{mapGndConeBtmWater_Width,mapGndConeBtmWater_Height,
   26, 27,
  107,108
};

#define mapGndBtmWaterGrp0_Width   (2)
#define mapGndBtmWaterGrp0_Height  (2)

const char mapGndBtmWaterGrp0[2 * 2 + 2] PROGMEM=
{mapGndBtmWaterGrp0_Width,mapGndBtmWaterGrp0_Height,
    7,  8,
  109,110
};

#define mapGndBtmWaterGrp1_Width   (2)
#define mapGndBtmWaterGrp1_Height  (2)

const char mapGndBtmWaterGrp1[2 * 2 + 2] PROGMEM=
{mapGndBtmWaterGrp1_Width,mapGndBtmWaterGrp1_Height,
    9, 10,
  109,110
};

#define mapGndBtmWaterGrp2_Width   (2)
#define mapGndBtmWaterGrp2_Height  (2)

const char mapGndBtmWaterGrp2[2 * 2 + 2] PROGMEM=
{mapGndBtmWaterGrp2_Width,mapGndBtmWaterGrp2_Height,
    8,  7,
  109,110
};

#define mapGndBtmWaterGrp3_Width   (2)
#define mapGndBtmWaterGrp3_Height  (2)

const char mapGndBtmWaterGrp3[2 * 2 + 2] PROGMEM=
{mapGndBtmWaterGrp3_Width,mapGndBtmWaterGrp3_Height,
   10,  9,
  109,110
};

#define mapExplosion_Width   (3)
#define mapExplosion_Height  (3)

const char mapExplosion[3 * 3 + 2] PROGMEM=
{mapExplosion_Width,mapExplosion_Height,
  111,112,113,
  112,112,112,
  114,112,115
};

#define mapGndWaterPikeDn_Width   (3)
#define mapGndWaterPikeDn_Height  (3)

const char mapGndWaterPikeDn[3 * 3 + 2] PROGMEM=
{mapGndWaterPikeDn_Width,mapGndWaterPikeDn_Height,
    7,  8,  7,
   26, 10, 27,
  107,  8,108
};

#define mapGndWaterPikeUp_Width   (3)
#define mapGndWaterPikeUp_Height  (3)

const char mapGndWaterPikeUp[3 * 3 + 2] PROGMEM=
{mapGndWaterPikeUp_Width,mapGndWaterPikeUp_Height,
  103,  8,105,
  104, 10,106,
    7,  8,  7
};

#define mapDashD_Width   (4)
#define mapDashD_Height  (6)

const char mapDashD[4 * 6 + 2] PROGMEM=
{mapDashD_Width,mapDashD_Height,
   74, 75, 74,  0,
   22,  0,  0, 75,
   22,  0,  0, 22,
   22, 46, 47, 22,
   22, 48, 49, 77,
   77, 76, 77,  0
};

#define mapDashA_Width   (4)
#define mapDashA_Height  (6)

const char mapDashA[4 * 6 + 2] PROGMEM=
{mapDashA_Width,mapDashA_Height,
    0, 74, 75,  0,
   75,  0,  0, 74,
   22, 34, 35, 22,
   22, 22, 22, 22,
   22,  0,  0, 22,
   77,  0,  0, 76
};

#define mapDashS_Width   (4)
#define mapDashS_Height  (6)

const char mapDashS[4 * 6 + 2] PROGMEM=
{mapDashS_Width,mapDashS_Height,
    0, 74, 75, 59,
   77,  0,  0, 74,
    0, 77,  0,  0,
    0,  0, 77,  0,
   77,  3,  0, 77,
    0, 77, 76,  0
};

#define mapDashH_Width   (4)
#define mapDashH_Height  (6)

const char mapDashH[4 * 6 + 2] PROGMEM=
{mapDashH_Width,mapDashH_Height,
   74,  0,  0, 75,
   22, 38, 39, 22,
   22, 40, 41, 22,
   22, 74, 75, 22,
   22,  0,  0, 22,
   76,  0,  0, 77
};

#define mapBFront_Width   (2)
#define mapBFront_Height  (11)

const char mapBFront[2 * 11 + 2] PROGMEM=
{mapBFront_Width,mapBFront_Height,
   13,  0,
    7, 13,
    9, 10,
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   18, 14
};

#define mapDucats_Width   (6)
#define mapDucats_Height  (1)

const char mapDucats[6 * 1 + 2] PROGMEM=
{mapDucats_Width,mapDucats_Height,
  170,187,169,167,186,185
};

#define mapStitchInTime_Width   (11)
#define mapStitchInTime_Height  (1)

const char mapStitchInTime[11 * 1 + 2] PROGMEM=
{mapStitchInTime_Width,mapStitchInTime_Height,
  185,186,175,186,169,174,  0,175,180,  0,  3
};

#define mapSpeedy_Width   (6)
#define mapSpeedy_Height  (1)

const char mapSpeedy[6 * 1 + 2] PROGMEM=
{mapSpeedy_Width,mapSpeedy_Height,
  185,182,171,171,170,191
};

#define mapDfly_Width   (9)
#define mapDfly_Height  (1)

const char mapDfly[9 * 1 + 2] PROGMEM=
{mapDfly_Width,mapDfly_Height,
  170,184,167,173,181,180,172,178,191
};

#define mapFloat_Width   (5)
#define mapFloat_Height  (1)

const char mapFloat[5 * 1 + 2] PROGMEM=
{mapFloat_Width,mapFloat_Height,
  172,178,181,167,186
};

#define mapLeap_Width   (4)
#define mapLeap_Height  (1)

const char mapLeap[4 * 1 + 2] PROGMEM=
{mapLeap_Width,mapLeap_Height,
  178,171,167,182
};

#define mapKaboom_Width   (6)
#define mapKaboom_Height  (1)

const char mapKaboom[6 * 1 + 2] PROGMEM=
{mapKaboom_Width,mapKaboom_Height,
  177,167,168,181,181,179
};

#define mapPoison_Width   (6)
#define mapPoison_Height  (1)

const char mapPoison[6 * 1 + 2] PROGMEM=
{mapPoison_Width,mapPoison_Height,
  182,181,175,185,181,180
};

#define mapTimeFlies_Width   (7)
#define mapTimeFlies_Height  (1)

const char mapTimeFlies[7 * 1 + 2] PROGMEM=
{mapTimeFlies_Width,mapTimeFlies_Height,
    3,  0,172,178,175,171,185
};

#define mapMovingPlatformStepped_Width   (1)
#define mapMovingPlatformStepped_Height  (1)

const char mapMovingPlatformStepped[1 * 1 + 2] PROGMEM=
{mapMovingPlatformStepped_Width,mapMovingPlatformStepped_Height,
  193
};

#define mapMovingPlatform_Width   (1)
#define mapMovingPlatform_Height  (1)

const char mapMovingPlatform[1 * 1 + 2] PROGMEM=
{mapMovingPlatform_Width,mapMovingPlatform_Height,
  194
};

#define animCoins_Width   (2)
#define animCoins_Height  (8)

const char animCoins[2 * 8 + 2] PROGMEM=
{2,2,
  116,117,
  118,119,
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  130,131
};

#define animWfallTop_Width   (2)
#define animWfallTop_Height  (4)

const char animWfallTop[2 * 4 + 2] PROGMEM=
{2,1,
  132,133,
  134,135,
  136,137,
  138,139
};

#define animWfallBtm_Width   (2)
#define animWfallBtm_Height  (16)

const char animWfallBtm[2 * 16 + 2] PROGMEM=
{2,4,
  140,141,
  142,143,
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    1,  1
};

#define animFire_Width   (2)
#define animFire_Height  (4)

const char animFire[2 * 4 + 2] PROGMEM=
{2,2,
  156,157,
  158,159,
  160,161,
  162,163
};

#define animWave_Width   (1)
#define animWave_Height  (4)

const char animWave[1 * 4 + 2] PROGMEM=
{1,1,
  164,
  165,
  166,
  165
};

#define animPressStart_Width   (14)
#define animPressStart_Height  (4)

const char animPressStart[14 * 4 + 2] PROGMEM=
{14,1,
  168,191,  0,182,167,187,178,  0,179,169,182,174,171,171,
  179,187,185,175,169,  0,168,191,  0,173,184,167,167,  0,
    0,  0,  0,  0,187,192,171,168,181,190,  0,  0,  0,  0,
    0,182,184,171,185,185,  0,  0,185,186,167,184,186,  0
};



const char waterfall[] PROGMEM = { 
0,PC_WAVE,11,
0,PC_PITCH,85,
0,PC_NOTE_UP,12, 
1,PC_NOTE_DOWN,2,
1,PC_NOTE_DOWN,2,
1,PC_NOTE_DOWN,2,
1,PC_NOTE_DOWN,2,
1,PC_NOTE_DOWN,2,
1,PC_NOTE_DOWN,2,
1,PC_NOTE_DOWN,2,
1,PC_NOTE_DOWN,2,
1,PC_NOTE_DOWN,2,
1,PC_NOTE_DOWN,2,
1,PC_NOTE_DOWN,2,
1,PC_NOTE_DOWN,2,
1,PC_NOTE_DOWN,2,
1,PC_NOTE_DOWN,2,
1,PC_NOTE_DOWN,2,
1,PC_NOTE_CUT,0,
0,PATCH_END
};

const char bomb[] PROGMEM = { 
0,PC_ENV_VOL,0xff,
0,PC_WAVE,3,
0,PC_ENV_SPEED,-4,
0,PC_PITCH,40,
1,PC_NOTE_DOWN,5, 
1,PC_NOTE_DOWN,4, 
1,PC_NOTE_DOWN,3, 
1,PC_NOTE_DOWN,2, 
1,PC_NOTE_DOWN,1,
0,PC_TREMOLO_LEVEL,0x90, 
0,PC_TREMOLO_RATE,0x60, 
2,PC_NOTE_DOWN,1,
2,PC_NOTE_DOWN,1,
2,PC_NOTE_DOWN,1,
2,PC_NOTE_DOWN,1,
2,PC_NOTE_DOWN,1,
2,PC_NOTE_DOWN,1,
2,PC_NOTE_DOWN,1,
2,PC_NOTE_DOWN,1,
2,PC_NOTE_DOWN,1,
2,PC_NOTE_DOWN,1,
2,PC_NOTE_DOWN,1,
2,PC_NOTE_DOWN,1,
2,PC_NOTE_DOWN,1,
2,PC_NOTE_CUT,0,
0,PATCH_END 
};

const char pupCollect[] PROGMEM = {
0,PC_ENV_SPEED,-5,
0,PC_PITCH,60,
2,PC_NOTE_UP,6,  
2,PC_NOTE_UP,6, 
2,PC_NOTE_UP,6,  
4,PC_NOTE_CUT,0,
0,PATCH_END
};

const char coinCollect[] PROGMEM = {
0,PC_WAVE,2,
0,PC_PITCH,83,
0,PC_ENV_VOL,0xff,
0,PC_TREMOLO_LEVEL,0x90,     
0,PC_TREMOLO_RATE,60, 
2,PC_NOTE_DOWN,6,
2,PC_NOTE_UP,6,
0,PC_ENV_SPEED,-10,
0,PATCH_END
};

const char psnCollect[] PROGMEM = {
0,PC_ENV_SPEED,-5,
0,PC_PITCH,50,
2,PC_NOTE_DOWN,6,  
2,PC_NOTE_DOWN,6, 
2,PC_NOTE_DOWN,6,  
4,PC_NOTE_CUT,0,
0,PATCH_END
};

//Square Piano 1 - chan 2 arpegio
const char patch00[] PROGMEM ={	
0,PC_WAVE,2,
0,PC_ENV_SPEED,-9,

2,PC_NOTE_UP,12,  
2,PC_NOTE_DOWN,12,

1,PC_NOTE_UP,12,
3,PC_NOTE_DOWN,12,

1,PC_NOTE_UP,12,
2,PC_NOTE_DOWN,12,

1,PC_NOTE_UP,12,
3,PC_NOTE_DOWN,12,

1,PC_NOTE_UP,12,
2,PC_NOTE_DOWN,12,

2,PC_NOTE_UP,12,
2,PC_NOTE_DOWN,12,

1,PC_NOTE_UP,12,
3,PC_NOTE_DOWN,12,


0,PATCH_END
};


//Snare
const char patch01[] PROGMEM ={
0,PC_ENV_SPEED,-25,
0,PC_NOISE_PARAMS,6,
3,PC_NOISE_PARAMS,5 ,
1,PC_NOISE_PARAMS,0x1,
0,PATCH_END 
};

//beat 15-7-15-7-15-7-14-7
const char patch02[] PROGMEM ={
0,PC_ENV_VOL,127*2,
0,PC_ENV_SPEED,-25,
0,PC_NOISE_PARAMS,8,
1,PC_NOISE_PARAMS,7,
2,PC_NOISE_PARAMS,5 ,
1,PC_NOISE_PARAMS,0x1,

11,PC_ENV_VOL,69*2,
0,PC_ENV_SPEED,-35 ,
0,PC_NOISE_PARAMS,0,
1,PC_NOISE_PARAMS,1,

6,PC_ENV_VOL,119*2,
0,PC_ENV_SPEED,-14 , 
0,PC_NOISE_PARAMS,0 ,
1,PC_NOISE_PARAMS,1,	

13,PC_ENV_VOL,69*2,
0,PC_ENV_SPEED,-35 ,
0,PC_NOISE_PARAMS,0,
1,PC_NOISE_PARAMS,1,



6,PC_ENV_VOL,127*2,
0,PC_ENV_SPEED,-25,
0,PC_NOISE_PARAMS,50,
1,PC_NOISE_PARAMS,7,
2,PC_NOISE_PARAMS,5 ,
1,PC_NOISE_PARAMS,0x1,

11,PC_ENV_VOL,69*2,
0,PC_ENV_SPEED,-35 ,
0,PC_NOISE_PARAMS,0,
1,PC_NOISE_PARAMS,1,

6,PC_ENV_VOL,119*2,
0,PC_ENV_SPEED,-14 , 
0,PC_NOISE_PARAMS,0 ,
1,PC_NOISE_PARAMS,1,	

13,PC_ENV_VOL,69*2,
0,PC_ENV_SPEED,-35 ,
0,PC_NOISE_PARAMS,0,
1,PC_NOISE_PARAMS,1,


5,PC_NOTE_CUT,0,
0,PATCH_END  
};

//INST: HIT HAT FAST
const char patch03[] PROGMEM ={	
0,PC_ENV_SPEED,-35 , 
0,PC_NOISE_PARAMS,0,
1,PC_NOISE_PARAMS,1,
7,PC_NOTE_CUT,0,
0,PATCH_END
};

//INST: hi-hat
const char patch04[] PROGMEM ={	
0,PC_ENV_SPEED,-15 , 
0,PC_NOISE_PARAMS,0 ,
1,PC_NOISE_PARAMS,1,
0,PATCH_END
};



//Square Piano 1
const char patch05[] PROGMEM ={	
0,PC_WAVE,2,
0,PC_ENV_SPEED,-15,  
4,PC_ENV_SPEED,-8,  
0,PATCH_END
};


//Square Piano 2
const char patch06[] PROGMEM ={	
0,PC_WAVE,2,
0,PC_TREMOLO_LEVEL,0x60,     
0,PC_TREMOLO_RATE,30, 
0,PC_ENV_SPEED,-8,   
0,PATCH_END
};


//Square Piano chord 1
const char patch07[] PROGMEM ={	
0,PC_WAVE,2,
0,PC_ENV_SPEED,-10,  

1,PC_NOTE_UP,3,
2,PC_NOTE_UP,4,
1,PC_NOTE_DOWN,7,

2,PC_NOTE_UP,3,
1,PC_NOTE_UP,4,
1,PC_NOTE_DOWN,7,

1,PC_NOTE_UP,3,
1,PC_NOTE_UP,4,
2,PC_NOTE_DOWN,7,

1,PC_NOTE_UP,3,
1,PC_NOTE_UP,4,
1,PC_NOTE_DOWN,7,

1,PC_NOTE_UP,3,
2,PC_NOTE_UP,4,
1,PC_NOTE_DOWN,7,

1,PC_NOTE_UP,3,
1,PC_NOTE_UP,4,
1,PC_NOTE_DOWN,7,

2,PC_NOTE_UP,3,
1,PC_NOTE_UP,4,
1,PC_NOTE_DOWN,7,

1,PC_NOTE_UP,3,
1,PC_NOTE_UP,4,
2,PC_NOTE_DOWN,7,

1,PC_NOTE_CUT,0,
0,PATCH_END
};

//Square Piano chord 2
const char patch08[] PROGMEM ={	
0,PC_WAVE,2 ,
0,PC_ENV_SPEED,-10,  

1,PC_NOTE_UP,4,
1,PC_NOTE_UP,3,
1,PC_NOTE_DOWN,7,

2,PC_NOTE_UP,4,
1,PC_NOTE_UP,3,
1,PC_NOTE_DOWN,7,

1,PC_NOTE_UP,4,
1,PC_NOTE_UP,3,
2,PC_NOTE_DOWN,7,

1,PC_NOTE_UP,4,
2,PC_NOTE_UP,3,
1,PC_NOTE_DOWN,7,

1,PC_NOTE_UP,4,
1,PC_NOTE_UP,3,
1,PC_NOTE_DOWN,7,

2,PC_NOTE_UP,4,
1,PC_NOTE_UP,3,
1,PC_NOTE_DOWN,7,

1,PC_NOTE_UP,4,
1,PC_NOTE_UP,3,
2,PC_NOTE_DOWN,7,

1,PC_NOTE_UP,4,
1,PC_NOTE_UP,3,
1,PC_NOTE_DOWN,7,

1,PC_NOTE_CUT,0,
0,PATCH_END
};


//INST: Baseline
const char patch10[] PROGMEM ={	
0,PC_WAVE,1,
1,PC_NOTE_HOLD,0,
1,PC_ENV_SPEED,-30,
0,PATCH_END
};

const char patch09[] PROGMEM ={	
0,PC_WAVE,1,
21,PC_NOTE_DOWN,2,
7,PC_NOTE_UP,2,
22,PC_NOTE_DOWN,4,
7,PC_NOTE_UP,4,
22,PC_NOTE_DOWN,2,
7,PC_NOTE_UP,2,
36,PC_ENV_VOL,0,
7,PC_NOTE_UP,3,
0,PC_ENV_VOL,0xff,

15,PC_ENV_VOL,0,
7,PC_NOTE_DOWN,3,
0,PC_ENV_VOL,0xff,

14,PC_ENV_VOL,0,

0,PATCH_END
};


const struct PatchStruct patches[] PROGMEM = {
{0,NULL,patch00,0,0},
{1,NULL,patch01,0,0},
{0,NULL,patch02,0,0},
{1,NULL,patch03,0,0},
{1,NULL,patch04,0,0},
{0,NULL,patch05,0,0},
{0,NULL,patch06,0,0},
{0,NULL,patch07,0,0}, 
{0,NULL,patch08,0,0},
{0,NULL,patch09,0,0},
{0,NULL,patch10,0,0},
{0,NULL,waterfall,0,0},
{0,NULL,bomb,0,0},
{0,NULL,pupCollect,0,0},
{0,NULL,coinCollect,0,0},
{0,NULL,psnCollect,0,0}
};

/*
 *  Uzebox Wavetable
 *  Copyright (C) 2008  Alec Bourque
 *
 *  This program is free software: you can redistribute it and/or modify
 *  it under the terms of the GNU General Public License as published by
 *  the Free Software Foundation, either version 3 of the License, or
 *  (at your option) any later version.
 *
 *  This program is distributed in the hope that it will be useful,
 *  but WITHOUT ANY WARRANTY; without even the implied warranty of
 *  MERCHANTABILITY or FITNESS FOR A PARTICULAR PURPOSE.  See the
 *  GNU General Public License for more details.
 *
 *  You should have received a copy of the GNU General Public License
 *  along with this program.  If not, see <http://www.gnu.org/licenses/>.
*/
/*
	;*************************************************************
	;Generated Wave #0: sine
	;*************************************************************
	.byte 0x00,0x03,0x06,0x09,0x0C,0x10,0x13,0x16,0x19,0x1C,0x1F,0x22,0x25,0x28,0x2B,0x2E
	.byte 0x31,0x33,0x36,0x39,0x3C,0x3F,0x41,0x44,0x47,0x49,0x4C,0x4E,0x51,0x53,0x55,0x58
	.byte 0x5A,0x5C,0x5E,0x60,0x62,0x64,0x66,0x68,0x6A,0x6B,0x6D,0x6F,0x70,0x71,0x73,0x74
	.byte 0x75,0x76,0x78,0x79,0x7A,0x7A,0x7B,0x7C,0x7D,0x7D,0x7E,0x7E,0x7E,0x7F,0x7F,0x7F
	.byte 0x7F,0x7F,0x7F,0x7F,0x7E,0x7E,0x7E,0x7D,0x7D,0x7C,0x7B,0x7A,0x7A,0x79,0x78,0x76
	.byte 0x75,0x74,0x73,0x71,0x70,0x6F,0x6D,0x6B,0x6A,0x68,0x66,0x64,0x62,0x60,0x5E,0x5C
	.byte 0x5A,0x58,0x55,0x53,0x51,0x4E,0x4C,0x49,0x47,0x44,0x41,0x3F,0x3C,0x39,0x36,0x33
	.byte 0x31,0x2E,0x2B,0x28,0x25,0x22,0x1F,0x1C,0x19,0x16,0x13,0x10,0x0C,0x09,0x06,0x03
	.byte 0x00,0xFD,0xFA,0xF7,0xF4,0xF0,0xED,0xEA,0xE7,0xE4,0xE1,0xDE,0xDB,0xD8,0xD5,0xD2
	.byte 0xCF,0xCD,0xCA,0xC7,0xC4,0xC1,0xBF,0xBC,0xB9,0xB7,0xB4,0xB2,0xAF,0xAD,0xAB,0xA8
	.byte 0xA6,0xA4,0xA2,0xA0,0x9E,0x9C,0x9A,0x98,0x96,0x95,0x93,0x91,0x90,0x8F,0x8D,0x8C
	.byte 0x8B,0x8A,0x88,0x87,0x86,0x86,0x85,0x84,0x83,0x83,0x82,0x82,0x82,0x81,0x81,0x81
	.byte 0x81,0x81,0x81,0x81,0x82,0x82,0x82,0x83,0x83,0x84,0x85,0x86,0x86,0x87,0x88,0x8A
	.byte 0x8B,0x8C,0x8D,0x8F,0x90,0x91,0x93,0x95,0x96,0x98,0x9A,0x9C,0x9E,0xA0,0xA2,0xA4
	.byte 0xA6,0xA8,0xAB,0xAD,0xAF,0xB2,0xB4,0xB7,0xB9,0xBC,0xBF,0xC1,0xC4,0xC7,0xCA,0xCD
	.byte 0xCF,0xD2,0xD5,0xD8,0xDB,0xDE,0xE1,0xE4,0xE7,0xEA,0xED,0xF0,0xF4,0xF7,0xFA,0xFD
*/
	;*************************************************************
	;Generated Wave #0: up-sawtooth
	;*************************************************************
	.byte 0x80,0x81,0x82,0x83,0x84,0x85,0x86,0x87,0x88,0x89,0x8A,0x8B,0x8C,0x8D,0x8E,0x8F
	.byte 0x90,0x91,0x92,0x93,0x94,0x95,0x96,0x97,0x98,0x99,0x9A,0x9B,0x9C,0x9D,0x9E,0x9F
	.byte 0xA0,0xA1,0xA2,0xA3,0xA4,0xA5,0xA6,0xA7,0xA8,0xA9,0xAA,0xAB,0xAC,0xAD,0xAE,0xAF
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	.byte 0x70,0x71,0x72,0x73,0x74,0x75,0x76,0x77,0x78,0x79,0x7A,0x7B,0x7C,0x7D,0x7E,0x7F




	;*************************************************************
	;Generated Wave #1: triangle
	;*************************************************************
	.byte 0x00,0x02,0x04,0x06,0x08,0x0A,0x0C,0x0E,0x10,0x12,0x14,0x16,0x18,0x1A,0x1C,0x1E
	.byte 0x20,0x22,0x24,0x26,0x28,0x2A,0x2C,0x2E,0x30,0x32,0x34,0x36,0x38,0x3A,0x3C,0x3E
	.byte 0x40,0x42,0x44,0x46,0x48,0x4A,0x4C,0x4E,0x50,0x52,0x54,0x56,0x58,0x5A,0x5C,0x5E
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	.byte 0xE0,0xE2,0xE4,0xE6,0xE8,0xEA,0xEC,0xEE,0xF0,0xF2,0xF4,0xF6,0xF8,0xFA,0xFC,0xFE

	;*************************************************************
	;Generated Wave #2: square-50%
	;*************************************************************
	.byte 0x7F,0x7F,0x7F,0x7F,0x7F,0x7F,0x7F,0x7F,0x7F,0x7F,0x7F,0x7F,0x7F,0x7F,0x7F,0x7F
	.byte 0x7F,0x7F,0x7F,0x7F,0x7F,0x7F,0x7F,0x7F,0x7F,0x7F,0x7F,0x7F,0x7F,0x7F,0x7F,0x7F
	.byte 0x7F,0x7F,0x7F,0x7F,0x7F,0x7F,0x7F,0x7F,0x7F,0x7F,0x7F,0x7F,0x7F,0x7F,0x7F,0x7F
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	.byte 0x80,0x80,0x80,0x80,0x80,0x80,0x80,0x80,0x80,0x80,0x80,0x80,0x80,0x80,0x80,0x80

	;*************************************************************
	;Generated Wave #3: square-25%
	;*************************************************************
	.byte 0x7F,0x7F,0x7F,0x7F,0x7F,0x7F,0x7F,0x7F,0x7F,0x7F,0x7F,0x7F,0x7F,0x7F,0x7F,0x7F
	.byte 0x7F,0x7F,0x7F,0x7F,0x7F,0x7F,0x7F,0x7F,0x7F,0x7F,0x7F,0x7F,0x7F,0x7F,0x7F,0x7F
	.byte 0x7F,0x7F,0x7F,0x7F,0x7F,0x7F,0x7F,0x7F,0x7F,0x7F,0x7F,0x7F,0x7F,0x7F,0x7F,0x7F
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	.byte 0x80,0x80,0x80,0x80,0x80,0x80,0x80,0x80,0x80,0x80,0x80,0x80,0x80,0x80,0x80,0x80

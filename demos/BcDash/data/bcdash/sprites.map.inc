#define animLynxIdle_Width   (3)
#define animLynxIdle_Height  (2)

const char animLynxIdle[3 * 2] PROGMEM=
{
    0,  1,  2,
    3,  4,  5
};

#define animLynxRun_Width   (3)
#define animLynxRun_Height  (12)

const char animLynxRun[3 * 12] PROGMEM=
{
    0,  1,  6,
    7,  8,  9,
    0,  1,  6,
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   29, 30, 31
};

#define animDFly_Width   (2)
#define animDFly_Height  (6)

const char animDFly[2 * 6] PROGMEM=
{
   32, 33,
   34, 35,
   36, 37,
   38, 39,
   40, 40,
   41, 35
};

#define animTurtle_Width   (2)
#define animTurtle_Height  (3)

const char animTurtle[2 * 3] PROGMEM=
{
   42, 43,
   44, 45,
   46, 47
};

#define animSnail_Width   (1)
#define animSnail_Height  (1)

const char animSnail[1 * 1] PROGMEM=
{
   48
};

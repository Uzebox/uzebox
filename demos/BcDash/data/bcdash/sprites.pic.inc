
// B.C. Dash sprites
// TileWidth:8
// TileHeight:8
// TileCount:49


const char spriteset[] PROGMEM ={
/* tile 0 */

  0xFE,0xFE,0xFE,0xFE,0xFE,0xFE,0xFE,0xFE,
  0xFE,0xFE,0xFE,0xFE,0xFE,0xFE,0xFE,0xFE,
  0xFE,0xFE,0xFE,0xFE,0xFE,0xFE,0xFE,0xFE,
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  0xFE,0xFE,0xFE,0xFE,0xFE,0xFE,0x00,0x00,
/* tile 1 */

  0xFE,0xFE,0xFE,0xFE,0xFE,0xFE,0xFE,0xFE,
  0xFE,0xFE,0xFE,0xFE,0xFE,0xFE,0xFE,0xFE,
  0xFE,0xFE,0xFE,0xFE,0xFE,0xFE,0xFE,0xFE,
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  0x00,0x52,0x52,0x5B,0x5B,0x5B,0x5B,0x52,
/* tile 2 */

  0xFE,0xFE,0xFE,0xFE,0xFE,0xFE,0xFE,0xFE,
  0xFE,0xFE,0xFE,0xFE,0xFE,0xFE,0xFE,0xFE,
  0xFE,0xFE,0x00,0xFE,0xFE,0xFE,0xFE,0xFE,
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  0x52,0x52,0x00,0x00,0x00,0x0C,0xFF,0xFE,
/* tile 3 */

  0xFE,0xFE,0xFE,0xFE,0xFE,0x00,0x00,0x00,
  0xFE,0xFE,0xFE,0xFE,0x00,0x00,0x00,0x00,
  0xFE,0xFE,0xFE,0x00,0x52,0xFE,0x00,0x00,
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  0xFE,0xFE,0xFE,0xFE,0xFE,0xFE,0xFE,0x00,
/* tile 4 */

  0x52,0x00,0x00,0x52,0x52,0x52,0x52,0x00,
  0x52,0x52,0x00,0x00,0x00,0x00,0x00,0x00,
  0x00,0x52,0x00,0x00,0x00,0x00,0x00,0x00,
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  0x00,0xFE,0x00,0x52,0xFE,0xFE,0xFE,0xFE,
/* tile 5 */

  0x52,0x52,0x00,0x00,0xFE,0xFE,0x52,0xFE,
  0x00,0x52,0x00,0x00,0xFE,0xFE,0xFE,0xFE,
  0x00,0x00,0x00,0xFE,0xFE,0xFE,0xFE,0xFE,
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  0x52,0x00,0x52,0xFE,0x52,0x00,0xFE,0xFE,
/* tile 6 */

  0xFE,0xFE,0xFE,0xFE,0xFE,0xFE,0xFE,0xFE,
  0xFE,0xFE,0xFE,0xFE,0xFE,0xFE,0xFE,0xFE,
  0xFE,0xFE,0x00,0xFE,0xFE,0xFE,0xFE,0xFE,
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  0x5B,0x52,0x00,0x00,0x00,0x0C,0xFF,0xFE,
/* tile 7 */

  0xFE,0xFE,0xFE,0xFE,0xFE,0x00,0x00,0x00,
  0xFE,0xFE,0xFE,0xFE,0x00,0x00,0x00,0x00,
  0xFE,0xFE,0xFE,0x00,0x52,0xFE,0x00,0x00,
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  0xFE,0xFE,0xFE,0xFE,0xFE,0xFE,0xFE,0xFE,
/* tile 8 */

  0x52,0x00,0x00,0x52,0x52,0x52,0x52,0x00,
  0x52,0x52,0x00,0x00,0x00,0x00,0x00,0x00,
  0x00,0x52,0x00,0x00,0x00,0x00,0x00,0x00,
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  0xFE,0x00,0x00,0x52,0x00,0x00,0xFE,0xFE,
/* tile 9 */

  0x5B,0x52,0x00,0x00,0xFE,0xFE,0x52,0xFE,
  0x00,0x52,0x00,0x00,0xFE,0xFE,0xFE,0xFE,
  0x00,0x00,0x00,0xFE,0xFE,0xFE,0xFE,0xFE,
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  0xFE,0xFE,0xFE,0xFE,0xFE,0xFE,0xFE,0xFE,
/* tile 10 */

  0xFE,0xFE,0xFE,0xFE,0x00,0x00,0x00,0x00,
  0xFE,0xFE,0x52,0x00,0x52,0x52,0x00,0x00,
  0xFE,0xFE,0x00,0xFE,0xFE,0xFE,0x00,0x00,
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  0xFE,0xFE,0xFE,0xFE,0xFE,0xFE,0x00,0x00,
/* tile 11 */

  0x52,0x00,0x00,0x52,0x52,0x52,0x52,0x00,
  0x52,0x52,0x00,0x00,0x00,0x00,0x00,0x00,
  0x00,0x52,0x00,0x00,0x00,0x00,0x00,0x00,
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  0xFE,0x52,0x00,0x00,0xFE,0xFE,0xFE,0xFE,
/* tile 12 */

  0x5B,0x52,0x00,0x00,0xFE,0xFE,0x52,0xFE,
  0x00,0x52,0x00,0x00,0x00,0x52,0xFE,0xFE,
  0x00,0x00,0x00,0x00,0x00,0x00,0xFE,0xFE,
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  0xFE,0xFE,0xFE,0xFE,0xFE,0xFE,0xFE,0xFE,
/* tile 13 */

  0xFE,0xFE,0xFE,0xFE,0xFE,0xFE,0xFE,0xFE,
  0xFE,0xFE,0xFE,0xFE,0xFE,0xFE,0xFE,0xFE,
  0xFE,0xFE,0xFE,0xFE,0xFE,0xFE,0xFE,0xFE,
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  0xFE,0xFE,0xFE,0x52,0x00,0x00,0x00,0x00,
/* tile 14 */

  0xFE,0xFE,0xFE,0xFE,0xFE,0xFE,0xFE,0xFE,
  0xFE,0xFE,0xFE,0xFE,0xFE,0xFE,0xFE,0xFE,
  0xFE,0xFE,0xFE,0xFE,0xFE,0xFE,0xFE,0xFE,
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  0x00,0x00,0x52,0x52,0x00,0x00,0x00,0x52,
/* tile 15 */

  0x00,0x00,0x00,0x00,0x00,0x00,0x00,0x00,
  0xFE,0xFE,0xFE,0xFE,0x52,0x00,0x00,0x52,
  0xFE,0xFE,0xFE,0xFE,0x00,0x00,0x00,0x52,
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  0xFE,0xFE,0x5B,0x00,0xFE,0xFE,0xFE,0xFE,
/* tile 16 */

  0x52,0x00,0x52,0x52,0x5B,0x5B,0x52,0x52,
  0x52,0x00,0x00,0x52,0x52,0x52,0x00,0x00,
  0x00,0x00,0x00,0x00,0x00,0x00,0x00,0x00,
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  0xFE,0xFE,0xFE,0xFE,0xFE,0xFE,0xFE,0xFE,
/* tile 17 */

  0x52,0x52,0x00,0x00,0x00,0x0C,0xFF,0xFE,
  0x52,0x00,0x00,0x00,0xFE,0xFE,0x52,0xFE,
  0x00,0x00,0x00,0x00,0xFE,0xFE,0xFE,0xFE,
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  0xFE,0xFE,0xFE,0xFE,0xFE,0xFE,0xFE,0xFE,
/* tile 18 */

  0xFE,0xFE,0xFE,0xFE,0xFE,0xFE,0xFE,0xFE,
  0xFE,0xFE,0xFE,0xFE,0xFE,0xFE,0xFE,0xFE,
  0x00,0xFE,0xFE,0xFE,0xFE,0xFE,0xFE,0xFE,
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  0xFE,0xFE,0xFE,0xFE,0xFE,0x00,0x00,0x00,
/* tile 19 */

  0xFE,0xFE,0xFE,0xFE,0xFE,0xFE,0xFE,0xFE,
  0xFE,0xFE,0xFE,0xFE,0xFE,0xFE,0xFE,0xFE,
  0xFE,0xFE,0xFE,0xFE,0xFE,0xFE,0xFE,0xFE,
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  0x52,0x00,0x52,0x5B,0x5B,0x5B,0x5B,0x52,
/* tile 20 */

  0xFE,0xFE,0xFE,0xFE,0xFE,0x00,0x00,0x52,
  0xFE,0xFE,0xFE,0xFE,0x00,0x00,0x00,0x00,
  0xFE,0xFE,0xFE,0x00,0x00,0xFE,0x00,0x00,
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  0xFE,0xFE,0xFE,0xFE,0xFE,0xFE,0xFE,0xFE,
/* tile 21 */

  0x52,0x00,0x00,0x52,0x52,0x52,0x52,0x52,
  0x00,0x00,0x00,0x00,0x00,0x52,0x00,0x00,
  0x00,0x52,0x52,0x00,0x00,0x00,0x00,0x00,
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  0xFE,0xFE,0xFE,0xFE,0xFE,0xFE,0xFE,0x52,
/* tile 22 */

  0x52,0x52,0x00,0x00,0xFE,0xFE,0x52,0xFE,
  0x52,0x00,0x00,0x52,0xFE,0xFE,0xFE,0xFE,
  0x00,0x00,0x00,0x52,0xFE,0xFE,0xFE,0xFE,
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  0x00,0x52,0xFE,0xFE,0x52,0x00,0xFE,0xFE,
/* tile 23 */

  0xFE,0xFE,0xFE,0xFE,0xFE,0xFE,0xFE,0xFE,
  0xFE,0xFE,0xFE,0xFE,0xFE,0xFE,0xFE,0xFE,
  0xFE,0xFE,0xFE,0xFE,0xFE,0xFE,0xFE,0xFE,
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  0xFE,0xFE,0xFE,0xFE,0x52,0x00,0x00,0x52,
/* tile 24 */

  0xFE,0xFE,0xFE,0xFE,0xFE,0xFE,0xFE,0xFE,
  0xFE,0xFE,0xFE,0xFE,0xFE,0xFE,0xFE,0xFE,
  0xFE,0xFE,0xFE,0xFE,0xFE,0xFE,0xFE,0xFE,
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  0x00,0x00,0x52,0x5B,0x5B,0x5B,0x5B,0x52,
/* tile 25 */

  0xFE,0xFE,0xFE,0xFE,0x00,0x00,0x52,0x52,
  0xFE,0xFE,0x9D,0xFE,0x00,0x00,0x00,0x52,
  0xFE,0x52,0x00,0x00,0x00,0x00,0x00,0x00,
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  0xFE,0xFE,0xFE,0xFE,0xFE,0xFE,0xFE,0xFE,
/* tile 26 */

  0x00,0x00,0x00,0x52,0x5B,0x5B,0x5B,0x5B,
  0x00,0x00,0x00,0x00,0x00,0x52,0x52,0x52,
  0x00,0x00,0x00,0x00,0x00,0x00,0x00,0x52,
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  0xFE,0xFE,0xFE,0xFE,0xFE,0x00,0x52,0xFE,
/* tile 27 */

  0x5B,0x52,0x00,0x00,0xFE,0xFE,0x52,0xFE,
  0x52,0x00,0x00,0xFE,0xFE,0xFE,0xFE,0xFE,
  0x00,0x00,0x00,0xFE,0xFE,0xFE,0xFE,0xFE,
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  0xFE,0xFE,0x00,0x00,0xFE,0xFE,0xFE,0xFE,
/* tile 28 */

  0xFE,0xFE,0xFE,0xFE,0xFE,0xFE,0xFE,0xFE,
  0xFE,0xFE,0xFE,0xFE,0xFE,0xFE,0xFE,0xFE,
  0xFE,0xFE,0xFE,0xFE,0xFE,0xFE,0xFE,0xFE,
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  0xFE,0xFE,0x00,0x00,0x5B,0x52,0x00,0x00,
/* tile 29 */

  0x00,0x00,0xFE,0xFE,0xFE,0x52,0x00,0x00,
  0xFE,0xFE,0xFE,0xFE,0xFE,0x52,0x00,0x00,
  0xFE,0xFE,0xFE,0xFE,0xFE,0xFE,0x52,0x00,
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  0xFE,0xFE,0xFE,0xFE,0xFE,0xFE,0xFE,0xFE,
/* tile 30 */

  0x52,0x00,0x00,0x52,0x52,0x5B,0x5B,0x52,
  0x52,0x52,0x00,0x00,0x00,0x00,0x52,0x52,
  0x00,0x52,0x52,0x00,0x00,0x00,0x00,0x00,
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  0xFE,0xFE,0x9D,0x00,0x00,0x52,0x5B,0x5B,
/* tile 31 */

  0x52,0x00,0x00,0x00,0xFE,0xFE,0x52,0xFE,
  0x00,0x00,0x00,0x00,0xFE,0xFE,0xFE,0xFE,
  0x00,0x00,0x00,0x52,0xFE,0xFE,0xFE,0xFE,
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  0xFE,0xFE,0xFE,0xFE,0xFE,0xFE,0xFE,0xFE,
/* tile 32 */

  0xFE,0xFE,0xFE,0xFE,0xFE,0xFE,0xFE,0xFE,
  0xFE,0xFE,0xFE,0xFE,0xFE,0xFE,0xFE,0xFE,
  0xFE,0xFE,0xFE,0xFE,0xFE,0xFE,0xFE,0xFE,
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  0x52,0x5B,0xA4,0xA4,0xA4,0xA4,0x5B,0x09,
/* tile 33 */

  0xFE,0xFE,0xFE,0xFE,0xFE,0xFE,0xFE,0xFE,
  0xFE,0xFE,0xFE,0xFE,0xFE,0xFE,0xFE,0xFE,
  0xFE,0xFE,0xFE,0xFE,0xFE,0xFE,0xFE,0xFE,
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  0x09,0xFE,0xFE,0xFE,0xFE,0xFE,0xFE,0xFE,
/* tile 34 */

  0xFE,0x52,0x5B,0x5B,0x5B,0x5B,0xA4,0xA4,
  0xFE,0xFE,0xFE,0xFE,0xFE,0xFE,0x52,0x5B,
  0xFE,0xFE,0xFE,0xFE,0xFE,0x5D,0x5E,0x5D,
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  0x20,0x10,0xFE,0xFE,0xFE,0xFE,0xFE,0xFE,
/* tile 35 */

  0x09,0xFE,0xFE,0x5E,0x40,0xFE,0xFE,0xFE,
  0xA4,0x5D,0x5D,0xFF,0xC0,0x40,0xFE,0xFE,
  0x5D,0x5E,0x67,0x5E,0xFF,0x5D,0xFE,0xFE,
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  0xFE,0xFE,0xFE,0xFE,0xFE,0xFE,0xFE,0xFE,
/* tile 36 */

  0xFE,0xFE,0xFE,0xFE,0xFE,0xFE,0xFE,0xFE,
  0xFE,0xFE,0xFE,0xFE,0xFE,0xFE,0xFE,0xFE,
  0xFE,0xFE,0xFE,0xFE,0xFE,0xFE,0xFE,0x52,
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  0xFE,0xFE,0xFE,0xFE,0xFE,0x52,0x5B,0xA4,
/* tile 37 */

  0xFE,0xFE,0xFE,0xFE,0xFE,0xFE,0xFE,0xFE,
  0xFE,0xFE,0xFE,0xFE,0xFE,0xFE,0xFE,0xFE,
  0xFE,0xFE,0xFE,0xFE,0xFE,0xFE,0xFE,0xFE,
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  0x52,0xFE,0xFE,0x5E,0x40,0xFE,0xFE,0xFE,
/* tile 38 */

  0xFE,0xFE,0xFE,0xFE,0x30,0x18,0x52,0x52,
  0xFE,0xFE,0x10,0x28,0x18,0x10,0x5E,0x5D,
  0xFE,0x10,0x30,0x28,0xFE,0xFE,0x5D,0x67,
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  0xFE,0xFE,0xFE,0xFE,0xFE,0xFE,0xFE,0xFE,
/* tile 39 */

  0xA4,0x5D,0x5D,0xFF,0xC0,0x40,0xFE,0xFE,
  0x5D,0x5E,0x67,0x5E,0xFF,0x5D,0xFE,0xFE,
  0x04,0x5E,0xFE,0x5E,0x5D,0x67,0xFE,0xFE,
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  0xFE,0xFE,0xFE,0xFE,0xFE,0xFE,0xFE,0xFE,
/* tile 40 */

  0xFE,0xFE,0xFE,0xFE,0xFE,0xFE,0xFE,0xFE,
  0xFE,0xFE,0xFE,0xFE,0xFE,0xFE,0xFE,0xFE,
  0xFE,0xFE,0xFE,0xFE,0xFE,0xFE,0xFE,0xFE,
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  0xFE,0xFE,0xFE,0xFE,0xFE,0xFE,0xFE,0xFE,
/* tile 41 */

  0xFE,0xFE,0xFE,0xFE,0xFE,0xFE,0xFE,0xFE,
  0xFE,0xFE,0xFE,0xFE,0xFE,0xFE,0x5B,0xA4,
  0xFE,0xFE,0xFE,0xFE,0x52,0x5B,0xA4,0xA4,
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  0x18,0x08,0xFE,0xFE,0xFE,0xFE,0xFE,0xFE,
/* tile 42 */

  0xFE,0xFE,0xFE,0x5D,0x5D,0x5E,0x5E,0x1D,
  0xFE,0xFE,0x1D,0x5E,0x66,0x66,0x66,0x66,
  0xFE,0x1D,0x5E,0x66,0x66,0x66,0x66,0x66,
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  0xFE,0x28,0x28,0x28,0xFE,0xFE,0xFE,0xFE,
/* tile 43 */

  0x5D,0xFE,0xFE,0xFE,0xFE,0xFE,0xFE,0xFE,
  0x5E,0x5D,0x5D,0xFE,0x28,0x28,0xFE,0xFE,
  0x66,0x5E,0x15,0x28,0xFF,0x80,0x28,0x18,
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  0x28,0x28,0x28,0xFE,0xFE,0xFE,0xFE,0xFE,
/* tile 44 */

  0xFE,0xFE,0xFE,0x5D,0x5D,0x5E,0x5E,0x1D,
  0xFE,0xFE,0x1D,0x5E,0x66,0x66,0x66,0x66,
  0xFE,0x1D,0x5E,0x66,0x66,0x66,0x66,0x66,
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  0xFE,0xFE,0x28,0x28,0x28,0xFE,0xFE,0xFE,
/* tile 45 */

  0x5D,0xFE,0xFE,0xFE,0xFE,0xFE,0xFE,0xFE,
  0x5E,0x5D,0x5D,0xFE,0x28,0x28,0xFE,0xFE,
  0x66,0x5E,0x15,0x28,0xFF,0x80,0x28,0x18,
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  0xFE,0x28,0x28,0x28,0xFE,0xFE,0xFE,0xFE,
/* tile 46 */

  0xFE,0xFE,0xFE,0x5D,0x5D,0x5E,0x5E,0x1D,
  0xFE,0xFE,0x1D,0x5E,0x66,0x66,0x66,0x66,
  0xFE,0x1D,0x5E,0x66,0x66,0x66,0x66,0x66,
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  0x28,0x28,0x28,0xFE,0xFE,0xFE,0xFE,0x28,
/* tile 47 */

  0x5D,0xFE,0xFE,0xFE,0xFE,0xFE,0xFE,0xFE,
  0x5E,0x5D,0x5D,0xFE,0x28,0x28,0xFE,0xFE,
  0x66,0x5E,0x15,0x28,0xFF,0x80,0x28,0x18,
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  0x28,0x28,0xFE,0xFE,0xFE,0xFE,0xFE,0xFE,
/* tile 48 */

  0xFE,0x66,0x5E,0xFE,0xFE,0x38,0xFE,0xFE,
  0x6F,0x5D,0x66,0x5E,0xFE,0x18,0x18,0xFE,
  0x66,0x66,0x5E,0x66,0x28,0xFF,0x40,0x18,
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  0x28,0x38,0x38,0x38,0x38,0x38,0x18,0xFE
};

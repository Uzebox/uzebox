/*
 *  Zombienator
 *  Copyright (C) 2009 Peter Hedman
 *
 *  This program is free software: you can redistribute it and/or modify
 *  it under the terms of the GNU General Public License as published by
 *  the Free Software Foundation, either version 3 of the License, or
 *  (at your option) any later version.
 *
 *  This program is distributed in the hope that it will be useful,
 *  but WITHOUT ANY WARRANTY; without even the implied warranty of
 *  MERCHANTABILITY or FITNESS FOR A PARTICULAR PURPOSE.  See the
 *  GNU General Public License for more details.
 *
 *  You should have received a copy of the GNU General Public License
 *  along with this program.  If not, see <http://www.gnu.org/licenses/>.
*/

#define MAINCHAR_SIZE 44

const char graveyard_sprites[] PROGMEM =
{
	0xFE,0xFE,0xFE,0xFE,0xFE,0xFE,
	0xFE,0xFE,0xFE,0xFE,0xFE,0xFE,
	0xFE,0xFE,0xFE,0xFE,0xFE,0xFE,
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	0xFE,0x01,0x2D,0x2D,0xFE,0x02,		// sprite # 66 zombie BURN 2


};

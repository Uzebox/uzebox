//*********************************//
// MIDI file: smw2.inc
//*********************************//
const char midisong[] PROGMEM ={
0x00,0xc0,0x00,0x00,0xc1,0x01,0x00,0xc2,0x02,0x00,0xb0,0x07,0x7f,0x00,0x0b,0x7f,0x00,0x0b,0x7f,0x00,0x90,0x47,0x64,0x00,0xb1,0x0b,0x7f,0x00,0x07,0x7f,0x00,0x91,
0x31,0x64,0x00,0xb2,0x0b,0x7f,0x00,0x07,0x7f,0x00,0x92,0x29,0x64,0x05,0x90,0x45,0x64,0x07,0x41,0x64,0x06,0x47,0x64,0x00,0x91,0x31,0x64,0x00,0x92,0x29,0x64,0x12,
0x90,0x45,0x64,0x06,0x41,0x64,0x06,0x40,0x64,0x00,0x91,0x32,0x64,0x00,0x92,0x28,0x64,0x0c,0x90,0x4c,0x64,0x00,0x91,0x44,0x64,0x0c,0x90,0x4c,0x64,0x00,0x91,0x44,
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0xff,0x06,0x01,0x45,0x00,0xff,0x2f,0x00 };

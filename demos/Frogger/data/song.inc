//*********************************//
// MIDI file: song.inc
//*********************************//
const char song[] PROGMEM ={
0x00,0xc0,0x00,0x00,0xc1,0x01,0x01,0xc0,0x00,0x00,0xc1,0x01,0x0c,0x90,0x49,0x7f,0x00,0x91,0x36,0x7f,0x1c,0x90,0x46,0x7f,0x0f,0x42,0x7f,0x0e,0x4e,0x7f,0x00,0x91,
0x33,0x7f,0x1c,0x90,0x4d,0x7f,0x0f,0x4b,0x7f,0x0e,0x49,0x7f,0x00,0x91,0x31,0x7f,0x1c,0x90,0x4e,0x7f,0x0f,0x46,0x7f,0x0e,0x49,0x7f,0x00,0x91,0x35,0x7f,0x0e,0x90,
0x44,0x7f,0x0e,0x91,0x33,0x7f,0x0f,0x35,0x7f,0x0c,0xff,0x06,0x01,0x53,0x02,0x91,0x36,0x7f,0x0e,0x90,0x49,0x7f,0x00,0x91,0x3a,0x7f,0x0f,0x90,0x49,0x7f,0x00,0x91,
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0x3a,0x7f,0x0f,0x31,0x7f,0x0e,0x3a,0x7f,0x0d,0xff,0x06,0x01,0x45,0x01,0xff,0x2f,0x00 };

//*********************************//
// MIDI file: frogger_end.inc
//*********************************//
const char song_end[] PROGMEM ={
0x00,0xc0,0x00,0x00,0xc1,0x01,0x03,0xc0,0x00,0x00,0xc1,0x01,0x08,0x90,0x49,0x7f,0x00,0x91,0x3b,0x7f,0x0c,0x90,0x4b,0x7f,0x00,0x91,0x33,0x7f,0x0c,0x90,0x4d,0x7f,
0x00,0x91,0x3b,0x7f,0x0c,0x90,0x4e,0x7f,0x00,0x91,0x36,0x7f,0x0d,0x90,0x50,0x7f,0x00,0x91,0x3b,0x7f,0x0c,0x90,0x4e,0x7f,0x00,0x91,0x33,0x7f,0x0c,0x90,0x4b,0x7f,
0x00,0x91,0x3b,0x7f,0x0d,0x90,0x4d,0x7f,0x00,0x91,0x35,0x7f,0x0c,0x90,0x4b,0x7f,0x00,0x91,0x3b,0x7f,0x0c,0x90,0x49,0x7f,0x00,0x91,0x31,0x7f,0x0d,0x90,0x47,0x7f,
0x00,0x91,0x3b,0x7f,0x0c,0x90,0x46,0x7f,0x00,0x91,0x35,0x7f,0x0c,0x90,0x44,0x7f,0x00,0x91,0x3b,0x7f,0x0d,0x90,0x3f,0x7f,0x00,0x91,0x31,0x7f,0x0c,0x90,0x41,0x7f,
0x00,0x91,0x3b,0x7f,0x0c,0x90,0x42,0x7f,0x00,0x91,0x36,0x7f,0x0d,0x90,0x46,0x7f,0x00,0x91,0x3a,0x7f,0x0c,0x90,0x42,0x7f,0x00,0x91,0x31,0x7f,0x11,0xff,0x2f,0x00,
 };

//*********************************//
// MIDI file: frogger_end2.inc
//*********************************//
const char song_end2[] PROGMEM ={
0x00,0xc0,0x00,0x00,0x90,0x41,0x7f,0x00,0xc1,0x01,0x0c,0x90,0x45,0x7f,0x00,0x91,0x35,0x7f,0x0c,0x90,0x41,0x7f,0x0c,0x45,0x7f,0x00,0x91,0x35,0x7f,0x0d,0x90,0x48,
0x7f,0x0c,0x4b,0x7f,0x00,0x91,0x35,0x7f,0x19,0x35,0x7f,0x19,0x90,0x4b,0x7f,0x00,0x91,0x33,0x7f,0x0c,0x90,0x49,0x7f,0x0d,0x48,0x7f,0x0c,0x41,0x7f,0x0c,0x91,0x35,
0x7f,0x0d,0x90,0x45,0x7f,0x0c,0x46,0x7f,0x16,0xff,0x06,0x01,0x53,0x02,0x91,0x3a,0x7f,0xac,0x31,0xff,0x06,0x01,0x45,0x00,0xff,0x2f,0x00 };

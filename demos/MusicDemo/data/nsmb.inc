//*********************************//
// MIDI file: C:\Documents and Settings\Admin\My Documents\projet\atmel\uzebox2\music\NSMB.mid
//*********************************//
const char song_nsmb[] PROGMEM ={
0x00,0xc0,0x03,0x00,0x90,0x4c,0x7f,0x00,0x91,0x3c,0x52,0x00,0x92,0x30,0x6c,0x00,0xc2,0x03,0x00,0xc1,0x03,0x35,0x90,0x4c,0x7f,0x00,0x91,0x3c,0x52,0x00,0x92,0x30,
0x6c,0x11,0x90,0x48,0x7f,0x00,0x91,0x37,0x52,0x12,0x90,0x48,0x7f,0x00,0x91,0x37,0x52,0x00,0x92,0x30,0x6c,0x12,0x30,0x6c,0x11,0x90,0x48,0x7f,0x00,0x91,0x39,0x52,
0x00,0x92,0x35,0x6c,0x24,0x90,0x45,0x7f,0x00,0x91,0x35,0x52,0x00,0x92,0x35,0x6c,0x12,0x90,0x41,0x7f,0x00,0x91,0x30,0x52,0x00,0x92,0x30,0x6c,0x11,0x90,0x45,0x7f,
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0x60,0x11,0x92,0x2b,0x7c,0x12,0x90,0x40,0x7f,0x00,0x91,0x3c,0x60,0x1b,0xff,0x2f,0x00 };

//picture: composer_6x8.raw
//Horizontal Tiles=28
//Vertical Tiles=6
//Tile Width=6
//Tile Height=8
const char composerTiles[] PROGMEM ={
 0x00, 0x00, 0x00, 0x00, 0x00, 0x00, 0x00, 0x00, 0x00, 0x00, 0x00, 0x00, 0x00, 0x00, 0x00, 0x00, 0x00, 0x00, 0x00, 0x00, 0x00, 0x00, 0x00, 0x00, 0x00, 0x00, 0x00, 0x00, 0x00, 0x00, 0x00, 0x00, 0x00, 0x00, 0x00, 0x00, 0x00, 0x00, 0x00, 0x00, 0x00, 0x00, 0x00, 0x00, 0x00, 0x00, 0x00, 0x00		 //tile:0 
, 0x00, 0x00, 0x00, 0x00, 0x00, 0x00, 0x00, 0x00, 0x00, 0x00, 0x00, 0x00, 0x00, 0x00, 0x00, 0x00, 0x00, 0x00, 0x00, 0x00, 0x00, 0x00, 0x00, 0x00, 0x00, 0x00, 0x00, 0xb6, 0xb6, 0xb6, 0x00, 0x00, 0x00, 0xb6, 0x00, 0x00, 0x00, 0x00, 0x00, 0xb6, 0x00, 0x00, 0x00, 0x00, 0x00, 0xb6, 0x00, 0x00		 //tile:1 
, 0x00, 0x00, 0x00, 0x00, 0x00, 0x00, 0x00, 0x00, 0x00, 0x00, 0x00, 0x00, 0x00, 0x00, 0x00, 0x00, 0x00, 0x00, 0x00, 0x00, 0x00, 0x00, 0x00, 0x00, 0xb6, 0xb6, 0xb6, 0xb6, 0xb6, 0xb6, 0x00, 0x00, 0x00, 0x00, 0x00, 0x00, 0x00, 0x00, 0x00, 0x00, 0x00, 0x00, 0x00, 0x00, 0x00, 0x00, 0x00, 0x00		 //tile:2 
, 0x00, 0x00, 0x00, 0x00, 0x00, 0x00, 0x00, 0x00, 0x00, 0x00, 0x00, 0x00, 0x00, 0x00, 0x00, 0x00, 0x00, 0x00, 0x00, 0x00, 0x00, 0x00, 0x00, 0x00, 0xb6, 0xb6, 0xb6, 0xb6, 0xb6, 0xb6, 0x00, 0x00, 0x00, 0xb6, 0x00, 0x00, 0x00, 0x00, 0x00, 0xb6, 0x00, 0x00, 0x00, 0x00, 0x00, 0xb6, 0x00, 0x00		 //tile:3 
, 0x00, 0x00, 0x00, 0x00, 0x00, 0x00, 0x00, 0x00, 0x00, 0x00, 0x00, 0x00, 0x00, 0x00, 0x00, 0x00, 0x00, 0x00, 0x00, 0x00, 0x00, 0x00, 0x00, 0x00, 0xb6, 0xb6, 0xb6, 0xb6, 0x00, 0x00, 0x00, 0x00, 0x00, 0xb6, 0x00, 0x00, 0x00, 0x00, 0x00, 0xb6, 0x00, 0x00, 0x00, 0x00, 0x00, 0xb6, 0x00, 0x00		 //tile:4 
, 0x00, 0x00, 0x00, 0xb6, 0x00, 0x00, 0x00, 0x00, 0x00, 0xb6, 0x00, 0x00, 0x00, 0x00, 0x00, 0xb6, 0x00, 0x00, 0x00, 0x00, 0x00, 0xb6, 0x00, 0x00, 0x00, 0x00, 0x00, 0xb6, 0xb6, 0xb6, 0x00, 0x00, 0x00, 0xb6, 0x00, 0x00, 0x00, 0x00, 0x00, 0xb6, 0x00, 0x00, 0x00, 0x00, 0x00, 0xb6, 0x00, 0x00		 //tile:5 
, 0x00, 0x00, 0x00, 0xb6, 0x00, 0x00, 0x00, 0x00, 0x00, 0xb6, 0x00, 0x00, 0x00, 0x00, 0x00, 0xb6, 0x00, 0x00, 0x00, 0x00, 0x00, 0xb6, 0x00, 0x00, 0x00, 0x00, 0x00, 0xb6, 0x00, 0x00, 0x00, 0x00, 0x00, 0xb6, 0x00, 0x00, 0x00, 0x00, 0x00, 0xb6, 0x00, 0x00, 0x00, 0x00, 0x00, 0xb6, 0x00, 0x00		 //tile:6 
, 0x00, 0x00, 0x00, 0xb6, 0x00, 0x00, 0x00, 0x00, 0x00, 0xb6, 0x00, 0x00, 0x00, 0x00, 0x00, 0xb6, 0x00, 0x00, 0x00, 0x00, 0x00, 0xb6, 0x00, 0x00, 0xb6, 0xb6, 0xb6, 0xb6, 0xb6, 0xb6, 0x00, 0x00, 0x00, 0xb6, 0x00, 0x00, 0x00, 0x00, 0x00, 0xb6, 0x00, 0x00, 0x00, 0x00, 0x00, 0xb6, 0x00, 0x00		 //tile:7 
, 0x00, 0x00, 0x00, 0xb6, 0x00, 0x00, 0x00, 0x00, 0x00, 0xb6, 0x00, 0x00, 0x00, 0x00, 0x00, 0xb6, 0x00, 0x00, 0x00, 0x00, 0x00, 0xb6, 0x00, 0x00, 0xb6, 0xb6, 0xb6, 0xb6, 0x00, 0x00, 0x00, 0x00, 0x00, 0xb6, 0x00, 0x00, 0x00, 0x00, 0x00, 0xb6, 0x00, 0x00, 0x00, 0x00, 0x00, 0xb6, 0x00, 0x00		 //tile:8 
, 0x00, 0x00, 0x00, 0xb6, 0x00, 0x00, 0x00, 0x00, 0x00, 0xb6, 0x00, 0x00, 0x00, 0x00, 0x00, 0xb6, 0x00, 0x00, 0x00, 0x00, 0x00, 0xb6, 0x00, 0x00, 0x00, 0x00, 0x00, 0xb6, 0xb6, 0xb6, 0x00, 0x00, 0x00, 0x00, 0x00, 0x00, 0x00, 0x00, 0x00, 0x00, 0x00, 0x00, 0x00, 0x00, 0x00, 0x00, 0x00, 0x00		 //tile:9 
, 0x00, 0x00, 0x00, 0xb6, 0x00, 0x00, 0x00, 0x00, 0x00, 0xb6, 0x00, 0x00, 0x00, 0x00, 0x00, 0xb6, 0x00, 0x00, 0x00, 0x00, 0x00, 0xb6, 0x00, 0x00, 0xb6, 0xb6, 0xb6, 0xb6, 0xb6, 0xb6, 0x00, 0x00, 0x00, 0x00, 0x00, 0x00, 0x00, 0x00, 0x00, 0x00, 0x00, 0x00, 0x00, 0x00, 0x00, 0x00, 0x00, 0x00		 //tile:10 
, 0x00, 0x00, 0x00, 0xb6, 0x00, 0x00, 0x00, 0x00, 0x00, 0xb6, 0x00, 0x00, 0x00, 0x00, 0x00, 0xb6, 0x00, 0x00, 0x00, 0x00, 0x00, 0xb6, 0x00, 0x00, 0xb6, 0xb6, 0xb6, 0xb6, 0x00, 0x00, 0x00, 0x00, 0x00, 0x00, 0x00, 0x00, 0x00, 0x00, 0x00, 0x00, 0x00, 0x00, 0x00, 0x00, 0x00, 0x00, 0x00, 0x00		 //tile:11 
, 0x00, 0x00, 0x00, 0x00, 0x00, 0x00, 0x00, 0x00, 0x00, 0x00, 0x00, 0x00, 0x00, 0x00, 0x00, 0x00, 0x00, 0x00, 0x00, 0x00, 0x00, 0x00, 0x00, 0x00, 0x00, 0x00, 0x00, 0x00, 0x00, 0x00, 0x00, 0x00, 0x00, 0x00, 0x00, 0x00, 0x00, 0x00, 0x00, 0x00, 0x00, 0x00, 0x63, 0x19, 0x19, 0x19, 0x10, 0x00		 //tile:12 
, 0x00, 0x00, 0x00, 0x00, 0x00, 0x00, 0x00, 0x00, 0x00, 0x00, 0x00, 0x00, 0x00, 0x00, 0x00, 0x00, 0x00, 0x00, 0x00, 0x00, 0x00, 0x00, 0x00, 0x00, 0x00, 0x00, 0x00, 0x00, 0x00, 0x00, 0x00, 0x00, 0x00, 0x00, 0x00, 0x00, 0x7b, 0x3a, 0x3a, 0x3a, 0x21, 0x00, 0x63, 0x19, 0x19, 0x19, 0x10, 0x00		 //tile:13 
, 0x00, 0x00, 0x00, 0x00, 0x00, 0x00, 0x00, 0x00, 0x00, 0x00, 0x00, 0x00, 0x00, 0x00, 0x00, 0x00, 0x00, 0x00, 0x00, 0x00, 0x00, 0x00, 0x00, 0x00, 0x00, 0x00, 0x00, 0x00, 0x00, 0x00, 0x63, 0x19, 0x19, 0x19, 0x10, 0x00, 0x7b, 0x3a, 0x3a, 0x3a, 0x21, 0x00, 0x63, 0x19, 0x19, 0x19, 0x10, 0x00		 //tile:14 
, 0x00, 0x00, 0x00, 0x00, 0x00, 0x00, 0x00, 0x00, 0x00, 0x00, 0x00, 0x00, 0x00, 0x00, 0x00, 0x00, 0x00, 0x00, 0x00, 0x00, 0x00, 0x00, 0x00, 0x00, 0x7b, 0x3a, 0x3a, 0x3a, 0x21, 0x00, 0x63, 0x19, 0x19, 0x19, 0x10, 0x00, 0x7b, 0x3a, 0x3a, 0x3a, 0x21, 0x00, 0x63, 0x19, 0x19, 0x19, 0x10, 0x00		 //tile:15 
, 0x00, 0x00, 0x00, 0x00, 0x00, 0x00, 0x00, 0x00, 0x00, 0x00, 0x00, 0x00, 0x00, 0x00, 0x00, 0x00, 0x00, 0x00, 0x63, 0x19, 0x19, 0x19, 0x10, 0x00, 0x7b, 0x3a, 0x3a, 0x3a, 0x21, 0x00, 0x63, 0x19, 0x19, 0x19, 0x10, 0x00, 0x7b, 0x3a, 0x3a, 0x3a, 0x21, 0x00, 0x63, 0x19, 0x19, 0x19, 0x10, 0x00		 //tile:16 
, 0x00, 0x00, 0x00, 0x00, 0x00, 0x00, 0x00, 0x00, 0x00, 0x00, 0x00, 0x00, 0x7b, 0x3a, 0x3a, 0x3a, 0x21, 0x00, 0x63, 0x19, 0x19, 0x19, 0x10, 0x00, 0x7b, 0x3a, 0x3a, 0x3a, 0x21, 0x00, 0x63, 0x19, 0x19, 0x19, 0x10, 0x00, 0x7b, 0x3a, 0x3a, 0x3a, 0x21, 0x00, 0x63, 0x19, 0x19, 0x19, 0x10, 0x00		 //tile:17 
, 0x00, 0x00, 0x00, 0x00, 0x00, 0x00, 0x63, 0x19, 0x19, 0x19, 0x10, 0x00, 0x7b, 0x3a, 0x3a, 0x3a, 0x21, 0x00, 0x63, 0x19, 0x19, 0x19, 0x10, 0x00, 0x7b, 0x3a, 0x3a, 0x3a, 0x21, 0x00, 0x63, 0x19, 0x19, 0x19, 0x10, 0x00, 0x7b, 0x3a, 0x3a, 0x3a, 0x21, 0x00, 0x63, 0x19, 0x19, 0x19, 0x10, 0x00		 //tile:18 
, 0x7b, 0x3a, 0x3a, 0x3a, 0x21, 0x00, 0x63, 0x19, 0x19, 0x19, 0x10, 0x00, 0x7b, 0x3a, 0x3a, 0x3a, 0x21, 0x00, 0x63, 0x19, 0x19, 0x19, 0x10, 0x00, 0x7b, 0x3a, 0x3a, 0x3a, 0x21, 0x00, 0x63, 0x19, 0x19, 0x19, 0x10, 0x00, 0x7b, 0x3a, 0x3a, 0x3a, 0x21, 0x00, 0x63, 0x19, 0x19, 0x19, 0x10, 0x00		 //tile:19 
, 0x00, 0x00, 0x00, 0x00, 0x00, 0x00, 0x00, 0x00, 0x00, 0x00, 0x00, 0x00, 0x00, 0x00, 0x00, 0x00, 0x00, 0x00, 0x00, 0x00, 0x00, 0x00, 0x00, 0x00, 0x00, 0x00, 0x00, 0x00, 0x00, 0x00, 0x00, 0x00, 0x00, 0x00, 0x00, 0x00, 0x00, 0x00, 0x00, 0x00, 0x00, 0x00, 0x6f, 0x27, 0x27, 0x27, 0x14, 0x00		 //tile:20 
, 0x00, 0x00, 0x00, 0x00, 0x00, 0x00, 0x00, 0x00, 0x00, 0x00, 0x00, 0x00, 0x00, 0x00, 0x00, 0x00, 0x00, 0x00, 0x00, 0x00, 0x00, 0x00, 0x00, 0x00, 0x00, 0x00, 0x00, 0x00, 0x00, 0x00, 0x00, 0x00, 0x00, 0x00, 0x00, 0x00, 0x77, 0x37, 0x37, 0x37, 0x1c, 0x00, 0x6f, 0x27, 0x27, 0x27, 0x14, 0x00		 //tile:21 
, 0x00, 0x00, 0x00, 0x00, 0x00, 0x00, 0x00, 0x00, 0x00, 0x00, 0x00, 0x00, 0x00, 0x00, 0x00, 0x00, 0x00, 0x00, 0x00, 0x00, 0x00, 0x00, 0x00, 0x00, 0x00, 0x00, 0x00, 0x00, 0x00, 0x00, 0x6f, 0x27, 0x27, 0x27, 0x14, 0x00, 0x77, 0x37, 0x37, 0x37, 0x1c, 0x00, 0x6f, 0x27, 0x27, 0x27, 0x14, 0x00		 //tile:22 
, 0x00, 0x00, 0x00, 0x00, 0x00, 0x00, 0x00, 0x00, 0x00, 0x00, 0x00, 0x00, 0x00, 0x00, 0x00, 0x00, 0x00, 0x00, 0x00, 0x00, 0x00, 0x00, 0x00, 0x00, 0x77, 0x37, 0x37, 0x37, 0x1c, 0x00, 0x6f, 0x27, 0x27, 0x27, 0x14, 0x00, 0x77, 0x37, 0x37, 0x37, 0x1c, 0x00, 0x6f, 0x27, 0x27, 0x27, 0x14, 0x00		 //tile:23 
, 0x00, 0x00, 0x00, 0x00, 0x00, 0x00, 0x00, 0x00, 0x00, 0x00, 0x00, 0x00, 0x00, 0x00, 0x00, 0x00, 0x00, 0x00, 0x55, 0x04, 0x04, 0x04, 0x02, 0x00, 0x77, 0x37, 0x37, 0x37, 0x1c, 0x00, 0x6f, 0x27, 0x27, 0x27, 0x14, 0x00, 0x77, 0x37, 0x37, 0x37, 0x1c, 0x00, 0x6f, 0x27, 0x27, 0x27, 0x14, 0x00		 //tile:24 
, 0x00, 0x00, 0x00, 0x00, 0x00, 0x00, 0x00, 0x00, 0x00, 0x00, 0x00, 0x00, 0x57, 0x07, 0x07, 0x07, 0x04, 0x00, 0x55, 0x04, 0x04, 0x04, 0x02, 0x00, 0x77, 0x37, 0x37, 0x37, 0x1c, 0x00, 0x6f, 0x27, 0x27, 0x27, 0x14, 0x00, 0x77, 0x37, 0x37, 0x37, 0x1c, 0x00, 0x6f, 0x27, 0x27, 0x27, 0x14, 0x00		 //tile:25 
, 0x00, 0x00, 0x00, 0x00, 0x00, 0x00, 0x55, 0x04, 0x04, 0x04, 0x02, 0x00, 0x57, 0x07, 0x07, 0x07, 0x04, 0x00, 0x55, 0x04, 0x04, 0x04, 0x02, 0x00, 0x77, 0x37, 0x37, 0x37, 0x1c, 0x00, 0x6f, 0x27, 0x27, 0x27, 0x14, 0x00, 0x77, 0x37, 0x37, 0x37, 0x1c, 0x00, 0x6f, 0x27, 0x27, 0x27, 0x14, 0x00		 //tile:26 
, 0x57, 0x07, 0x07, 0x07, 0x04, 0x00, 0x55, 0x04, 0x04, 0x04, 0x02, 0x00, 0x57, 0x07, 0x07, 0x07, 0x04, 0x00, 0x55, 0x04, 0x04, 0x04, 0x02, 0x00, 0x77, 0x37, 0x37, 0x37, 0x1c, 0x00, 0x6f, 0x27, 0x27, 0x27, 0x14, 0x00, 0x77, 0x37, 0x37, 0x37, 0x1c, 0x00, 0x6f, 0x27, 0x27, 0x27, 0x14, 0x00		 //tile:27 
, 0xff, 0xff, 0x00, 0x00, 0x00, 0x00, 0xff, 0xf5, 0x7f, 0x00, 0x00, 0x00, 0xff, 0xec, 0xf5, 0x7f, 0x00, 0x00, 0x7f, 0xec, 0xff, 0xd9, 0x7f, 0x00, 0x7f, 0xec, 0xd9, 0xd9, 0x24, 0x00, 0x7f, 0xec, 0xd9, 0x24, 0x00, 0x00, 0x7f, 0xec, 0x24, 0x00, 0x00, 0x00, 0x24, 0x24, 0x00, 0x00, 0x00, 0x00		 //tile:28 
, 0x00, 0x00, 0x00, 0x00, 0x00, 0x00, 0x00, 0x52, 0x52, 0x52, 0x52, 0x52, 0x00, 0x52, 0x52, 0x52, 0x52, 0x52, 0x00, 0x52, 0x52, 0x52, 0x52, 0x52, 0x00, 0x52, 0x52, 0x52, 0x00, 0x00, 0x00, 0x52, 0x52, 0x52, 0x00, 0x09, 0x00, 0x52, 0x52, 0x52, 0x00, 0x0a, 0x00, 0x52, 0x52, 0x52, 0x00, 0x12		 //tile:29 
, 0x00, 0x00, 0x00, 0x00, 0x00, 0x00, 0x52, 0x52, 0x52, 0x52, 0x52, 0x52, 0x52, 0x52, 0x52, 0x52, 0x52, 0x52, 0x52, 0x52, 0x52, 0x52, 0x52, 0x52, 0x00, 0x00, 0x00, 0x00, 0x00, 0x00, 0x1b, 0x1b, 0x1b, 0x09, 0x00, 0x00, 0x1b, 0x1b, 0x1b, 0x09, 0x00, 0x00, 0x1c, 0x1c, 0x1c, 0x0a, 0x00, 0x00		 //tile:30 
, 0x00, 0x00, 0x00, 0x00, 0x00, 0x00, 0x52, 0x52, 0x52, 0x52, 0x52, 0x52, 0x52, 0x52, 0x52, 0x52, 0x52, 0x52, 0x52, 0x52, 0x52, 0x52, 0x52, 0x52, 0x00, 0x00, 0x00, 0x00, 0x00, 0x00, 0x00, 0x00, 0x00, 0x00, 0x00, 0x13, 0x00, 0x00, 0x00, 0x00, 0x00, 0x1b, 0x00, 0x00, 0x00, 0x00, 0x00, 0x1b		 //tile:31 
, 0x00, 0x00, 0x00, 0x00, 0x00, 0x00, 0x52, 0x52, 0x52, 0x52, 0x52, 0x52, 0x52, 0x52, 0x52, 0x52, 0x52, 0x52, 0x52, 0x52, 0x52, 0x52, 0x52, 0x52, 0x00, 0x00, 0x00, 0x00, 0x00, 0x00, 0x1b, 0x1b, 0x13, 0x00, 0x09, 0x1b, 0x1b, 0x1b, 0x1b, 0x00, 0x0a, 0x1b, 0x1c, 0x1c, 0x1b, 0x00, 0x12, 0x1c		 //tile:32 
, 0x00, 0x00, 0x00, 0x00, 0x00, 0x00, 0x52, 0x5b, 0x52, 0x5b, 0x5b, 0x5b, 0x5b, 0x52, 0x52, 0x5b, 0x9b, 0x5b, 0x52, 0x5b, 0x5b, 0x5b, 0x5b, 0x5b, 0x00, 0x00, 0x00, 0x00, 0x00, 0x00, 0x1b, 0x1b, 0x1b, 0x1b, 0x1b, 0x1b, 0x1b, 0x1b, 0x1b, 0x1b, 0x1b, 0x1b, 0x1c, 0x1c, 0x1c, 0x1c, 0x1c, 0x1c		 //tile:33 
, 0x00, 0x00, 0x00, 0x00, 0x00, 0x00, 0x5b, 0x9b, 0x64, 0xa4, 0xa4, 0xa4, 0x9b, 0x64, 0x5b, 0xa4, 0x64, 0xa4, 0x5b, 0x9b, 0xa4, 0xa4, 0xa4, 0xa4, 0x00, 0x00, 0x00, 0x00, 0x00, 0x00, 0x1b, 0x1b, 0x1b, 0x1b, 0x1b, 0x1b, 0x1b, 0x1b, 0x1b, 0x1b, 0x1b, 0x1b, 0x1c, 0x1c, 0x1c, 0x1c, 0x1c, 0x1c		 //tile:34 
, 0x00, 0x00, 0x00, 0x00, 0x00, 0x00, 0xa4, 0xad, 0xad, 0xad, 0xad, 0xad, 0xad, 0xa4, 0xad, 0xad, 0xad, 0xad, 0xa4, 0xad, 0xad, 0xad, 0xed, 0xad, 0x00, 0x00, 0x00, 0x00, 0x00, 0x00, 0x1b, 0x13, 0x01, 0x00, 0x00, 0x00, 0x1b, 0x09, 0x00, 0x00, 0x00, 0x00, 0x09, 0x00, 0x00, 0x00, 0x00, 0x00		 //tile:35 
, 0x00, 0x00, 0x00, 0x00, 0x00, 0x00, 0xad, 0xad, 0xb6, 0xad, 0xb6, 0xf6, 0xad, 0xf6, 0xad, 0xed, 0xf6, 0xad, 0xed, 0xad, 0xb6, 0xb6, 0xad, 0xf6, 0x00, 0x00, 0x00, 0x00, 0x00, 0x00, 0x00, 0x12, 0x1b, 0x1b, 0x1b, 0x1b, 0x00, 0x12, 0x1b, 0x1b, 0x1b, 0x1b, 0x00, 0x12, 0x1c, 0x1c, 0x1c, 0x1c		 //tile:36 
, 0x00, 0x00, 0x00, 0x00, 0x00, 0x00, 0xb6, 0xf6, 0xb6, 0xf6, 0xb6, 0xf6, 0xf6, 0xb6, 0xf6, 0xb6, 0xf6, 0xf6, 0xb6, 0xf6, 0xb6, 0xf6, 0xf6, 0xbf, 0x00, 0x00, 0x00, 0x00, 0x00, 0x00, 0x1b, 0x1b, 0x1b, 0x1b, 0x1b, 0x1b, 0x1b, 0x1b, 0x1b, 0x1b, 0x1b, 0x1b, 0x1c, 0x1c, 0x1c, 0x1c, 0x1c, 0x1c		 //tile:37 
, 0x00, 0x00, 0x00, 0x00, 0x00, 0x00, 0xf6, 0xf6, 0xff, 0xf6, 0xff, 0xf6, 0xb6, 0xff, 0xb6, 0xff, 0xb6, 0xff, 0xf6, 0xf6, 0xff, 0xf6, 0xff, 0xf6, 0x00, 0x00, 0x00, 0x00, 0x00, 0x00, 0x1b, 0x00, 0x09, 0x12, 0x12, 0x12, 0x1b, 0x00, 0x09, 0x1a, 0x1a, 0x1a, 0x1c, 0x00, 0x11, 0x63, 0x63, 0x63		 //tile:38 
, 0x00, 0x00, 0x00, 0x00, 0x00, 0x00, 0xff, 0xff, 0xff, 0xff, 0xff, 0xff, 0xff, 0xff, 0xf6, 0xff, 0xff, 0xff, 0xff, 0xf6, 0xff, 0xff, 0xff, 0xff, 0x00, 0x00, 0x00, 0x00, 0x00, 0x00, 0x12, 0x12, 0x12, 0x12, 0x12, 0x12, 0x1a, 0x1a, 0x1a, 0x1a, 0x1a, 0x1a, 0x63, 0x63, 0x63, 0x63, 0x63, 0x63		 //tile:39 
, 0x00, 0x00, 0x00, 0x00, 0x00, 0x00, 0xff, 0xff, 0xff, 0xff, 0xff, 0xff, 0xff, 0xff, 0xff, 0xff, 0xff, 0xff, 0xff, 0xff, 0xff, 0xff, 0xff, 0xff, 0x00, 0x00, 0x00, 0x00, 0x00, 0x00, 0x08, 0x00, 0x00, 0x00, 0x00, 0x00, 0x09, 0x00, 0x00, 0x00, 0x00, 0x00, 0x09, 0x00, 0x00, 0x00, 0x00, 0x00		 //tile:40 
, 0x00, 0x00, 0x00, 0x00, 0x00, 0x00, 0xff, 0xff, 0xff, 0xff, 0xff, 0xff, 0xff, 0xff, 0xff, 0xff, 0xff, 0xff, 0xff, 0xff, 0xff, 0xff, 0xff, 0xff, 0x00, 0x00, 0x00, 0x00, 0x00, 0x00, 0x00, 0x12, 0x12, 0x12, 0x11, 0x00, 0x00, 0x1a, 0x1a, 0x1a, 0x12, 0x00, 0x00, 0x63, 0x63, 0x63, 0x5b, 0x00		 //tile:41 
, 0x00, 0x00, 0x00, 0x00, 0x00, 0x00, 0xff, 0xff, 0xff, 0xff, 0xff, 0xff, 0xff, 0xff, 0xff, 0xff, 0xf6, 0xff, 0xff, 0xff, 0xf6, 0xff, 0xff, 0xbf, 0x00, 0x00, 0x00, 0x00, 0x00, 0x00, 0x00, 0x00, 0x00, 0x00, 0x00, 0x00, 0x00, 0x00, 0x00, 0x00, 0x00, 0x00, 0x00, 0x00, 0x00, 0x00, 0x00, 0x00		 //tile:42 
, 0x00, 0x00, 0x00, 0x00, 0x00, 0x00, 0xff, 0xff, 0xf6, 0xff, 0xf6, 0xf6, 0xf6, 0xf6, 0xff, 0xb6, 0xf6, 0xbf, 0xff, 0xbf, 0xf6, 0xff, 0xf6, 0xf6, 0x00, 0x00, 0x00, 0x00, 0x00, 0x00, 0x09, 0x12, 0x12, 0x12, 0x09, 0x00, 0x09, 0x1a, 0x1a, 0x1a, 0x09, 0x00, 0x11, 0x63, 0x63, 0x63, 0x11, 0x00		 //tile:43 
, 0x00, 0x00, 0x00, 0x00, 0x00, 0x00, 0xf6, 0xf6, 0xb6, 0xf6, 0xb6, 0xf6, 0xf6, 0xb6, 0xf6, 0xb6, 0xf6, 0xb6, 0xb6, 0xf6, 0xf6, 0xb6, 0xf6, 0xad, 0x00, 0x00, 0x00, 0x00, 0x00, 0x00, 0x09, 0x12, 0x12, 0x12, 0x12, 0x11, 0x09, 0x1a, 0x1a, 0x1a, 0x1a, 0x1a, 0x11, 0x63, 0x63, 0x63, 0x63, 0x63		 //tile:44 
, 0x00, 0x00, 0x00, 0x00, 0x00, 0x00, 0xb6, 0xed, 0xb6, 0xad, 0xad, 0xad, 0xed, 0xb6, 0xad, 0xb6, 0xed, 0xad, 0xb6, 0xed, 0xb6, 0xed, 0xad, 0xad, 0x00, 0x00, 0x00, 0x00, 0x00, 0x00, 0x00, 0x00, 0x00, 0x00, 0x00, 0x00, 0x09, 0x00, 0x00, 0x00, 0x00, 0x00, 0x63, 0x09, 0x00, 0x00, 0x00, 0x00		 //tile:45 
, 0x00, 0x00, 0x00, 0x00, 0x00, 0x00, 0xad, 0xad, 0xad, 0xad, 0xad, 0xa4, 0xad, 0xad, 0xad, 0xad, 0xa4, 0xa4, 0xad, 0xad, 0xad, 0xa4, 0xad, 0xa4, 0x00, 0x00, 0x00, 0x00, 0x00, 0x00, 0x11, 0x12, 0x12, 0x12, 0x00, 0x09, 0x12, 0x1a, 0x1a, 0x1a, 0x00, 0x09, 0x5b, 0x63, 0x63, 0x63, 0x00, 0x11		 //tile:46 
, 0x00, 0x00, 0x00, 0x00, 0x00, 0x00, 0xa4, 0xa4, 0xa4, 0x64, 0x9b, 0x5b, 0xa4, 0x64, 0x64, 0x9b, 0x5b, 0x5b, 0x64, 0xa4, 0x9b, 0x64, 0x9b, 0x5b, 0x00, 0x00, 0x00, 0x00, 0x00, 0x00, 0x12, 0x12, 0x12, 0x12, 0x12, 0x12, 0x1a, 0x1a, 0x1a, 0x1a, 0x1a, 0x1a, 0x63, 0x63, 0x63, 0x63, 0x63, 0x63		 //tile:47 
, 0x00, 0x00, 0x00, 0x00, 0x00, 0x00, 0x5b, 0x5b, 0x52, 0x5b, 0x52, 0x52, 0x9b, 0x5b, 0x5b, 0x5b, 0x52, 0x52, 0x5b, 0x5b, 0x52, 0x52, 0x52, 0x52, 0x00, 0x00, 0x00, 0x00, 0x00, 0x00, 0x12, 0x12, 0x12, 0x12, 0x12, 0x12, 0x1a, 0x1a, 0x1a, 0x1a, 0x1a, 0x1a, 0x63, 0x63, 0x63, 0x63, 0x63, 0x63		 //tile:48 
, 0x00, 0x00, 0x00, 0x00, 0x00, 0x00, 0x52, 0x52, 0x52, 0x52, 0x52, 0x52, 0x52, 0x52, 0x52, 0x12, 0x52, 0x52, 0x52, 0x52, 0x12, 0x52, 0x52, 0x52, 0x00, 0x00, 0x00, 0x00, 0x00, 0x00, 0x12, 0x12, 0x11, 0x00, 0x09, 0x12, 0x1a, 0x1a, 0x12, 0x00, 0x09, 0x1a, 0x63, 0x63, 0x5b, 0x00, 0x11, 0x63		 //tile:49 
, 0x00, 0x00, 0x00, 0x00, 0x00, 0x00, 0x52, 0x52, 0x52, 0x52, 0x52, 0x52, 0x12, 0x52, 0x52, 0x12, 0x52, 0x52, 0x52, 0x52, 0x52, 0x52, 0x52, 0x52, 0x00, 0x00, 0x00, 0x00, 0x00, 0x00, 0x12, 0x12, 0x09, 0x00, 0x00, 0x00, 0x1a, 0x1a, 0x09, 0x00, 0x00, 0x00, 0x63, 0x63, 0x11, 0x00, 0x00, 0x00		 //tile:50 
, 0x00, 0x00, 0x00, 0x00, 0x00, 0x00, 0x52, 0x52, 0x52, 0x52, 0x52, 0x52, 0x12, 0x52, 0x52, 0x12, 0x52, 0x52, 0x52, 0x52, 0x52, 0x52, 0x52, 0x52, 0x00, 0x00, 0x00, 0x00, 0x00, 0x00, 0x00, 0x00, 0x00, 0x00, 0x11, 0x12, 0x00, 0x00, 0x00, 0x00, 0x12, 0x1a, 0x00, 0x00, 0x00, 0x00, 0x5b, 0x63		 //tile:51 
, 0x00, 0x00, 0x00, 0x00, 0x00, 0x00, 0x52, 0x52, 0x52, 0x52, 0x52, 0x52, 0x12, 0x52, 0x52, 0x12, 0x52, 0x52, 0x52, 0x52, 0x52, 0x52, 0x52, 0x12, 0x00, 0x00, 0x00, 0x52, 0x52, 0x52, 0x12, 0x12, 0x00, 0x12, 0x52, 0x52, 0x1a, 0x1a, 0x00, 0x52, 0x52, 0x52, 0x63, 0x63, 0x00, 0x52, 0x52, 0x12		 //tile:52 
, 0x00, 0x52, 0x52, 0x52, 0x00, 0x12, 0x00, 0x52, 0x52, 0x52, 0x00, 0x12, 0x00, 0x52, 0x52, 0x52, 0x00, 0x1b, 0x00, 0x52, 0x52, 0x52, 0x00, 0x1b, 0x00, 0x52, 0x52, 0x52, 0x00, 0x5b, 0x00, 0x52, 0x52, 0x52, 0x00, 0x5b, 0x00, 0x52, 0x52, 0x52, 0x00, 0x5b, 0x00, 0x52, 0x52, 0x52, 0x00, 0x1b		 //tile:53 
, 0x24, 0x24, 0x24, 0x12, 0x00, 0x00, 0x2d, 0x2d, 0x2d, 0x12, 0x00, 0x00, 0x36, 0x36, 0x36, 0x1b, 0x00, 0x00, 0x3f, 0x3f, 0x3f, 0x1b, 0x00, 0x00, 0xbf, 0xbf, 0xbf, 0x5b, 0x00, 0x00, 0xff, 0xff, 0xff, 0x5b, 0x00, 0x00, 0x7f, 0x7f, 0x7f, 0x1b, 0x00, 0x00, 0x3f, 0x3f, 0x3f, 0x1b, 0x00, 0x00		 //tile:54 
, 0x00, 0x00, 0x00, 0x00, 0x00, 0x1c, 0x00, 0x00, 0x00, 0x00, 0x00, 0x24, 0x00, 0x00, 0x00, 0x00, 0x00, 0x2e, 0x00, 0x00, 0x00, 0x00, 0x00, 0x36, 0x00, 0x00, 0x00, 0x00, 0x00, 0xb6, 0x00, 0x00, 0x00, 0x00, 0x00, 0xf6, 0x00, 0x00, 0x00, 0x00, 0x00, 0x76, 0x00, 0x00, 0x00, 0x00, 0x00, 0x36		 //tile:55 
, 0x24, 0x24, 0x1c, 0x00, 0x00, 0x00, 0x2d, 0x2d, 0x24, 0x00, 0x00, 0x00, 0x36, 0x36, 0x2e, 0x00, 0x00, 0x00, 0x3f, 0x3f, 0x36, 0x00, 0x00, 0x00, 0xbf, 0xbf, 0xb6, 0x00, 0x00, 0x00, 0xff, 0xff, 0xf6, 0x00, 0x00, 0x00, 0x7f, 0x7f, 0x76, 0x00, 0x00, 0x00, 0x3f, 0x3f, 0x36, 0x00, 0x00, 0x00		 //tile:56 
, 0x00, 0x00, 0x00, 0x00, 0x00, 0x00, 0x00, 0x00, 0x00, 0x00, 0x00, 0x00, 0x00, 0x00, 0x00, 0x00, 0x00, 0x12, 0x00, 0x00, 0x00, 0x00, 0x09, 0x3f, 0x00, 0x00, 0x00, 0x00, 0xb6, 0xbf, 0x00, 0x00, 0x00, 0xad, 0xff, 0xff, 0x00, 0x00, 0x5b, 0x7f, 0x7f, 0x7f, 0x00, 0x12, 0x3f, 0x3f, 0x3f, 0x2d		 //tile:57 
, 0x00, 0x1b, 0x24, 0x24, 0x24, 0x12, 0x1b, 0x2d, 0x2d, 0x2d, 0x1b, 0x00, 0x36, 0x36, 0x36, 0x2d, 0x00, 0x00, 0x3f, 0x3f, 0x3f, 0x09, 0x00, 0x00, 0xbf, 0xbf, 0x09, 0x00, 0x00, 0x00, 0xff, 0x5b, 0x00, 0x00, 0x00, 0x00, 0x64, 0x00, 0x00, 0x00, 0x00, 0x00, 0x00, 0x00, 0x00, 0x00, 0x00, 0x00		 //tile:58 
, 0x00, 0x00, 0x00, 0x00, 0x00, 0x00, 0x00, 0x00, 0x00, 0x00, 0x00, 0x00, 0x00, 0x00, 0x00, 0x00, 0x00, 0x00, 0x00, 0x00, 0x00, 0x1b, 0x3f, 0x3f, 0x00, 0x00, 0x00, 0x5b, 0xbf, 0xbf, 0x00, 0x00, 0x00, 0x5b, 0xff, 0xff, 0x00, 0x00, 0x00, 0x5b, 0x7f, 0x7f, 0x00, 0x00, 0x00, 0x1b, 0x3f, 0x3f		 //tile:59 
, 0x00, 0x13, 0x24, 0x24, 0x24, 0x09, 0x00, 0x1b, 0x2d, 0x2d, 0x2d, 0x09, 0x00, 0x24, 0x36, 0x36, 0x36, 0x09, 0x3f, 0x3f, 0x3f, 0x3f, 0x3f, 0x3f, 0xbf, 0xbf, 0xbf, 0xbf, 0xbf, 0xbf, 0xff, 0xff, 0xff, 0xff, 0xff, 0xff, 0x7f, 0x1b, 0x00, 0x00, 0x00, 0x00, 0x3f, 0x1b, 0x00, 0x00, 0x00, 0x00		 //tile:60 
, 0x00, 0x00, 0x00, 0x00, 0x00, 0x00, 0x00, 0x00, 0x00, 0x00, 0x00, 0x00, 0x00, 0x00, 0x00, 0x00, 0x00, 0x00, 0x3f, 0x3f, 0x09, 0x00, 0x00, 0x00, 0xbf, 0xbf, 0x09, 0x00, 0x00, 0x00, 0xff, 0xff, 0x09, 0x00, 0x00, 0x00, 0x00, 0x00, 0x00, 0x00, 0x00, 0x00, 0x00, 0x00, 0x00, 0x00, 0x00, 0x00		 //tile:61 
, 0x00, 0x00, 0x52, 0x6c, 0x6c, 0x6c, 0x00, 0x00, 0x52, 0x6d, 0x6d, 0x6d, 0x00, 0x00, 0x5a, 0xb5, 0xb5, 0xb5, 0x00, 0x00, 0x5b, 0xb6, 0xb6, 0xb6, 0x00, 0x00, 0x5b, 0xff, 0xff, 0xff, 0x00, 0x00, 0x00, 0x00, 0x00, 0x00, 0x00, 0x00, 0x00, 0x00, 0x00, 0x00, 0x00, 0x00, 0x00, 0x00, 0x00, 0x00		 //tile:62 
, 0x12, 0x00, 0x00, 0x00, 0x00, 0x00, 0x52, 0x00, 0x00, 0x00, 0x00, 0x00, 0xb5, 0xb5, 0xb5, 0xb5, 0xb5, 0xb5, 0xb6, 0xb6, 0xb6, 0xb6, 0xb6, 0xb6, 0xff, 0xff, 0xff, 0xff, 0xff, 0xff, 0x00, 0x00, 0x00, 0x00, 0x00, 0x00, 0x00, 0x00, 0x00, 0x00, 0x00, 0x00, 0x00, 0x00, 0x00, 0x00, 0x00, 0x00		 //tile:63 
, 0x00, 0x00, 0x00, 0x00, 0x00, 0x00, 0x00, 0x00, 0x00, 0x00, 0x00, 0x00, 0xb5, 0xb5, 0xb5, 0xb5, 0xb5, 0xad, 0xb6, 0xb6, 0xb6, 0xb6, 0xb6, 0xad, 0xff, 0xff, 0xff, 0xff, 0xff, 0xf6, 0x00, 0x00, 0xb6, 0xff, 0xff, 0xb6, 0x00, 0x00, 0xad, 0xb6, 0xb6, 0xad, 0x00, 0x00, 0xad, 0xb5, 0xb5, 0xad		 //tile:64 
, 0x00, 0x6c, 0x6c, 0x6c, 0x64, 0x00, 0x00, 0x6d, 0x6d, 0x6d, 0x6c, 0x00, 0x00, 0xb5, 0xb5, 0xb5, 0xad, 0x00, 0x00, 0xb6, 0xb6, 0xb6, 0xad, 0x00, 0x00, 0xff, 0xff, 0xff, 0xff, 0xff, 0x00, 0xff, 0xff, 0xff, 0xff, 0xff, 0x00, 0xb6, 0xb6, 0xb6, 0xb6, 0xb6, 0x00, 0x00, 0x00, 0x00, 0x00, 0x00		 //tile:65 
, 0x00, 0x00, 0x00, 0x00, 0x00, 0x00, 0x00, 0x00, 0x00, 0x00, 0x00, 0x00, 0x00, 0x00, 0x00, 0x00, 0x00, 0x00, 0x00, 0x00, 0x00, 0x00, 0x00, 0x00, 0xff, 0xff, 0xff, 0xff, 0xff, 0xff, 0xff, 0xff, 0xff, 0xff, 0xff, 0xff, 0xb6, 0xb6, 0xb6, 0xb6, 0xb6, 0xb6, 0x51, 0xb5, 0xb5, 0xb5, 0x5b, 0x00		 //tile:66 
, 0x12, 0x6c, 0x6c, 0x6c, 0x12, 0x00, 0x52, 0x6d, 0x6d, 0x6d, 0x52, 0x00, 0x52, 0xb5, 0xb5, 0xb5, 0x52, 0x00, 0x52, 0xb6, 0xb6, 0xb6, 0x52, 0x00, 0xff, 0xff, 0xff, 0xff, 0x5b, 0x00, 0xff, 0xff, 0xff, 0xff, 0x5b, 0x00, 0xb6, 0xb6, 0xb6, 0xb6, 0x5a, 0x00, 0x00, 0x00, 0x00, 0x00, 0x00, 0x00		 //tile:67 
, 0x52, 0x6c, 0x6c, 0x6c, 0x6c, 0x6c, 0x52, 0x6d, 0x6d, 0x6d, 0x6c, 0x6d, 0x5a, 0xb5, 0xb5, 0xb5, 0x52, 0xad, 0x5b, 0xb6, 0xb6, 0xb6, 0x52, 0x52, 0x5b, 0xff, 0xff, 0xff, 0x52, 0x00, 0x5b, 0xff, 0xff, 0xff, 0x52, 0x00, 0x5b, 0xb6, 0xb6, 0xb6, 0x52, 0x00, 0x5b, 0xb5, 0xb5, 0xb5, 0x51, 0x00		 //tile:68 
, 0x6c, 0x63, 0x00, 0x00, 0x00, 0x00, 0x6d, 0x6d, 0x52, 0x00, 0x00, 0x00, 0xb5, 0xb5, 0xad, 0x09, 0x00, 0x00, 0xb6, 0xb6, 0xb6, 0xac, 0x00, 0x00, 0xad, 0xff, 0xff, 0xff, 0x5b, 0x00, 0x09, 0xf6, 0xff, 0xff, 0xf6, 0x00, 0x00, 0x5a, 0xb6, 0xb6, 0xb6, 0x64, 0x00, 0x00, 0x64, 0xb5, 0xb5, 0xb5		 //tile:69 
, 0x64, 0x6c, 0x6c, 0x6c, 0x00, 0x00, 0x6c, 0x6d, 0x6d, 0x6d, 0x00, 0x00, 0xad, 0xb5, 0xb5, 0xb5, 0x00, 0x00, 0xad, 0xb6, 0xb6, 0xb6, 0x00, 0x00, 0xf6, 0xff, 0xff, 0xff, 0x00, 0x00, 0xb6, 0xff, 0xff, 0xff, 0x00, 0x00, 0xad, 0xb6, 0xb6, 0xb6, 0x00, 0x00, 0xb5, 0xb5, 0xb5, 0xb5, 0x00, 0x00		 //tile:70 
, 0x00, 0x00, 0x00, 0x00, 0x00, 0x5a, 0x00, 0x00, 0x00, 0x00, 0x00, 0x5b, 0x00, 0x00, 0x00, 0x00, 0x00, 0x5b, 0x00, 0x00, 0x00, 0x00, 0x00, 0x63, 0x00, 0x00, 0x00, 0x00, 0x00, 0xa4, 0x00, 0x00, 0x00, 0x00, 0x00, 0xa4, 0x00, 0x00, 0x00, 0x00, 0x00, 0x64, 0x00, 0x00, 0x00, 0x00, 0x00, 0x63		 //tile:71 
, 0x6c, 0x6c, 0x6c, 0x09, 0x00, 0x00, 0x6d, 0x6d, 0x6d, 0x09, 0x00, 0x00, 0xb5, 0xb5, 0xb5, 0x09, 0x00, 0x00, 0xb6, 0xb6, 0xb6, 0x09, 0x00, 0x00, 0xff, 0xff, 0xff, 0x09, 0x00, 0x00, 0xff, 0xff, 0xff, 0x09, 0x00, 0x00, 0xb6, 0xb6, 0xb6, 0x09, 0x00, 0x00, 0xb5, 0xb5, 0xb5, 0x09, 0x00, 0x00		 //tile:72 
, 0x00, 0x00, 0x00, 0x00, 0x52, 0x6c, 0x00, 0x00, 0x00, 0x00, 0x52, 0x6d, 0x00, 0x00, 0x00, 0x00, 0x5a, 0xb5, 0x00, 0x00, 0x00, 0x00, 0x5b, 0xb6, 0x00, 0x00, 0x00, 0x00, 0x5b, 0xff, 0x00, 0x00, 0x00, 0x00, 0x5b, 0xff, 0x00, 0x00, 0x00, 0x00, 0x5b, 0xb6, 0x00, 0x00, 0x00, 0x00, 0x5b, 0xb5		 //tile:73 
, 0x6c, 0x6c, 0x12, 0x00, 0x00, 0x00, 0x6d, 0x6d, 0x52, 0x00, 0x00, 0x00, 0xb5, 0xb5, 0x52, 0x00, 0x00, 0x00, 0xb6, 0xb6, 0xb6, 0xb6, 0xb6, 0xb6, 0xff, 0xff, 0xff, 0xff, 0xff, 0xff, 0xff, 0xff, 0xff, 0xff, 0xff, 0xff, 0xb6, 0xb6, 0x5a, 0x00, 0x00, 0x00, 0xb5, 0xb5, 0x52, 0x00, 0x00, 0x00		 //tile:74 
, 0x00, 0x00, 0x00, 0x00, 0x64, 0x6c, 0x00, 0x00, 0x00, 0x00, 0x6c, 0x6d, 0x00, 0x00, 0x00, 0x00, 0xad, 0xb5, 0xb6, 0xb6, 0xb6, 0xb6, 0xb6, 0xb6, 0xff, 0xff, 0xff, 0xff, 0xff, 0xff, 0xff, 0xff, 0xff, 0xff, 0xff, 0xff, 0x00, 0x00, 0x00, 0x00, 0xb6, 0xb6, 0x00, 0x00, 0x00, 0x00, 0xb5, 0xb5		 //tile:75 
, 0x6c, 0x6c, 0x00, 0x52, 0x52, 0x52, 0x6d, 0x6d, 0x00, 0x12, 0x52, 0x52, 0xb5, 0xb5, 0x00, 0x52, 0x52, 0x52, 0xb6, 0xb6, 0x00, 0x52, 0x52, 0x12, 0xff, 0xff, 0x00, 0x52, 0x52, 0x52, 0xff, 0xff, 0x00, 0x12, 0x52, 0x52, 0xb6, 0xb6, 0x00, 0x52, 0x52, 0x52, 0xb5, 0xb5, 0x00, 0x52, 0x52, 0x12		 //tile:76 
, 0x00, 0x52, 0x52, 0x52, 0x00, 0x13, 0x00, 0x52, 0x52, 0x52, 0x00, 0x12, 0x00, 0x52, 0x52, 0x52, 0x00, 0x12, 0x00, 0x52, 0x52, 0x52, 0x00, 0x0a, 0x00, 0x52, 0x52, 0x52, 0x00, 0x00, 0x00, 0x52, 0x52, 0x52, 0x52, 0x52, 0x00, 0x52, 0x52, 0x52, 0x52, 0x52, 0x00, 0x52, 0x52, 0x12, 0x52, 0x52		 //tile:77 
, 0x2e, 0x2e, 0x2e, 0x12, 0x00, 0x00, 0x25, 0x25, 0x25, 0x25, 0x25, 0x25, 0x24, 0x24, 0x24, 0x24, 0x24, 0x24, 0x1c, 0x1c, 0x1c, 0x1c, 0x1c, 0x1c, 0x00, 0x00, 0x00, 0x00, 0x00, 0x00, 0x52, 0x52, 0x52, 0x52, 0x52, 0x52, 0x52, 0x52, 0x52, 0x52, 0x52, 0x52, 0x52, 0x52, 0x52, 0x52, 0x52, 0x52		 //tile:78 
, 0x00, 0x00, 0x00, 0x00, 0x00, 0x2d, 0x25, 0x25, 0x25, 0x25, 0x25, 0x25, 0x24, 0x24, 0x24, 0x24, 0x24, 0x24, 0x1c, 0x1c, 0x1c, 0x1c, 0x1c, 0x1c, 0x00, 0x00, 0x00, 0x00, 0x00, 0x00, 0x52, 0x52, 0x52, 0x52, 0x52, 0x52, 0x52, 0x52, 0x52, 0x52, 0x52, 0x52, 0x52, 0x52, 0x52, 0x52, 0x52, 0x52		 //tile:79 
, 0x2e, 0x2e, 0x2d, 0x00, 0x00, 0x00, 0x25, 0x25, 0x24, 0x00, 0x00, 0x00, 0x24, 0x24, 0x1c, 0x00, 0x00, 0x13, 0x1c, 0x1c, 0x1c, 0x00, 0x12, 0x1c, 0x00, 0x00, 0x00, 0x00, 0x00, 0x00, 0x52, 0x52, 0x52, 0x52, 0x52, 0x52, 0x52, 0x52, 0x52, 0x52, 0x52, 0x52, 0x52, 0x52, 0x52, 0x52, 0x52, 0x53		 //tile:80 
, 0x09, 0x2d, 0x2e, 0x2e, 0x2d, 0x00, 0x1c, 0x25, 0x25, 0x25, 0x25, 0x25, 0x24, 0x24, 0x24, 0x24, 0x24, 0x24, 0x1c, 0x1c, 0x1c, 0x1c, 0x1c, 0x1c, 0x00, 0x00, 0x00, 0x00, 0x00, 0x00, 0x52, 0x53, 0x5a, 0x5b, 0x5b, 0x5b, 0x5a, 0x52, 0x5b, 0x53, 0x5b, 0x9b, 0x52, 0x5b, 0x52, 0x5b, 0x9b, 0x5b		 //tile:81 
, 0x00, 0x00, 0x00, 0x00, 0x00, 0x00, 0x25, 0x25, 0x25, 0x25, 0x25, 0x25, 0x24, 0x24, 0x24, 0x24, 0x24, 0x24, 0x1c, 0x1c, 0x1c, 0x1c, 0x1c, 0x1c, 0x00, 0x00, 0x00, 0x00, 0x00, 0x00, 0x5b, 0x9b, 0x64, 0xa4, 0xa4, 0xa4, 0x5b, 0xa4, 0x5b, 0xa4, 0x64, 0xa4, 0x5b, 0x5b, 0xa4, 0xa4, 0xa4, 0xa4		 //tile:82 
, 0x00, 0x00, 0x00, 0x13, 0x2e, 0x2e, 0x25, 0x24, 0x00, 0x12, 0x25, 0x25, 0x24, 0x1c, 0x00, 0x12, 0x24, 0x24, 0x1c, 0x1c, 0x00, 0x0a, 0x1c, 0x1c, 0x00, 0x00, 0x00, 0x00, 0x00, 0x00, 0xa4, 0xad, 0xad, 0xad, 0xad, 0xad, 0xad, 0xa4, 0xad, 0xad, 0xad, 0xad, 0xa4, 0xad, 0xad, 0xad, 0xed, 0xad		 //tile:83 
, 0x2e, 0x12, 0x00, 0x00, 0x00, 0x00, 0x25, 0x25, 0x25, 0x25, 0x25, 0x25, 0x24, 0x24, 0x24, 0x24, 0x24, 0x24, 0x1c, 0x1c, 0x1c, 0x1c, 0x1c, 0x1c, 0x00, 0x00, 0x00, 0x00, 0x00, 0x00, 0xad, 0xad, 0xb6, 0xad, 0xb6, 0xf6, 0xad, 0xf6, 0xad, 0xee, 0xf6, 0xad, 0xed, 0xad, 0xb6, 0xb5, 0xae, 0xf6		 //tile:84 
, 0x00, 0x00, 0x00, 0x00, 0x00, 0x00, 0x25, 0x25, 0x25, 0x25, 0x25, 0x25, 0x24, 0x24, 0x24, 0x24, 0x24, 0x24, 0x1c, 0x1c, 0x1c, 0x1c, 0x1c, 0x1c, 0x00, 0x00, 0x00, 0x00, 0x00, 0x00, 0xb6, 0xf6, 0xb6, 0xf6, 0xb6, 0xf6, 0xf6, 0xb6, 0xf6, 0xb6, 0xf6, 0xfe, 0xb6, 0xf6, 0xb6, 0xf6, 0xf6, 0xb7		 //tile:85 
, 0x00, 0x00, 0x00, 0x00, 0x00, 0x00, 0x24, 0x00, 0x52, 0x6c, 0x6c, 0x6c, 0x1c, 0x00, 0x52, 0x6c, 0x6c, 0x6c, 0x1c, 0x00, 0x11, 0x5b, 0x5b, 0x5b, 0x00, 0x00, 0x00, 0x00, 0x00, 0x00, 0xf6, 0xf6, 0xff, 0xf6, 0xff, 0xfe, 0xb6, 0xff, 0xb6, 0xf7, 0xbe, 0xf7, 0xf6, 0xf6, 0xff, 0xfe, 0xf7, 0xfe		 //tile:86 
, 0x00, 0x00, 0x00, 0x00, 0x00, 0x00, 0x6c, 0x6c, 0x6c, 0x6c, 0x6c, 0x6c, 0x6c, 0x6c, 0x6c, 0x6c, 0x6c, 0x6c, 0x5b, 0x5b, 0x5b, 0x5b, 0x5b, 0x5b, 0x00, 0x00, 0x00, 0x00, 0x00, 0x00, 0xff, 0xff, 0xff, 0xff, 0xff, 0xff, 0xff, 0xf7, 0xfe, 0xff, 0xff, 0xff, 0xff, 0xfe, 0xff, 0xf7, 0xff, 0xff		 //tile:87 
, 0x00, 0x00, 0x6c, 0xb5, 0xb5, 0x6c, 0x6c, 0x6c, 0x6c, 0x6c, 0x6c, 0x6c, 0x6c, 0x6c, 0x6c, 0x6c, 0x6c, 0x64, 0x5b, 0x5b, 0x5b, 0x5b, 0x5b, 0x5a, 0x00, 0x00, 0x00, 0x00, 0x00, 0x00, 0xff, 0xff, 0xff, 0xff, 0xff, 0xff, 0xff, 0xff, 0xff, 0xff, 0xff, 0xff, 0xff, 0xff, 0xff, 0xff, 0xff, 0xff		 //tile:88 
, 0x00, 0x00, 0x00, 0x00, 0x00, 0x00, 0x00, 0x00, 0x00, 0x00, 0x00, 0x00, 0x00, 0x00, 0x00, 0x00, 0x00, 0x00, 0x00, 0x00, 0x00, 0x00, 0x00, 0x00, 0x00, 0x00, 0x00, 0x00, 0x00, 0x00, 0xff, 0xff, 0xff, 0xff, 0xff, 0xff, 0xff, 0xff, 0xff, 0xff, 0xff, 0xff, 0xff, 0xff, 0xff, 0xff, 0xff, 0xff		 //tile:89 
, 0x09, 0xb5, 0xb5, 0xb5, 0x5a, 0x00, 0x09, 0x6c, 0x6c, 0x6c, 0x52, 0x00, 0x09, 0x6c, 0x6c, 0x6c, 0x52, 0x00, 0x09, 0x5b, 0x5b, 0x5b, 0x11, 0x00, 0x00, 0x00, 0x00, 0x00, 0x00, 0x00, 0xff, 0xff, 0xff, 0xff, 0xff, 0xff, 0xff, 0xff, 0xff, 0xff, 0xf6, 0xff, 0xff, 0xff, 0xfe, 0xf7, 0xff, 0xff		 //tile:90 
, 0x00, 0x00, 0x00, 0x00, 0x00, 0x00, 0x00, 0x00, 0x00, 0x00, 0x00, 0x00, 0x00, 0x00, 0x00, 0x00, 0x00, 0x00, 0x00, 0x00, 0x00, 0x00, 0x00, 0x00, 0x00, 0x00, 0x00, 0x00, 0x00, 0x00, 0xff, 0xff, 0xf6, 0xff, 0xf6, 0xf6, 0xf6, 0xf6, 0xbf, 0xf6, 0xb6, 0xff, 0xbf, 0xff, 0xf6, 0xff, 0xf6, 0xf6		 //tile:91 
, 0x5a, 0xb5, 0xb5, 0xb5, 0x09, 0x00, 0x52, 0x6c, 0x6c, 0x6c, 0x09, 0x00, 0x52, 0x6c, 0x6c, 0x6c, 0x09, 0x00, 0x11, 0x5b, 0x5b, 0x5b, 0x09, 0x00, 0x00, 0x00, 0x00, 0x00, 0x00, 0x00, 0xf6, 0xb6, 0xf6, 0xf6, 0xb6, 0xf6, 0xb6, 0xf6, 0xb6, 0xf6, 0xb6, 0xf6, 0xf6, 0xb6, 0xf6, 0xb6, 0xf6, 0xad		 //tile:92 
, 0x00, 0x00, 0x09, 0xad, 0xb5, 0xb5, 0x00, 0x00, 0x00, 0x52, 0x6c, 0x6c, 0x00, 0x00, 0x00, 0x00, 0x5b, 0x6c, 0x00, 0x00, 0x00, 0x00, 0x00, 0x5a, 0x00, 0x00, 0x00, 0x00, 0x00, 0x00, 0xb6, 0xed, 0xb6, 0xad, 0xad, 0xad, 0xad, 0xb6, 0xed, 0xb6, 0xed, 0xad, 0xf6, 0xad, 0xb6, 0xad, 0xad, 0xad		 //tile:93 
, 0xb5, 0xb5, 0xb5, 0xb5, 0x00, 0x00, 0x6c, 0x6c, 0x6c, 0x6c, 0x00, 0x00, 0x6c, 0x6c, 0x6c, 0x6c, 0x00, 0x00, 0x5b, 0x5b, 0x5b, 0x5b, 0x00, 0x00, 0x00, 0x00, 0x00, 0x00, 0x00, 0x00, 0xad, 0xad, 0xad, 0xad, 0xad, 0xa4, 0xad, 0xad, 0xad, 0xad, 0xa4, 0xa4, 0xad, 0xad, 0xad, 0xa4, 0xad, 0xa4		 //tile:94 
, 0x00, 0x00, 0x00, 0x00, 0x00, 0x5b, 0x00, 0x00, 0x00, 0x00, 0x00, 0x5b, 0x00, 0x00, 0x00, 0x00, 0x00, 0x5a, 0x00, 0x00, 0x00, 0x00, 0x00, 0x12, 0x00, 0x00, 0x00, 0x00, 0x00, 0x00, 0xa4, 0xa4, 0xa4, 0x64, 0x9b, 0x5b, 0xa4, 0x64, 0x64, 0x9b, 0x5b, 0x5b, 0x64, 0xa4, 0x9b, 0x64, 0x9b, 0x5b		 //tile:95 
, 0xb5, 0xb5, 0xb5, 0x09, 0x00, 0x00, 0x6c, 0x6c, 0x6c, 0x09, 0x00, 0x00, 0x6c, 0x6c, 0x6c, 0x09, 0x00, 0x00, 0x5b, 0x5b, 0x5b, 0x00, 0x00, 0x00, 0x00, 0x00, 0x00, 0x00, 0x00, 0x00, 0x5b, 0x5b, 0x5a, 0x5b, 0x52, 0x52, 0x9b, 0x5b, 0x5b, 0x53, 0x52, 0x52, 0x5b, 0x5b, 0x52, 0x52, 0x5a, 0x52		 //tile:96 
, 0x00, 0x00, 0x00, 0x00, 0x5a, 0xb5, 0x00, 0x00, 0x00, 0x00, 0x52, 0x6c, 0x00, 0x00, 0x00, 0x00, 0x52, 0x6c, 0x00, 0x00, 0x00, 0x00, 0x11, 0x5b, 0x00, 0x00, 0x00, 0x00, 0x00, 0x00, 0x52, 0x52, 0x52, 0x52, 0x52, 0x52, 0x52, 0x52, 0x52, 0x52, 0x52, 0x52, 0x52, 0x12, 0x52, 0x12, 0x52, 0x52		 //tile:97 
, 0xb5, 0xb5, 0x52, 0x00, 0x00, 0x00, 0x6c, 0x6c, 0x52, 0x00, 0x00, 0x00, 0x6c, 0x6c, 0x12, 0x00, 0x00, 0x00, 0x5b, 0x5b, 0x09, 0x00, 0x00, 0x00, 0x00, 0x00, 0x00, 0x00, 0x00, 0x00, 0x52, 0x52, 0x52, 0x52, 0x52, 0x52, 0x12, 0x52, 0x52, 0x12, 0x52, 0x52, 0x52, 0x52, 0x52, 0x52, 0x52, 0x52		 //tile:98 
, 0x00, 0x00, 0x00, 0x00, 0xb5, 0xb5, 0x00, 0x00, 0x00, 0x00, 0x6c, 0x6c, 0x00, 0x00, 0x00, 0x00, 0x6c, 0x6c, 0x00, 0x00, 0x00, 0x00, 0x5b, 0x5b, 0x00, 0x00, 0x00, 0x00, 0x00, 0x00, 0x52, 0x52, 0x52, 0x52, 0x52, 0x52, 0x12, 0x52, 0x52, 0x12, 0x52, 0x52, 0x52, 0x52, 0x52, 0x52, 0x52, 0x52		 //tile:99 
, 0xb5, 0xb5, 0x00, 0x52, 0x52, 0x52, 0x6c, 0x6c, 0x00, 0x12, 0x52, 0x52, 0x6c, 0x6c, 0x00, 0x52, 0x52, 0x52, 0x5b, 0x5b, 0x00, 0x52, 0x52, 0x12, 0x00, 0x00, 0x00, 0x52, 0x52, 0x52, 0x52, 0x52, 0x52, 0x12, 0x52, 0x52, 0x12, 0x52, 0x52, 0x52, 0x52, 0x52, 0x52, 0x52, 0x11, 0x4a, 0x52, 0x12		 //tile:100 
};

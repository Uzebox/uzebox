
// Key: { Width, height, [sprite indexes] }

const char map200[2 * 1 + 2] PROGMEM=
{2,1,
    0,  1
};

const char map400[2 * 1 + 2] PROGMEM=
{2,1,
    2,  1
};

const char map800[2 * 1 + 2] PROGMEM=
{2,1,
    3,  1
};

const char map1600[2 * 1 + 2] PROGMEM=
{2,1,
    4,  5
};

const char map100[2 * 1 + 2] PROGMEM=
{2,1,
    6,  7
};

const char map300[2 * 1 + 2] PROGMEM=
{2,1,
    8,  7
};

const char map500[2 * 1 + 2] PROGMEM=
{2,1,
    9,  7
};

const char map700[2 * 1 + 2] PROGMEM=
{2,1,
   10,  7
};

const char map1000[2 * 1 + 2] PROGMEM=
{2,1,
   11, 12
};

const char map2000[2 * 1 + 2] PROGMEM=
{2,1,
   13, 12
};

const char map3000[2 * 1 + 2] PROGMEM=
{2,1,
   14, 12
};

const char map5000[2 * 1 + 2] PROGMEM=
{2,1,
   15, 12
};

const char mapGiantPacman0[2 * 2 + 2] PROGMEM=
{2,2,
   16, 17,
   18, 19
};

const char mapGiantPacman1[2 * 2 + 2] PROGMEM=
{2,2,
   16, 20,
   18, 21
};

const char mapGiantPacman2[2 * 2 + 2] PROGMEM=
{2,2,
   22, 23,
   24, 25
};

const char mapBlinkyNaked0[2 * 1 + 2] PROGMEM=
{2,1,
   26, 27
};

const char mapBlinkyNaked1[2 * 1 + 2] PROGMEM=
{2,1,
   28, 29
};

const char mapCurtainSml[1 * 1 + 2] PROGMEM=
{1,1,
   91
};

const char mapCurtainLge[2 * 2 + 2] PROGMEM=
{2,2,
   91,91,
   91,91
};


//////////////////
// Pacman
//////////////////
const char pacman_up[] PROGMEM ={
	30,31,35,31
};

const char pacman_lt[] PROGMEM ={
	30,34,38,34
};

const char pacman_dn[] PROGMEM ={
	30,33,37,33
};

const char pacman_rt[] PROGMEM ={
	30,32,36,32
};

const char pacman_die[] PROGMEM ={
	39,40,41,42,43,44,45,46,47,48
};

const char pacman_giant[] PROGMEM ={
	16,17,18,19,
	16,20,18,21,
	22,23,24,25,
	16,20,18,21
};

//////////////////
// Ghosts common
//////////////////
const char ghost_flee[] PROGMEM ={
	81,82
};

const char ghost_flash[] PROGMEM ={
	83,84,81,82
};

const char ghost_dead_up[] PROGMEM ={
	86
};

const char ghost_dead_lt[] PROGMEM ={
	87
};

const char ghost_dead_dn[] PROGMEM ={
	85
};

const char ghost_dead_rt[] PROGMEM ={
	88
};

//////////////////
// Blinky
//////////////////
const char blinky_up[] PROGMEM ={
	51,52
};

const char blinky_lt[] PROGMEM ={
	53,54
};

const char blinky_dn[] PROGMEM ={
	49,50
};

const char blinky_rt[] PROGMEM ={
	55,56
};

const char blinky_stitched[] PROGMEM ={
	89,90
};

const char blinky_exposed[] PROGMEM ={
	26,27,
	28,29
};

//////////////////
// Pinky
//////////////////
const char pinky_up[] PROGMEM ={
	75,76
};

const char pinky_lt[] PROGMEM ={
	77,78
};

const char pinky_dn[] PROGMEM ={
	73,74
};

const char pinky_rt[] PROGMEM ={
	79,80
};

//////////////////
// Inky
//////////////////
const char inky_up[] PROGMEM ={
	59,60
};

const char inky_lt[] PROGMEM ={
	61,62
};

const char inky_dn[] PROGMEM ={
	57,58
};

const char inky_rt[] PROGMEM ={
	63,64
};

//////////////////
// Clyde
//////////////////
const char clyde_up[] PROGMEM ={
	67,68
};

const char clyde_lt[] PROGMEM ={
	69,70
};

const char clyde_dn[] PROGMEM ={
	65,66
};

const char clyde_rt[] PROGMEM ={
	71,72
};

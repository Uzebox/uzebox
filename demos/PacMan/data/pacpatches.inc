
const char sfxPellet1[] PROGMEM ={ 
0,PC_WAVE,1,
0,PC_PITCH,80,
0,PC_NOTE_DOWN,26, 
1,PC_NOTE_UP,3,
1,PC_NOTE_UP,3, 
1,PC_NOTE_UP,3, 
1,PC_NOTE_UP,4, 
1,PC_NOTE_DOWN,16, 
1,PC_NOTE_CUT,0,
0,PATCH_END
};

const char sfxPellet2[] PROGMEM ={ 
0,PC_WAVE,1,
0,PC_PITCH,80,
0,PC_NOTE_DOWN,29, 
1,PC_NOTE_UP,3,
1,PC_NOTE_UP,3, 
1,PC_NOTE_UP,3, 
1,PC_NOTE_UP,4, 
1,PC_NOTE_DOWN,13, 
1,PC_NOTE_CUT,0,
0,PATCH_END
};

const char sfxFruit[] PROGMEM ={ 
0,PC_WAVE,2,
0,PC_PITCH,80,
0,PC_NOTE_DOWN,18, 
1,PC_NOTE_DOWN,4, 
1,PC_NOTE_UP,1, 
1,PC_NOTE_UP,1, 
3,PC_NOTE_UP,1, 
1,PC_NOTE_DOWN,3, 
1,PC_NOTE_DOWN,3, 
1,PC_NOTE_DOWN,3, 
1,PC_NOTE_DOWN,3, 
3,PC_NOTE_UP,3, 
1,PC_NOTE_UP,3, 
1,PC_NOTE_UP,3, 
1,PC_NOTE_UP,3, 
1,PC_NOTE_DOWN,1, 
1,PC_NOTE_UP,1, 
1,PC_NOTE_UP,1, 
5,PC_NOTE_CUT,0,
0,PATCH_END
};

const char sfxPacmanDie[] PROGMEM ={	
0,PC_WAVE,8,
0,PC_NOTE_DOWN,1,
2,PC_NOTE_DOWN,1,
2,PC_NOTE_DOWN,1,
2,PC_NOTE_DOWN,1,
2,PC_NOTE_DOWN,1,
2,PC_NOTE_DOWN,1,
2,PC_NOTE_DOWN,1,
2,PC_NOTE_UP,1,
2,PC_NOTE_UP,1,
2,PC_NOTE_UP,1,
2,PC_NOTE_UP,1,
2,PC_NOTE_DOWN,1,
2,PC_NOTE_DOWN,1,
2,PC_NOTE_DOWN,1,
2,PC_NOTE_DOWN,1,
2,PC_NOTE_DOWN,1,
2,PC_NOTE_UP,1,
2,PC_NOTE_UP,1,
2,PC_NOTE_UP,1,
2,PC_NOTE_DOWN,1,
2,PC_NOTE_DOWN,1,
2,PC_NOTE_DOWN,1,
2,PC_NOTE_DOWN,1,
2,PC_NOTE_DOWN,1,
2,PC_NOTE_UP,1,
2,PC_NOTE_UP,1,
2,PC_NOTE_UP,1,
2,PC_NOTE_DOWN,1,
2,PC_NOTE_DOWN,1,
2,PC_NOTE_DOWN,1,
2,PC_NOTE_DOWN,1,
2,PC_NOTE_DOWN,1,
2,PC_NOTE_UP,1,
2,PC_NOTE_UP,1,
2,PC_NOTE_UP,1,
0,PC_WAVE,2,
0,PC_NOTE_UP,6,
3,PC_NOTE_UP,6,
3,PC_NOTE_UP,6,
3,PC_NOTE_UP,6,
3,PC_NOTE_DOWN,24,
0,PC_NOTE_UP,6,
3,PC_NOTE_UP,6,
3,PC_NOTE_UP,6,
3,PC_NOTE_UP,6,
3,PC_NOTE_CUT,0,
0,PATCH_END
};

const char sfxSirenSlow[] PROGMEM ={ 
0,PC_WAVE,2,
0,PC_NOTE_DOWN,18, 
1,PC_NOTE_UP,1, 
1,PC_NOTE_UP,1, 
1,PC_NOTE_UP,1, 
1,PC_NOTE_UP,1, 
1,PC_NOTE_UP,1, 
1,PC_NOTE_UP,1, 
1,PC_NOTE_UP,1, 
1,PC_NOTE_UP,1, 
1,PC_NOTE_UP,1, 
1,PC_NOTE_UP,1, 
1,PC_NOTE_UP,1, 
1,PC_NOTE_UP,1, 
1,PC_NOTE_UP,1, 
1,PC_NOTE_UP,1, 
1,PC_NOTE_UP,1, 
1,PC_NOTE_UP,1, 
1,PC_NOTE_DOWN,1,
1,PC_NOTE_DOWN,1,
1,PC_NOTE_DOWN,1,
1,PC_NOTE_DOWN,1,
1,PC_NOTE_DOWN,1,
1,PC_NOTE_DOWN,1,
1,PC_NOTE_DOWN,1,
1,PC_NOTE_DOWN,1,
1,PC_NOTE_DOWN,1,
1,PC_NOTE_DOWN,1,
1,PC_NOTE_DOWN,1,
1,PC_NOTE_DOWN,1,
1,PC_NOTE_DOWN,1,
1,PC_NOTE_DOWN,1,
1,PC_NOTE_DOWN,1,
1,PC_NOTE_CUT,0,
0,PATCH_END
};

const char sfxSirenMed[] PROGMEM ={ 
0,PC_WAVE,2,
0,PC_NOTE_DOWN,15, 
1,PC_NOTE_UP,1, 
1,PC_NOTE_UP,1, 
1,PC_NOTE_UP,1, 
1,PC_NOTE_UP,1, 
1,PC_NOTE_UP,1, 
1,PC_NOTE_UP,1, 
1,PC_NOTE_UP,1, 
1,PC_NOTE_UP,1, 
1,PC_NOTE_UP,1, 
1,PC_NOTE_UP,1, 
1,PC_NOTE_UP,1, 
1,PC_NOTE_UP,1, 
1,PC_NOTE_UP,1, 
1,PC_NOTE_UP,1, 
1,PC_NOTE_UP,1, 
1,PC_NOTE_UP,1, 
1,PC_NOTE_DOWN,1,
1,PC_NOTE_DOWN,1,
1,PC_NOTE_DOWN,1,
1,PC_NOTE_DOWN,1,
1,PC_NOTE_DOWN,1,
1,PC_NOTE_DOWN,1,
1,PC_NOTE_DOWN,1,
1,PC_NOTE_DOWN,1,
1,PC_NOTE_DOWN,1,
1,PC_NOTE_DOWN,1,
1,PC_NOTE_DOWN,1,
1,PC_NOTE_DOWN,1,
1,PC_NOTE_DOWN,1,
1,PC_NOTE_DOWN,1,
1,PC_NOTE_DOWN,1,
1,PC_NOTE_CUT,0,
0,PATCH_END
};

const char sfxSirenFast[] PROGMEM ={ 
0,PC_WAVE,2,
0,PC_NOTE_DOWN,12, 
1,PC_NOTE_UP,1, 
1,PC_NOTE_UP,1, 
1,PC_NOTE_UP,1, 
1,PC_NOTE_UP,1, 
1,PC_NOTE_UP,1, 
1,PC_NOTE_UP,1, 
1,PC_NOTE_UP,1, 
1,PC_NOTE_UP,1, 
1,PC_NOTE_UP,1, 
1,PC_NOTE_UP,1, 
1,PC_NOTE_UP,1, 
1,PC_NOTE_UP,1, 
1,PC_NOTE_UP,1, 
1,PC_NOTE_UP,1, 
1,PC_NOTE_UP,1, 
1,PC_NOTE_UP,1, 
1,PC_NOTE_DOWN,1,
1,PC_NOTE_DOWN,1,
1,PC_NOTE_DOWN,1,
1,PC_NOTE_DOWN,1,
1,PC_NOTE_DOWN,1,
1,PC_NOTE_DOWN,1,
1,PC_NOTE_DOWN,1,
1,PC_NOTE_DOWN,1,
1,PC_NOTE_DOWN,1,
1,PC_NOTE_DOWN,1,
1,PC_NOTE_DOWN,1,
1,PC_NOTE_DOWN,1,
1,PC_NOTE_DOWN,1,
1,PC_NOTE_DOWN,1,
1,PC_NOTE_DOWN,1,
1,PC_NOTE_CUT,0,
0,PATCH_END
};

const char sfxFrightened[] PROGMEM ={ 
0,PC_WAVE,2,
0,PC_PITCH,65,
0,PC_NOTE_DOWN,24, 
0,PC_ENV_SPEED,-12,
0,PC_NOTE_UP,5, 
1,PC_NOTE_UP,5, 
1,PC_NOTE_UP,5, 
1,PC_NOTE_UP,5, 
1,PC_NOTE_UP,5, 
1,PC_NOTE_UP,5, 
1,PC_NOTE_UP,5, 
1,PC_NOTE_UP,5, 
1,PC_NOTE_CUT,0,
0,PATCH_END
};

const char sfxKillGhost[] PROGMEM ={ 
0,PC_WAVE,4,
0,PC_ENV_SPEED,-3,
0,PC_PITCH,60,
1,PC_NOTE_DOWN,5, 
1,PC_NOTE_DOWN,4, 
1,PC_NOTE_DOWN,3, 
1,PC_NOTE_DOWN,2, 
1,PC_NOTE_DOWN,1,
0,PC_WAVE,4,
0,PC_TREMOLO_LEVEL,0x90, 
0,PC_TREMOLO_RATE,0x60, 
2,PC_NOTE_UP,5,
2,PC_NOTE_UP,5,
2,PC_NOTE_UP,5,
2,PC_NOTE_UP,4,
2,PC_NOTE_UP,4,
2,PC_NOTE_UP,4,
2,PC_NOTE_UP,3,
2,PC_NOTE_UP,3,
2,PC_NOTE_UP,3,
2,PC_NOTE_UP,2,
2,PC_NOTE_UP,2,
2,PC_NOTE_UP,2 ,
2,PC_NOTE_UP,2,
2,PC_NOTE_UP,2,
2,PC_NOTE_UP,2 ,
1,PC_NOTE_CUT,0,
0,PATCH_END
};

const char sfxDeadGhost[] PROGMEM ={ 
0,PC_WAVE,0,
0,PC_PITCH,85,
0,PC_NOTE_UP,12, 
1,PC_NOTE_DOWN,2,
1,PC_NOTE_DOWN,2,
1,PC_NOTE_DOWN,2,
1,PC_NOTE_DOWN,2,
1,PC_NOTE_DOWN,2,
1,PC_NOTE_DOWN,2,
1,PC_NOTE_DOWN,2,
1,PC_NOTE_DOWN,2,
1,PC_NOTE_DOWN,2,
1,PC_NOTE_DOWN,2,
1,PC_NOTE_DOWN,2,
1,PC_NOTE_DOWN,2,
1,PC_NOTE_DOWN,2,
1,PC_NOTE_DOWN,2,
1,PC_NOTE_DOWN,2,
1,PC_NOTE_CUT,0,
0,PATCH_END
};

const char sfxExtraLife[] PROGMEM ={ 
0,PC_WAVE,8,
0,PC_PITCH,73,
0,PC_ENV_SPEED,-12,
0,PATCH_END
};

const char newgameIns1[] PROGMEM ={ 
0,PC_WAVE,8,
0,PC_ENV_VOL,0xa0,
1,PC_NOTE_HOLD,0,
1,PC_ENV_SPEED,-32,
0,PATCH_END
};

const char newgameIns2[] PROGMEM ={ 
0,PC_WAVE,1 ,
0,PC_ENV_VOL,0x90,
1,PC_ENV_SPEED,-10,
0,PATCH_END
};


const char intermissionIns1[] PROGMEM ={ 
0,PC_WAVE,5 ,
0,PC_NOTE_DOWN,12,
0,PC_ENV_VOL,0x20,
0,PC_ENV_SPEED,20,
1,PC_ENV_SPEED,0,
4,PC_ENV_SPEED,-15,
0,PATCH_END
};

const char intermissionIns2[] PROGMEM ={ 
0,PC_WAVE,6,
0,PC_NOTE_DOWN,12,
0,PC_ENV_VOL,0xA0,
1,PC_ENV_SPEED,-15,
0,PATCH_END
};


const struct PatchStruct patches[] PROGMEM = {
{0,NULL,sfxPellet1,0,0},	// 00
{0,NULL,sfxPellet2,0,0},	// 01
{0,NULL,sfxFruit,0,0},		// 02
{0,NULL,sfxPacmanDie,0,0},	// 03
{0,NULL,sfxSirenSlow,0,0},	// 04
{0,NULL,sfxSirenMed,0,0},	// 05
{0,NULL,sfxSirenFast,0,0},	// 06
{0,NULL,sfxFrightened,0,0},	// 07
{0,NULL,sfxKillGhost,0,0},	// 08
{0,NULL,sfxDeadGhost,0,0},	// 09
{0,NULL,sfxExtraLife,0,0},	// 10
{0,NULL,newgameIns1,0,0},		// 11
{0,NULL,newgameIns2,0,0},		// 12
{0,NULL,intermissionIns1,0,0},		// 13
{0,NULL,intermissionIns2,0,0},		// 14

};

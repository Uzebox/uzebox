#define mapBoard_Width   (27)
#define mapBoard_Height  (25)

const char mapBoard[27 * 25 + 2] PROGMEM=
{mapBoard_Width,mapBoard_Height,
    0,  0,  0,  0,  1,  2,  2,  2,  2,  2,  2,  2,  2,  3,  2,  2,  2,  2,  2,
    2,  2,  2,  4,  0,  0,  0,  0,
    0,  0,  0,  0,  5,  6,  6,  6,  6,  6,  6,  6,  6,  7,  6,  6,  6,  6,  6,
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    0,  0,  0,  0,  0,  0,  0,  0
};

#define mapLives_Width   (1)
#define mapLives_Height  (1)

const char mapLives[1 * 1 + 2] PROGMEM=
{mapLives_Width,mapLives_Height,
   47
};

#define mapReady_Width   (5)
#define mapReady_Height  (1)

const char mapReady[5 * 1 + 2] PROGMEM=
{mapReady_Width,mapReady_Height,
   48, 49, 50, 51, 52
};

#define mapGameOver_Width   (7)
#define mapGameOver_Height  (1)

const char mapGameOver[7 * 1 + 2] PROGMEM=
{mapGameOver_Width,mapGameOver_Height,
   53, 54, 55, 56, 57, 58, 59
};

#define mapPlayerOne_Width   (7)
#define mapPlayerOne_Height  (1)

const char mapPlayerOne[7 * 1 + 2] PROGMEM=
{mapPlayerOne_Width,mapPlayerOne_Height,
   60, 61, 62, 63, 64, 65, 66
};

#define mapLvlCompleteB_Width   (19)
#define mapLvlCompleteB_Height  (22)

const char mapLvlCompleteB[19 * 22 + 2] PROGMEM=
{mapLvlCompleteB_Width,mapLvlCompleteB_Height,
    1,  2,  2,  2,  2,  2,  2,  2,  2,  3,  2,  2,  2,  2,  2,  2,  2,  2,  4,
    5,  0,  0,  0,  0,  0,  0,  0,  0,  7,  0,  0,  0,  0,  0,  0,  0,  0,  8,
    5,  0,  9, 10,  0,  9, 11, 10,  0,  7,  0,  9, 11, 10,  0,  9, 10,  0,  8,
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   22, 23, 23, 23, 23, 23, 23, 23, 23, 23, 23, 23, 23, 23, 23, 23, 23, 23, 28
};

#define mapLvlCompleteG_Width   (19)
#define mapLvlCompleteG_Height  (22)

const char mapLvlCompleteG[19 * 22 + 2] PROGMEM=
{mapLvlCompleteG_Width,mapLvlCompleteG_Height,
   67, 68, 68, 68, 68, 68, 68, 68, 68, 69, 68, 68, 68, 68, 68, 68, 68, 68, 70,
   71,  0,  0,  0,  0,  0,  0,  0,  0, 72,  0,  0,  0,  0,  0,  0,  0,  0, 73,
   71,  0, 74, 75,  0, 74, 76, 75,  0, 72,  0, 74, 76, 75,  0, 74, 75,  0, 73,
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   86, 87, 87, 87, 87, 87, 87, 87, 87, 87, 87, 87, 87, 87, 87, 87, 87, 87, 92
};

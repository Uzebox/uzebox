// LUTs for Uzebox Pacman

const speed spdLut[] PROGMEM = {
	{ SPEED_MODE_MOVE,SPEED_MODE_MOVE,21,0,0,0 },		// 0, 105%
	{ SPEED_MODE_MOVE,SPEED_MODE_MOVE,20,0,1,0 },		// 1, 100%
	{ SPEED_MODE_MOVE,SPEED_MODE_MOVE,9,0,1,0 },		// 2, 95%
	{ SPEED_MODE_MOVE,SPEED_MODE_MOVE,6,0,1,0 },		// 3, 90%
	{ SPEED_MODE_MOVE,SPEED_MODE_MOVE,4,0,1,0 },		// 4, 85%
	{ SPEED_MODE_PAUSE,SPEED_MODE_PAUSE,4,0,1,0 },		// 5, 80%
	{ SPEED_MODE_MOVE,SPEED_MODE_MOVE,5,0,2,0 },		// 6, 75%
	{ SPEED_MODE_MOVE,SPEED_MODE_MOVE,2,0,1,0 },		// 7, 70%
	{ SPEED_MODE_MOVE,SPEED_MODE_MOVE,3,0,3,0 },		// 8, 60%
	{ SPEED_MODE_MOVE,SPEED_MODE_MOVE,1,0,1,0 },			// 9, 55%
	{ SPEED_MODE_PAUSE,SPEED_MODE_PAUSE,1,0,1,0 },		// 10, 50%
	{ SPEED_MODE_PAUSE,SPEED_MODE_PAUSE,3,0,3,0 },		// 11, 45%
	{ SPEED_MODE_MOVE,SPEED_MODE_MOVE,2,0,3,0 }			// 12, 40%
};

// Index into speed lut. Pacman speed, Pacman fright speed
const u8 pacmanSpdLUT[] PROGMEM = {
	5, 3,		// level 1
	3, 2,		// levels 2-4
	1, 1,		// levels 5-20
	3, 3,		// levels 21+
	5, 2,		// intermissions
	5, 1		// intro
};

// Index into speed lut. Ghost speed, Ghost frightened speed, Ghost tunnel speed
const u8 ghostSpdLUT[] PROGMEM = {
	6, 10, 12,				// level 1
	4, 9, 11,				// levels 2-4
	2, 8, 10,				// levels 5-20
	2, 2, 10,				// levels 21+
	5, 3, 5,				// intermissions
	5, 6, 6				// intro
};

const u8 elroySpdLUT[] PROGMEM = {
	5, 4,		// level 1
	3, 2,		// level 2-4
	1, 0		// level 5+
};

// 2 bits per square. 1st: Live/Dead square 2nd: Pellet/No pellet. 4 squares per byte (+1 trailing don't care square per row).
const u8 gameMapPgm[GAME_MAP_WID*GAME_MAP_HGT] PROGMEM = {
	0b00000000, 0b00000000, 0b00000000, 0b00000000, 0b00000000,
	0b00111111, 0b11111111, 0b11001111, 0b11111111, 0b11110000,
	0b00110000, 0b11000000, 0b11001100, 0b00001100, 0b00110000,
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	0b00000000, 0b00000000, 0b00000000, 0b00000000, 0b00000000
};

// Patch game map for intro animation
const u8 introMapPatchPgm[GAME_MAP_WID] PROGMEM = {
	0b11101010, 0b10101010, 0b10101010, 0b10101010, 0b10101010
};

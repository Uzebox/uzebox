//*********************************//
// MIDI file: F:\work\uzebox\sources\rev4-beta\\demos\pacman-sound\music\intermission.mid
//*********************************//
const char song_intermission[] PROGMEM ={
0x00,0xb0,0x07,0x7f,0x00,0xc0,0x0d,0x00,0x90,0x4c,0x7f,0x00,0xb1,0x07,0x7f,0x00,0xc1,0x0e,0x00,0x91,0x35,0x7f,0x00,0xbb,0x07,0x7f,0x01,0x90,0x4c,0x00,0x00,0x4d,
0x7f,0x08,0x4d,0x00,0x00,0x4c,0x7f,0x02,0x4c,0x00,0x00,0x4d,0x7f,0x02,0x91,0x35,0x00,0x00,0x35,0x7f,0x06,0x35,0x00,0x00,0x90,0x4d,0x00,0x00,0x4c,0x7f,0x00,0x91,
0x35,0x7f,0x02,0x90,0x4c,0x00,0x00,0x4d,0x7f,0x08,0x4d,0x00,0x00,0x49,0x7f,0x01,0x49,0x00,0x00,0x4a,0x7f,0x02,0x91,0x35,0x00,0x00,0x35,0x7f,0x02,0x90,0x4a,0x00,
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0x0f,0x90,0x4d,0x00,0x02,0x91,0x35,0x00,0x00,0xff,0x2f,0x00 };

//*********************************//
// MIDI file: F:\work\uzebox\sources\rev4-beta\\demos\pacman-sound\music\newgame2.mid
//*********************************//
const char song_newgame[] PROGMEM ={
0x00,0xc0,0x0b,0x00,0xb0,0x07,0x78,0x00,0xc0,0x0b,0x00,0x90,0x48,0x7f,0x00,0xc1,0x0c,0x00,0x91,0x24,0x7f,0x04,0x90,0x48,0x00,0x04,0x91,0x24,0x00,0x00,0x90,0x54,
0x7f,0x04,0x54,0x00,0x04,0x4f,0x7f,0x04,0x4f,0x00,0x04,0x4c,0x7f,0x00,0x91,0x30,0x7f,0x04,0x90,0x4c,0x00,0x04,0x91,0x30,0x00,0x00,0x90,0x54,0x7f,0x00,0x91,0x24,
0x7f,0x04,0x90,0x54,0x00,0x00,0x4f,0x7f,0x04,0x4f,0x00,0x00,0x91,0x24,0x00,0x08,0x90,0x4c,0x7f,0x08,0x91,0x30,0x7f,0x04,0x90,0x4c,0x00,0x04,0x91,0x30,0x00,0x00,
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0x30,0x00,0x00,0x90,0x54,0x00,0x00,0xff,0x2f,0x00 };

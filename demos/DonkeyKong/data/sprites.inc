/*
 * Transformation file: ../data/sprites.xml
 * Source image: ../data/sprites.png
 * Tile width: 8px
 * Tile height: 8px
 */
#define MAPMARIOWALK0_WIDTH 2
#define MAPMARIOWALK0_HEIGHT 2
const char mapMarioWalk0[] PROGMEM ={
2,2
,0x1,0x2,0x7,0x8};

#define MAPMARIOWALK1_WIDTH 2
#define MAPMARIOWALK1_HEIGHT 2
const char mapMarioWalk1[] PROGMEM ={
2,2
,0x3,0x4,0x9,0xa};

#define MAPMARIOJUMP0_WIDTH 2
#define MAPMARIOJUMP0_HEIGHT 2
const char mapMarioJump0[] PROGMEM ={
2,2
,0x5,0x6,0xb,0xc};

#define MAPMARIOCLIMB0_WIDTH 2
#define MAPMARIOCLIMB0_HEIGHT 2
const char mapMarioClimb0[] PROGMEM ={
2,2
,0xd,0xe,0x15,0x16};

#define MAPMARIOCLIMB1_WIDTH 2
#define MAPMARIOCLIMB1_HEIGHT 2
const char mapMarioClimb1[] PROGMEM ={
2,2
,0xf,0x10,0x17,0x18};

#define MAPMARIOCLIMB2_WIDTH 2
#define MAPMARIOCLIMB2_HEIGHT 2
const char mapMarioClimb2[] PROGMEM ={
2,2
,0x11,0x12,0x19,0x1a};

#define MAPMARIOCLIMB3_WIDTH 2
#define MAPMARIOCLIMB3_HEIGHT 2
const char mapMarioClimb3[] PROGMEM ={
2,2
,0x13,0x14,0x1b,0x1c};

#define MAPMARIOMALLET0_WIDTH 3
#define MAPMARIOMALLET0_HEIGHT 2
const char mapMarioMallet0[] PROGMEM ={
3,2
,0x1f,0x20,0x21,0x24,0x25,0x26};

#define MAPMARIOMALLET1_WIDTH 2
#define MAPMARIOMALLET1_HEIGHT 3
const char mapMarioMallet1[] PROGMEM ={
2,3
,0x1d,0x1e,0x22,0x23,0x27,0x28};

#define MAPMARIODIE0_WIDTH 2
#define MAPMARIODIE0_HEIGHT 2
const char mapMarioDie0[] PROGMEM ={
2,2
,0x29,0x2a,0x31,0x32};

#define MAPMARIODIE1_WIDTH 2
#define MAPMARIODIE1_HEIGHT 2
const char mapMarioDie1[] PROGMEM ={
2,2
,0x2b,0x2c,0x33,0x34};

#define MAPMARIODIE2_WIDTH 2
#define MAPMARIODIE2_HEIGHT 2
const char mapMarioDie2[] PROGMEM ={
2,2
,0x2d,0x2e,0x35,0x36};

#define MAPMARIODIE3_WIDTH 2
#define MAPMARIODIE3_HEIGHT 2
const char mapMarioDie3[] PROGMEM ={
2,2
,0x2f,0x30,0x37,0x38};

#define MAPBARRELDROP0_WIDTH 2
#define MAPBARRELDROP0_HEIGHT 1
const char mapBarrelDrop0[] PROGMEM ={
2,1
,0x3c,0x3d};

#define MAPBARRELDROP1_WIDTH 2
#define MAPBARRELDROP1_HEIGHT 1
const char mapBarrelDrop1[] PROGMEM ={
2,1
,0x3e,0x3f};

#define MAPBARRELROLL0_WIDTH 1
#define MAPBARRELROLL0_HEIGHT 1
const char mapBarrelRoll0[] PROGMEM ={
1,1
,0x40};

#define MAPBARRELROLL1_WIDTH 1
#define MAPBARRELROLL1_HEIGHT 1
const char mapBarrelRoll1[] PROGMEM ={
1,1
,0x41};

#define MAPBARRELROLL2_WIDTH 1
#define MAPBARRELROLL2_HEIGHT 1
const char mapBarrelRoll2[] PROGMEM ={
1,1
,0x42};

#define MAPBARRELROLL3_WIDTH 1
#define MAPBARRELROLL3_HEIGHT 1
const char mapBarrelRoll3[] PROGMEM ={
1,1
,0x43};

#define MAPSPARKY0_WIDTH 2
#define MAPSPARKY0_HEIGHT 2
const char mapSparky0[] PROGMEM ={
2,2
,0x47,0x48,0x4e,0x4f};

#define MAPSPARKY1_WIDTH 2
#define MAPSPARKY1_HEIGHT 2
const char mapSparky1[] PROGMEM ={
2,2
,0x49,0x4a,0x50,0x51};

#define MAPGHOSTRED0_WIDTH 2
#define MAPGHOSTRED0_HEIGHT 2
const char mapGhostRed0[] PROGMEM ={
2,2
,0x55,0x56,0x60,0x61};

#define MAPGHOSTRED1_WIDTH 2
#define MAPGHOSTRED1_HEIGHT 2
const char mapGhostRed1[] PROGMEM ={
2,2
,0x57,0x58,0x62,0x63};

#define MAPGHOSTBLUE0_WIDTH 2
#define MAPGHOSTBLUE0_HEIGHT 2
const char mapGhostBlue0[] PROGMEM ={
2,2
,0x59,0x5a,0x64,0x65};

#define MAPGHOSTBLUE1_WIDTH 2
#define MAPGHOSTBLUE1_HEIGHT 2
const char mapGhostBlue1[] PROGMEM ={
2,2
,0x5b,0x5c,0x66,0x67};

#define MAPSPRING0_WIDTH 1
#define MAPSPRING0_HEIGHT 2
const char mapSpring0[] PROGMEM ={
1,2
,0x6b,0x72};

#define MAPSPRING1_WIDTH 2
#define MAPSPRING1_HEIGHT 1
const char mapSpring1[] PROGMEM ={
2,1
,0x73,0x74};

#define MAPEXPLODE0_WIDTH 1
#define MAPEXPLODE0_HEIGHT 1
const char mapExplode0[] PROGMEM ={
1,1
,0x7b};

#define MAPEXPLODE1_WIDTH 1
#define MAPEXPLODE1_HEIGHT 1
const char mapExplode1[] PROGMEM ={
1,1
,0x7c};

#define MAPEXPLODE2_WIDTH 1
#define MAPEXPLODE2_HEIGHT 1
const char mapExplode2[] PROGMEM ={
1,1
,0x7d};

#define MAPPIE0_WIDTH 2
#define MAPPIE0_HEIGHT 1
const char mapPie0[] PROGMEM ={
2,1
,0x7e,0x7f};

#define MAPDKESCAPE0_WIDTH 3
#define MAPDKESCAPE0_HEIGHT 3
const char mapDKEscape0[] PROGMEM ={
3,3
,0x6c,0x6d,0x6e,0x75,0x76,0x77,0x80,0x81,0x82};

#define MAPDKESCAPE1_WIDTH 3
#define MAPDKESCAPE1_HEIGHT 3
const char mapDKEscape1[] PROGMEM ={
3,3
,0x6f,0x70,0x71,0x78,0x79,0x7a,0x83,0x84,0x85};

#define MAPDKFALLING_WIDTH 3
#define MAPDKFALLING_HEIGHT 3
const char mapDKFalling[] PROGMEM ={
3,3
,0x52,0x53,0x54,0x5d,0x5e,0x5f,0x68,0x69,0x6a};

#define MAPDKBOUNCING_WIDTH 3
#define MAPDKBOUNCING_HEIGHT 3
const char mapDKBouncing[] PROGMEM ={
3,3
,0x39,0x3a,0x3b,0x44,0x45,0x46,0x4b,0x4c,0x4d};

#define SPRITESET_SIZE 134
const char spriteset[] PROGMEM={
 0xfe, 0xfe, 0xfe, 0xfe, 0xfe, 0xfe, 0xfe, 0xfe, 0xfe, 0xfe, 0xfe, 0xfe,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 0xfe, 0xfe		 //tile:0
, 0xfe, 0xfe, 0xfe, 0xfe, 0xfe, 0x17, 0x17, 0x17, 0xfe, 0xfe, 0xfe, 0xfe,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 0x81, 0x81		 //tile:1
, 0x17, 0xfe, 0xfe, 0xfe, 0xfe, 0xfe, 0xfe, 0xfe, 0x17, 0x17, 0x17, 0x17,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 0xfe, 0xfe		 //tile:2
, 0xfe, 0xfe, 0xfe, 0xfe, 0xfe, 0x17, 0x17, 0x17, 0xfe, 0xfe, 0xfe, 0xfe,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 0x17, 0x17		 //tile:3
, 0x17, 0xfe, 0xfe, 0xfe, 0xfe, 0xfe, 0xfe, 0xfe, 0x17, 0x17, 0x17, 0x17,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 0xb7, 0xfe		 //tile:4
, 0xfe, 0xfe, 0xfe, 0xfe, 0xfe, 0xfe, 0x17, 0x17, 0xfe, 0xfe, 0xfe, 0xfe,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 0x81, 0x81		 //tile:5
, 0x17, 0x17, 0xfe, 0xfe, 0xfe, 0xfe, 0xfe, 0xfe, 0x17, 0x17, 0x17, 0x17,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 0xb7, 0xb7		 //tile:6
, 0xfe, 0xfe, 0xfe, 0x81, 0x81, 0x81, 0x81, 0x17, 0xfe, 0xfe, 0xfe, 0x81,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 0x81, 0xfe		 //tile:7
, 0x17, 0x81, 0x81, 0xfe, 0xfe, 0xfe, 0xfe, 0xfe, 0xb7, 0x17, 0x17, 0xfe,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 0xfe, 0xfe		 //tile:8
, 0xb7, 0xb7, 0x81, 0x81, 0x81, 0x81, 0x17, 0x17, 0xb7, 0xb7, 0xb7, 0xfe,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 0xfe, 0xfe		 //tile:9
, 0x17, 0x81, 0x81, 0x81, 0xb7, 0xb7, 0xb7, 0xfe, 0x17, 0x17, 0x17, 0x81,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 0xfe, 0xfe		 //tile:10
, 0xfe, 0xfe, 0xb7, 0xfe, 0x81, 0x81, 0x81, 0x17, 0xfe, 0xfe, 0xfe, 0xfe,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 0xfe, 0xfe		 //tile:11
, 0x17, 0x17, 0x81, 0x81, 0x81, 0x81, 0x81, 0xfe, 0xb7, 0x17, 0x17, 0x17,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 0xfe, 0xfe		 //tile:12
, 0xfe, 0xfe, 0xfe, 0xb7, 0xb7, 0xb7, 0xfe, 0xfe, 0xfe, 0xfe, 0xfe, 0xb7,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 0x81, 0x81		 //tile:13
, 0xfe, 0xfe, 0xfe, 0xfe, 0xfe, 0xfe, 0xfe, 0xfe, 0x17, 0x17, 0x17, 0xfe,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 0x81, 0xfe		 //tile:14
, 0xfe, 0xfe, 0xfe, 0xfe, 0xfe, 0xfe, 0xfe, 0xfe, 0xfe, 0xfe, 0xfe, 0xfe,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 0x17, 0x17		 //tile:15
, 0xfe, 0xfe, 0xfe, 0xfe, 0xfe, 0xfe, 0xfe, 0xfe, 0xb7, 0x81, 0x81, 0xfe,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 0xfe, 0xfe		 //tile:16
, 0xfe, 0xfe, 0xfe, 0xfe, 0xfe, 0xfe, 0xfe, 0xfe, 0xfe, 0xfe, 0xfe, 0xfe,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 0x17, 0x17		 //tile:17
, 0xfe, 0xfe, 0xfe, 0xfe, 0xfe, 0xfe, 0xfe, 0xfe, 0xfe, 0xfe, 0xfe, 0xfe,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 0x81, 0xfe		 //tile:18
, 0xfe, 0xfe, 0xfe, 0xfe, 0xfe, 0xfe, 0xfe, 0xfe, 0xfe, 0xfe, 0xfe, 0xfe,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 0x81, 0x81		 //tile:19
, 0xfe, 0xfe, 0xfe, 0xfe, 0xfe, 0xfe, 0xfe, 0xfe, 0x17, 0x17, 0x17, 0xfe,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 0xfe, 0xfe		 //tile:20
, 0xfe, 0xfe, 0xfe, 0x17, 0x17, 0x17, 0x17, 0x81, 0xfe, 0xfe, 0x17, 0x17,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 0x81, 0x81		 //tile:21
, 0x81, 0x17, 0x17, 0x17, 0x17, 0xfe, 0xfe, 0xfe, 0x17, 0x17, 0x17, 0x17,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 0xfe, 0xfe		 //tile:22
, 0xfe, 0x17, 0x17, 0x17, 0x17, 0x17, 0x17, 0x17, 0xfe, 0xfe, 0x17, 0x17,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 0x81, 0x81		 //tile:23
, 0x17, 0x17, 0x17, 0x17, 0x17, 0xfe, 0xfe, 0xfe, 0x17, 0x17, 0x17, 0x17,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 0xfe, 0xfe		 //tile:24
, 0x17, 0x17, 0x17, 0x17, 0x17, 0x17, 0x17, 0x17, 0xfe, 0xfe, 0x17, 0x17,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 0xfe, 0xfe		 //tile:25
, 0x17, 0x17, 0x17, 0x17, 0x17, 0x17, 0x81, 0xfe, 0x17, 0x17, 0x17, 0x17,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 0xfe, 0xfe		 //tile:26
, 0xfe, 0x81, 0x81, 0x81, 0x17, 0x17, 0x81, 0x81, 0xb7, 0x81, 0x81, 0x17,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 0x81, 0x81		 //tile:27
, 0x81, 0x81, 0x17, 0x17, 0x81, 0x81, 0x81, 0xfe, 0x81, 0x17, 0x17, 0x17,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 0xfe, 0xfe		 //tile:28
, 0xfe, 0xfe, 0xfe, 0xfe, 0xfe, 0xfe, 0xfe, 0xd, 0xfe, 0xfe, 0xfe, 0xfe,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 0xfe, 0xfe		 //tile:29
, 0xd, 0xd, 0xd, 0xd, 0xd, 0xfe, 0xfe, 0xfe, 0xff, 0xff, 0xff, 0xd,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 0xfe, 0xfe		 //tile:30
, 0xfe, 0xfe, 0xfe, 0xfe, 0xfe, 0xfe, 0x17, 0x17, 0xfe, 0xfe, 0xfe, 0xfe,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 0x81, 0x81		 //tile:31
, 0x17, 0x17, 0xfe, 0xfe, 0xfe, 0xfe, 0xfe, 0xfe, 0x17, 0x17, 0x17, 0x17,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 0xfe, 0xfe		 //tile:32
, 0xfe, 0xfe, 0xfe, 0xfe, 0xfe, 0xfe, 0xfe, 0xfe, 0xfe, 0xfe, 0xfe, 0xfe,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 0xd, 0xfe		 //tile:33
, 0xfe, 0xfe, 0xfe, 0xfe, 0xfe, 0xfe, 0xfe, 0x17, 0xfe, 0xfe, 0xfe, 0xfe,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 0x80, 0x80		 //tile:34
, 0xb7, 0xb7, 0xb7, 0xfe, 0xfe, 0xfe, 0xfe, 0xfe, 0xb7, 0xb7, 0xb7, 0x17,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 0xfe, 0xfe		 //tile:35
, 0xfe, 0xfe, 0xfe, 0xfe, 0xfe, 0x81, 0x81, 0x81, 0xfe, 0xfe, 0xfe, 0xfe,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 0xfe, 0xfe		 //tile:36
, 0x81, 0x81, 0x81, 0x81, 0x81, 0x81, 0xb7, 0xb7, 0x81, 0x81, 0x81, 0x81,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 0xfe, 0xfe		 //tile:37
, 0xfe, 0xfe, 0xd, 0xd, 0xd, 0xff, 0xd, 0xfe, 0xff, 0xff, 0xd, 0xd,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 0xfe, 0xfe		 //tile:38
, 0xfe, 0xfe, 0xfe, 0xfe, 0xfe, 0xfe, 0x80, 0x80, 0xfe, 0xfe, 0xfe, 0xfe,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 0x80, 0x80		 //tile:39
, 0x80, 0x80, 0x17, 0x17, 0x80, 0xfe, 0xfe, 0xfe, 0x80, 0x17, 0xb7, 0x17,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 0xfe, 0xfe		 //tile:40
, 0xfe, 0xfe, 0xfe, 0xfe, 0xfe, 0x17, 0x17, 0x17, 0xfe, 0xfe, 0xfe, 0xfe,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 0x81, 0x81		 //tile:41
, 0x17, 0x17, 0xfe, 0xfe, 0xfe, 0xfe, 0xfe, 0xfe, 0x17, 0x17, 0x17, 0xfe,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 0xb7, 0xb7		 //tile:42
, 0xfe, 0xfe, 0xfe, 0xfe, 0xfe, 0xfe, 0xb7, 0xb7, 0xfe, 0xfe, 0xfe, 0xfe,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 0x17, 0x81		 //tile:43
, 0xfe, 0xfe, 0xfe, 0x81, 0x81, 0x81, 0xfe, 0xfe, 0x81, 0xfe, 0xfe, 0x81,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 0xfe, 0xfe		 //tile:44
, 0xfe, 0xfe, 0xfe, 0x81, 0x81, 0x81, 0xfe, 0xfe, 0xfe, 0xfe, 0x81, 0x81,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 0x17, 0x81		 //tile:45
, 0xfe, 0xfe, 0xfe, 0xfe, 0x81, 0x81, 0xfe, 0xfe, 0xfe, 0xfe, 0x17, 0x17,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 0x81, 0xfe		 //tile:46
, 0xfe, 0xfe, 0xb7, 0xb7, 0xb7, 0xb7, 0xb7, 0xfe, 0xfe, 0xb7, 0xfe, 0xfe,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 0xfe, 0xfe		 //tile:47
, 0xfe, 0xfe, 0xfe, 0xfe, 0xfe, 0xfe, 0xfe, 0xfe, 0xfe, 0xfe, 0xfe, 0xfe,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 0x17, 0xfe		 //tile:48
, 0xfe, 0x81, 0x81, 0x81, 0x81, 0x17, 0x81, 0x81, 0xfe, 0xfe, 0xfe, 0x81,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 0xfe, 0xfe		 //tile:49
, 0x81, 0x17, 0x81, 0x81, 0x81, 0x81, 0xb7, 0xfe, 0x17, 0x17, 0x17, 0x81,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 0xfe, 0xfe		 //tile:50
, 0x17, 0x17, 0x81, 0xb7, 0x81, 0x81, 0x17, 0x81, 0x17, 0x17, 0xb7, 0xb7,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 0xb7, 0xb7		 //tile:51
, 0x81, 0x17, 0x17, 0x17, 0x17, 0x17, 0xfe, 0xfe, 0x17, 0x17, 0xb7, 0x17,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 0xfe, 0xfe		 //tile:52
, 0xb7, 0xb7, 0x81, 0x81, 0x81, 0x81, 0x17, 0x81, 0xb7, 0xb7, 0xb7, 0xfe,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 0x17, 0x17		 //tile:53
, 0x81, 0x81, 0x17, 0x81, 0x81, 0x81, 0x81, 0xb7, 0x17, 0x17, 0xb7, 0x81,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 0xfe, 0xfe		 //tile:54
, 0xfe, 0xfe, 0xfe, 0xfe, 0xb7, 0xfe, 0xfe, 0xfe, 0x17, 0xfe, 0xfe, 0xb7,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 0x81, 0x81		 //tile:55
, 0xfe, 0xfe, 0x17, 0x17, 0x17, 0x17, 0x17, 0xfe, 0x81, 0x17, 0xb7, 0x17,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 0xb7, 0xb7		 //tile:56
, 0xfe, 0xfe, 0xfe, 0xfe, 0xfe, 0xfe, 0xfe, 0xfe, 0xfe, 0xfe, 0xfe, 0xfe,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 0x6, 0x6f		 //tile:57
, 0xfe, 0xfe, 0x6, 0x6, 0x6, 0x6, 0xfe, 0xfe, 0xfe, 0x6, 0x6f, 0x6,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 0x6f, 0x6		 //tile:58
, 0xfe, 0xfe, 0xfe, 0xfe, 0xfe, 0xfe, 0xfe, 0xfe, 0xfe, 0xfe, 0xfe, 0xfe,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 0xfe, 0xfe		 //tile:59
, 0xfe, 0xfe, 0xfe, 0xfe, 0xfe, 0xfe, 0xd, 0xd, 0xfe, 0xfe, 0xfe, 0xfe,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 0xd, 0xd		 //tile:60
, 0xd, 0xd, 0xfe, 0xfe, 0xfe, 0xfe, 0xfe, 0xfe, 0x6f, 0x6f, 0xd, 0x81,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 0xfe, 0xfe		 //tile:61
, 0xfe, 0xfe, 0xfe, 0xfe, 0xfe, 0xfe, 0x6f, 0x6f, 0xfe, 0xfe, 0xfe, 0xfe,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 0x6f, 0x6f		 //tile:62
, 0x6f, 0x6f, 0xfe, 0xfe, 0xfe, 0xfe, 0xfe, 0xfe, 0xd, 0xd, 0x6f, 0x81,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 0xfe, 0xfe		 //tile:63
, 0xfe, 0xfe, 0x6f, 0x6f, 0x6f, 0x6f, 0xfe, 0xfe, 0xfe, 0x6f, 0xd, 0xd,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 0xfe, 0xfe		 //tile:64
, 0xfe, 0xfe, 0x6f, 0x6f, 0x6f, 0x6f, 0xfe, 0xfe, 0xfe, 0x6f, 0xd, 0xd,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 0xfe, 0xfe		 //tile:65
, 0xfe, 0xfe, 0x6f, 0x6f, 0x6f, 0x6f, 0xfe, 0xfe, 0xfe, 0x6f, 0xd, 0xd,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 0xfe, 0xfe		 //tile:66
, 0xfe, 0xfe, 0x6f, 0x6f, 0x6f, 0x6f, 0xfe, 0xfe, 0xfe, 0x6f, 0xd, 0xd,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 0xfe, 0xfe		 //tile:67
, 0xfe, 0xfe, 0x1f, 0x6, 0x6, 0x6, 0x6, 0x6f, 0xfe, 0xfe, 0x6, 0x6,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 0x6, 0x1f		 //tile:68
, 0x6f, 0x6f, 0x6f, 0x6f, 0x6f, 0x6f, 0x6f, 0x6f, 0x6f, 0x6f, 0x6f, 0x6f,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 0x6f, 0x6f		 //tile:69
, 0x6f, 0x6, 0x6, 0x6, 0x6, 0x1f, 0xfe, 0xfe, 0x6, 0x6, 0x6, 0x1f,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 0xfe, 0xfe		 //tile:70
, 0xfe, 0x17, 0xfe, 0xfe, 0xfe, 0x17, 0xfe, 0xfe, 0xfe, 0xfe, 0xfe, 0xfe,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 0xb7, 0xb7		 //tile:71
, 0xfe, 0xfe, 0x17, 0xfe, 0xfe, 0xfe, 0xfe, 0xfe, 0xfe, 0xb7, 0xfe, 0x17,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 0xfe, 0xfe		 //tile:72
, 0xfe, 0xfe, 0xfe, 0x17, 0xfe, 0xfe, 0xfe, 0xfe, 0xfe, 0xfe, 0xfe, 0xfe,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 0xb7, 0xb7		 //tile:73
, 0xfe, 0xfe, 0xfe, 0xfe, 0xfe, 0xfe, 0xfe, 0xfe, 0xfe, 0xfe, 0xfe, 0xfe,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 0xfe, 0xfe		 //tile:74
, 0xfe, 0xfe, 0xfe, 0x1f, 0x6, 0x6, 0x6, 0x6, 0xfe, 0xfe, 0x1f, 0x6,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 0x6f, 0xfe		 //tile:75
, 0x1f, 0x1f, 0x6f, 0x6f, 0x6f, 0x6f, 0x1f, 0x1f, 0x1f, 0x6f, 0x6f, 0x6f,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 0xfe, 0xfe		 //tile:76
, 0x6, 0x6, 0x6, 0x6, 0x1f, 0xfe, 0xfe, 0xfe, 0x6, 0x6, 0x6, 0x6,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 0x6f, 0x6f		 //tile:77
, 0xfe, 0xfe, 0xfe, 0x17, 0x17, 0xb7, 0xb7, 0xff, 0xfe, 0xfe, 0xfe, 0x17,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 0xfe, 0xfe		 //tile:78
, 0xff, 0xb7, 0xb7, 0xb7, 0x17, 0xfe, 0xfe, 0xfe, 0xff, 0xff, 0x17, 0xb7,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 0xfe, 0xfe		 //tile:79
, 0xfe, 0x17, 0xfe, 0x17, 0x17, 0xb7, 0xb7, 0xff, 0xfe, 0xfe, 0x17, 0x17,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 0x17, 0x17		 //tile:80
, 0xff, 0xb7, 0xb7, 0xb7, 0x17, 0x17, 0xfe, 0xfe, 0xff, 0xff, 0xff, 0xb7,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 0xfe, 0xfe		 //tile:81
, 0x6f, 0x6f, 0x6f, 0x6f, 0x6f, 0x6f, 0x6f, 0xfe, 0xfe, 0x1f, 0x6f, 0x6,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 0x6, 0x6		 //tile:82
, 0xfe, 0xfe, 0xfe, 0xfe, 0xfe, 0xfe, 0xfe, 0xfe, 0xfe, 0xfe, 0xfe, 0xfe,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 0x1f, 0x1f		 //tile:83
, 0xfe, 0x6f, 0x6f, 0x6f, 0x6f, 0x6f, 0x6f, 0x6f, 0x6f, 0x6, 0x6f, 0x6f,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 0xfe, 0xfe		 //tile:84
, 0xfe, 0xfe, 0xfe, 0xfe, 0xfe, 0xfe, 0xfe, 0xfe, 0xfe, 0xfe, 0xfe, 0xfe,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 0x17, 0xb7		 //tile:85
, 0xfe, 0xfe, 0xfe, 0xfe, 0xfe, 0xfe, 0xfe, 0xfe, 0xfe, 0xfe, 0xfe, 0xfe,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 0xb7, 0x17		 //tile:86
, 0xfe, 0xfe, 0xfe, 0xfe, 0xfe, 0xfe, 0xfe, 0xfe, 0xfe, 0xfe, 0xfe, 0xfe,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 0xb7, 0xb7		 //tile:87
, 0xfe, 0xfe, 0xfe, 0xfe, 0xfe, 0xfe, 0xfe, 0xfe, 0xfe, 0xfe, 0xfe, 0xfe,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 0x17, 0xfe		 //tile:88
, 0xfe, 0xfe, 0xfe, 0xfe, 0xfe, 0xfe, 0xfe, 0xfe, 0xfe, 0xfe, 0xfe, 0xfe,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 0xb0, 0xdb		 //tile:89
, 0xfe, 0xfe, 0xfe, 0xfe, 0xfe, 0xfe, 0xfe, 0xfe, 0xfe, 0xfe, 0xfe, 0xfe,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 0xdb, 0xb0		 //tile:90
, 0xfe, 0xfe, 0xfe, 0xfe, 0xfe, 0xfe, 0xfe, 0xfe, 0xfe, 0xfe, 0xfe, 0xfe,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 0xdb, 0xdb		 //tile:91
, 0xfe, 0xfe, 0xfe, 0xfe, 0xfe, 0xfe, 0xfe, 0xfe, 0xfe, 0xfe, 0xfe, 0xfe,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 0xb0, 0xfe		 //tile:92
, 0xfe, 0xfe, 0xfe, 0xfe, 0x1f, 0x1f, 0x6, 0x1f, 0xfe, 0xfe, 0xfe, 0xfe,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 0x6, 0x6f		 //tile:93
, 0x6f, 0x6f, 0x1f, 0x6f, 0x6f, 0x1f, 0x6f, 0x6f, 0x6f, 0x6, 0x6f, 0x1f,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 0xff, 0x6		 //tile:94
, 0x1f, 0x6, 0x1f, 0x1f, 0xfe, 0xfe, 0xfe, 0xfe, 0x6, 0x6, 0x6, 0xfe,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 0xfe, 0xfe		 //tile:95
, 0xfe, 0xfe, 0x17, 0x17, 0xfe, 0x17, 0xb7, 0xb7, 0xfe, 0x17, 0x17, 0x17,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 0x17, 0x17		 //tile:96
, 0xff, 0xff, 0x17, 0xff, 0x17, 0xb7, 0xb7, 0x17, 0xb7, 0xff, 0xff, 0xff,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 0xfe, 0xfe		 //tile:97
, 0xfe, 0x17, 0xfe, 0xfe, 0x17, 0xb7, 0xb7, 0xff, 0xfe, 0x17, 0x17, 0xfe,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 0x17, 0x17		 //tile:98
, 0xff, 0x17, 0xff, 0x17, 0xff, 0xb7, 0x17, 0xfe, 0xff, 0xff, 0xff, 0xff,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 0xfe, 0xfe		 //tile:99
, 0xfe, 0xfe, 0xb0, 0xb0, 0xfe, 0xb0, 0xdb, 0xdb, 0xfe, 0xb0, 0xb0, 0xb0,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 0xb0, 0xb0		 //tile:100
, 0x17, 0x17, 0xb0, 0x17, 0xb0, 0xdb, 0xdb, 0xb0, 0xdb, 0x17, 0x17, 0x17,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 0xfe, 0xfe		 //tile:101
, 0xfe, 0xb0, 0xfe, 0xfe, 0xb0, 0xdb, 0xdb, 0x17, 0xfe, 0xb0, 0xb0, 0xfe,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 0xb0, 0xb0		 //tile:102
, 0x17, 0xb0, 0x17, 0xb0, 0x17, 0xdb, 0xb0, 0xfe, 0x17, 0x17, 0x17, 0x17,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 0xfe, 0xfe		 //tile:103
, 0xfe, 0xfe, 0x1f, 0x6, 0x6, 0x6, 0x6, 0x6f, 0xfe, 0xfe, 0xfe, 0xfe,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 0xfe, 0xfe		 //tile:104
, 0x6, 0x6, 0x6, 0x6, 0x6, 0x6, 0x6, 0x6, 0xff, 0x6, 0xff, 0x6,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 0xfe, 0xfe		 //tile:105
, 0x6, 0x6, 0x6, 0x6, 0x6, 0x1f, 0xfe, 0xfe, 0x6f, 0x6, 0x6, 0x1f,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 0xfe, 0xfe		 //tile:106
, 0xfe, 0xfe, 0xfe, 0xfe, 0xfe, 0xfe, 0xfe, 0xfe, 0xfe, 0xfe, 0xfe, 0xfe,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 0xfe, 0xb7		 //tile:107
, 0xfe, 0xfe, 0xfe, 0x77, 0x6, 0x6f, 0x77, 0xfe, 0xfe, 0xfe, 0xfe, 0x6,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 0x27, 0x6		 //tile:108
, 0xfe, 0xfe, 0xfe, 0xfe, 0xfe, 0xfe, 0xfe, 0xfe, 0xfe, 0xfe, 0xfe, 0xfe,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 0x6, 0x6		 //tile:109
, 0xfe, 0xfe, 0xfe, 0xfe, 0xfe, 0xfe, 0xfe, 0xfe, 0xfe, 0xfe, 0xfe, 0xfe,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 0xfe, 0xfe		 //tile:110
, 0xfe, 0xfe, 0xfe, 0xfe, 0xfe, 0xfe, 0xfe, 0xfe, 0xfe, 0xfe, 0xfe, 0xfe,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 0x6, 0x6		 //tile:111
, 0xfe, 0xfe, 0xfe, 0xfe, 0xfe, 0xfe, 0xfe, 0xfe, 0xfe, 0x1f, 0x5, 0x5,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 0x6, 0x6		 //tile:112
, 0xfe, 0xfe, 0xfe, 0xfe, 0xfe, 0xfe, 0xfe, 0xfe, 0xfe, 0xfe, 0xfe, 0xfe,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 0x27, 0xfe		 //tile:113
, 0xd8, 0xfe, 0xfe, 0xb7, 0xb7, 0xfe, 0xfe, 0xd8, 0xb7, 0xfe, 0xfe, 0x47,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 0xfe, 0xfe		 //tile:114
, 0xfe, 0xfe, 0xfe, 0xfe, 0xfe, 0xfe, 0xfe, 0xfe, 0xfe, 0xfe, 0xfe, 0xfe,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 0xd8, 0xd8		 //tile:115
, 0xfe, 0xfe, 0xfe, 0xfe, 0xfe, 0xfe, 0xfe, 0xfe, 0xd8, 0xd8, 0xd8, 0xfe,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 0xfe, 0xfe		 //tile:116
, 0xfe, 0x6, 0x6, 0x6, 0x6, 0x6, 0x6, 0x6, 0xfe, 0x6, 0x6, 0x6,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 0x6, 0x6		 //tile:117
, 0x6, 0x6, 0x6, 0x1f, 0x6, 0x6, 0x6, 0x6, 0x6, 0x6, 0x6, 0x6,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 0x6, 0x80		 //tile:118
, 0x6, 0x6, 0x6, 0x6, 0x6, 0x5, 0x27, 0xfe, 0x6, 0x6, 0x6, 0x6,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 0x80, 0xfe		 //tile:119
, 0xfe, 0xfe, 0x6, 0x6, 0x6, 0x6, 0x6, 0x6, 0xfe, 0xfe, 0xfe, 0x6,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 0x27, 0x6		 //tile:120
, 0x6, 0x6, 0x6, 0x6, 0x6, 0x6, 0x6, 0x6, 0x6, 0x6, 0x6, 0x6,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 0x6, 0x6		 //tile:121
, 0x6, 0x6, 0x6, 0x6, 0x6, 0x6, 0x6, 0x1f, 0x6, 0x9f, 0x9f, 0x97,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 0xfe, 0x57		 //tile:122
, 0xfe, 0xfe, 0xfe, 0xfe, 0xfe, 0xfe, 0xfe, 0xfe, 0xfe, 0xfe, 0xfe, 0xfe,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 0xfe, 0xfe		 //tile:123
, 0xfe, 0xfe, 0xfe, 0xfe, 0xfe, 0xfe, 0xfe, 0xfe, 0xfe, 0xfe, 0x17, 0x17,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 0xfe, 0xfe		 //tile:124
, 0xff, 0xfe, 0xfe, 0xfe, 0xff, 0xfe, 0xfe, 0xff, 0xfe, 0x17, 0xfe, 0xfe,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 0xfe, 0xff		 //tile:125
, 0xfe, 0xfe, 0xfe, 0xfe, 0xfe, 0xfe, 0xfe, 0xfe, 0xfe, 0xfe, 0xfe, 0xfe,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 0xc0, 0xc0		 //tile:126
, 0xfe, 0xfe, 0xfe, 0xfe, 0xfe, 0xfe, 0xfe, 0xfe, 0x66, 0x6f, 0xfe, 0xfe,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 0xfe, 0xfe		 //tile:127
, 0x27, 0x5, 0x6, 0x6, 0x6, 0x6, 0x6, 0x6, 0x5, 0x5, 0x6, 0x6,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 0x27, 0xfe		 //tile:128
, 0x27, 0x6, 0x6, 0x6, 0x6, 0x27, 0x6, 0x80, 0xfe, 0x27, 0x1f, 0x1f,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 0xfe, 0xfe		 //tile:129
, 0x80, 0x5, 0x27, 0xfe, 0xfe, 0xfe, 0xfe, 0xfe, 0x80, 0x80, 0xfe, 0xfe,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 0xfe, 0xfe		 //tile:130
, 0xfe, 0xfe, 0x27, 0x6, 0x6, 0x6, 0x6, 0x6, 0xfe, 0xfe, 0xfe, 0x6,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 0xfe, 0xfe		 //tile:131
, 0x6, 0x6, 0x6, 0x27, 0x5, 0x5, 0x1f, 0x6, 0x1f, 0x1f, 0x1f, 0xfe,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 0x1f, 0x6f		 //tile:132
, 0x80, 0x1f, 0x57, 0xfe, 0x57, 0xfe, 0x57, 0xfe, 0x80, 0x80, 0xfe, 0xfe,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 0xfe, 0xfe		 //tile:133
};

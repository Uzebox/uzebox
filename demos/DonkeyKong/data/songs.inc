const char HammerSong[] PROGMEM ={
0x00,0xc2,0x02,0x00,0xc1,0x01,0x00,0xc0,0x00,0x00,0xb0,0x07,0x7f,0x00,0xff,0x06,0x01,0x53,0x07,0xb0,0x07,0x7f,0x00,0x0b,0x7f,0x00,0x90,0x3c,0x64,0x03,0xb0,0x0b,
0x00,0x07,0x0b,0x7f,0x00,0x90,0x3c,0x64,0x03,0xb0,0x0b,0x00,0x02,0x0b,0x7f,0x00,0x90,0x3c,0x64,0x03,0xb0,0x0b,0x00,0x02,0x0b,0x7f,0x00,0x90,0x3c,0x64,0x03,0xb0,
0x0b,0x00,0x07,0x0b,0x7f,0x00,0x90,0x3c,0x64,0x03,0xb0,0x0b,0x00,0x07,0x0b,0x7f,0x00,0x90,0x40,0x64,0x03,0xb0,0x0b,0x00,0x07,0x0b,0x7f,0x00,0x90,0x3c,0x64,0x03,
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0x00,0x07,0x0b,0x7f,0x00,0x0b,0x00,0x00,0xff,0x2f,0x00 };

const char Level1Song[] PROGMEM ={
0x00,0xc2,0x02,0x00,0xc1,0x01,0x00,0xc0,0x00,0x00,0xff,0x06,0x01,0x53,0x05,0xb0,0x07,0x7f,0x00,0x90,0x30,0x64,0x20,0x34,0x64,0x15,0x37,0x64,0x0b,0x39,0x64,0x0a,
0x37,0x64,0x06,0xff,0x06,0x01,0x45,0x00,0xff,0x2f,0x00 };

const char Level2Song[] PROGMEM ={//just a guess, not sure what level
0x00,0xc0,0x00,0x00,0xff,0x06,0x01,0x53,0x03,0xb0,0x07,0x7f,0x00,0x90,0x31,0x64,0x10,0x31,0x64,0x08,0x31,0x64,0x04,0xff,0x06,0x01,0x45,0x00,0xff,0x2f,0x00 };

const char Level3Song[] PROGMEM ={
0x00,0xc0,0x00,0x00,0xff,0x06,0x01,0x53,0x03,0xb0,0x07,0x7f,0x00,0x90,0x34,0x64,0x10,0x30,0x64,0x08,0x30,0x64,0x04,0xff,0x06,0x01,0x45,0x00,0xff,0x2f,0x00 };

const char LevelEnd[] PROGMEM ={
0x00,0xc1,0x01,0x00,0xc0,0x00,0x00,0xb0,0x07,0x7f,0x00,0x0b,0x00,0x00,0xb1,0x07,0x7f,0x00,0x0b,0x49,0x00,0x0b,0x2e,0x00,0xff,0x06,0x01,0x53,0x02,0xb1,0x0b,0x20,
0x02,0x0b,0x00,0x01,0x90,0x40,0x64,0x00,0xb0,0x0b,0x7f,0x00,0x91,0x43,0x64,0x00,0xb1,0x0b,0x7f,0x01,0xb0,0x0b,0x7a,0x01,0x0b,0x76,0x00,0xb1,0x0b,0x7a,0x01,0x0b,
0x76,0x01,0xb0,0x0b,0x71,0x00,0xb1,0x0b,0x71,0x01,0x0b,0x6c,0x01,0x90,0x41,0x64,0x00,0xb0,0x0b,0x7a,0x00,0x91,0x45,0x64,0x00,0xb1,0x0b,0x7f,0x02,0x0b,0x7a,0x01,
0xb0,0x0b,0x76,0x00,0xb1,0x0b,0x76,0x01,0xb0,0x0b,0x71,0x00,0xb1,0x0b,0x71,0x01,0x0b,0x6c,0x01,0xb0,0x0b,0x6c,0x01,0x90,0x43,0x64,0x00,0xb0,0x0b,0x7f,0x00,0x91,
0x47,0x64,0x0d,0x90,0x40,0x64,0x00,0x91,0x43,0x64,0x1a,0x90,0x40,0x64,0x00,0x91,0x43,0x64,0x06,0x90,0x41,0x64,0x00,0x91,0x45,0x64,0x07,0x90,0x43,0x64,0x00,0x91,
0x47,0x64,0x0d,0x90,0x40,0x64,0x00,0x91,0x43,0x7f,0x84,0xaa,0x01,0xff,0x06,0x01,0x45,0x00,0xff,0x2f,0x00 };

const char DeathSong[] PROGMEM ={
0x00,0xc2,0x02,0x00,0xc1,0x01,0x00,0xc0,0x00,0x00,0xb0,0x07,0x7f,0x00,0x90,0x52,0x64,0x00,0xb1,0x07,0x7f,0x00,0xb2,0x07,0x7f,0x00,0xff,0x06,0x01,0x53,0x03,0x90,
0x59,0x64,0x04,0x56,0x64,0x04,0x5c,0x64,0x03,0x54,0x64,0x04,0x5b,0x64,0x04,0x53,0x64,0x04,0x5a,0x64,0x03,0x52,0x64,0x04,0x59,0x64,0x04,0x50,0x64,0x04,0x57,0x64,
0x03,0x4f,0x64,0x04,0x56,0x64,0x04,0x4e,0x64,0x04,0x55,0x64,0x03,0x4d,0x64,0x04,0x54,0x64,0x04,0x4b,0x64,0x04,0x52,0x64,0x03,0x4a,0x64,0x04,0x51,0x64,0x04,0x49,
0x64,0x04,0x50,0x64,0x03,0x48,0x64,0x04,0x4f,0x64,0x04,0x46,0x64,0x04,0x4d,0x64,0x03,0x54,0x01,0x00,0x91,0x40,0x7f,0x08,0x43,0x7f,0x00,0x30,0x7f,0x0f,0x37,0x7f,
0x00,0x2b,0x7f,0x0f,0x3c,0x7f,0x00,0x24,0x7f,0xfe,0x71,0xff,0x06,0x01,0x45,0x00,0xff,0x2f,0x00 };


const char StartGame[] PROGMEM ={//improved patches, not as pathetic, possibly smaller
0x00,0xc2,0x05,0x00,0xc1,0x04,0x00,0xc0,0x03,0x00,0xb0,0x07,0x7f,0x00,0x90,0x2d,0x64,0x00,0xb1,0x07,0x7f,0x00,0x91,0x26,0x64,0x00,0xff,0x06,0x01,0x53,0x35,0x90,
0x2f,0x64,0x00,0x91,0x28,0x64,0x12,0x90,0x30,0x64,0x00,0x91,0x29,0x64,0x24,0x90,0x2d,0x64,0x00,0x91,0x26,0x64,0x24,0x2c,0x64,0x00,0x92,0x39,0x7f,0x48,0x90,0x39,
0x64,0x00,0x91,0x2d,0x64,0x81,0x97,0x6d,0xff,0x06,0x01,0x45,0x00,0xff,0x2f,0x00 };

const char StageStart[] PROGMEM ={
0x00,0xc2,0x02,0x00,0xc1,0x01,0x00,0xc0,0x00,0x00,0xb0,0x07,0x7f,0x00,0x07,0x7f,0x00,0x90,0x43,0x64,0x00,0x91,0x30,0x64,0x00,0xff,0x06,0x01,0x53,0x11,0x90,0x45,
0x64,0x06,0x91,0x2b,0x64,0x0c,0x90,0x48,0x64,0x0c,0x91,0x30,0x64,0x0c,0x90,0x45,0x64,0x0c,0x43,0x64,0x00,0x91,0x2b,0x64,0x0c,0x90,0x45,0x64,0x0c,0x41,0x64,0x00,
0x91,0x29,0x64,0x0c,0x2b,0x64,0x06,0x2d,0x64,0x06,0x2e,0x64,0x06,0x30,0x64,0x06,0x90,0x44,0x01,0x00,0x91,0x32,0x64,0x06,0x34,0x64,0x06,0x35,0x64,0x18,0x35,0x01,
0xe5,0x03,0xff,0x06,0x01,0x45,0x00,0xff,0x2f,0x00 };

const char EndingSong[] PROGMEM ={
0x00,0xc2,0x02,0x00,0xc1,0x01,0x00,0xc0,0x00,0x00,0xb0,0x07,0x7f,0x00,0xb1,0x07,0x7f,0x00,0xb2,0x07,0x7f,0x00,0xff,0x06,0x01,0x53,0x02,0x91,0x3c,0x78,0x0d,0x3c,
0x78,0x0c,0x45,0x78,0x00,0x92,0x29,0x78,0x0c,0x90,0x35,0x78,0x0d,0x39,0x78,0x0c,0x35,0x78,0x00,0x92,0x29,0x78,0x0c,0x90,0x39,0x78,0x00,0x92,0x29,0x78,0x0c,0x91,
0x40,0x78,0x0d,0x43,0x78,0x0c,0x41,0x78,0x0c,0x90,0x2e,0x78,0x00,0x91,0x3e,0x78,0x00,0x92,0x2b,0x78,0x0c,0x90,0x32,0x78,0x0d,0x37,0x78,0x0c,0x32,0x78,0x00,0x92,
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0x92,0x29,0x78,0x04,0x90,0x35,0x78,0x1f,0xff,0x06,0x01,0x45,0x29,0xff,0x2f,0x00 };

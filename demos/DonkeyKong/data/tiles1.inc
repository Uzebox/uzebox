/*
 * Transformation file: ../data/tiles1.xml
 * Source image: ../data/tiles1.png
 * Tile width: 8px
 * Tile height: 8px
 */
#define TILESET1_SIZE 86
const char tileset1[] PROGMEM={
 0x0, 0x0, 0xff, 0xff, 0xff, 0x0, 0x0, 0x0, 0x0, 0xff, 0xff, 0x0,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 0x0, 0x0		 //tile:0
, 0xff, 0xff, 0xff, 0xff, 0xff, 0xff, 0x0, 0x0, 0xff, 0xff, 0x0, 0x0,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 0x0, 0x0		 //tile:1
, 0x0, 0x0, 0xff, 0xff, 0xff, 0xff, 0x0, 0x0, 0x0, 0xff, 0xff, 0x0,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 0x0, 0x0		 //tile:2
, 0xff, 0xff, 0xff, 0xff, 0xff, 0x0, 0x0, 0x0, 0xff, 0xff, 0x0, 0x0,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 0x0, 0x0		 //tile:3
, 0xff, 0xff, 0xff, 0xff, 0xff, 0xff, 0xff, 0x0, 0xff, 0xff, 0x0, 0x0,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 0x0, 0x0		 //tile:4
, 0xff, 0xff, 0xff, 0xff, 0xff, 0xff, 0xff, 0x0, 0xff, 0xff, 0x0, 0x0,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 0x0, 0x0		 //tile:5
, 0x0, 0x0, 0xff, 0xff, 0xff, 0xff, 0xff, 0x0, 0x0, 0xff, 0xff, 0x0,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 0x0, 0x0		 //tile:6
, 0xff, 0xff, 0x0, 0x0, 0x0, 0xff, 0xff, 0x0, 0xff, 0xff, 0x0, 0x0,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 0x0, 0x0		 //tile:7
, 0x0, 0xff, 0xff, 0xff, 0xff, 0xff, 0xff, 0x0, 0x0, 0x0, 0x0, 0xff,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 0x0, 0x0		 //tile:8
, 0x0, 0x0, 0x0, 0xff, 0xff, 0xff, 0xff, 0x0, 0x0, 0x0, 0x0, 0x0,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 0x0, 0x0		 //tile:9
, 0xff, 0xff, 0x0, 0x0, 0x0, 0xff, 0xff, 0x0, 0xff, 0xff, 0x0, 0x0,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 0x0, 0x0		 //tile:10
, 0x0, 0xff, 0xff, 0x0, 0x0, 0x0, 0x0, 0x0, 0x0, 0xff, 0xff, 0x0,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 0x0, 0x0		 //tile:11
, 0xff, 0xff, 0x0, 0x0, 0x0, 0xff, 0xff, 0x0, 0xff, 0xff, 0xff, 0x0,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 0x0, 0x0		 //tile:12
, 0xff, 0xff, 0x0, 0x0, 0x0, 0xff, 0xff, 0x0, 0xff, 0xff, 0xff, 0x0,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 0x0, 0x0		 //tile:13
, 0x0, 0xff, 0xff, 0xff, 0xff, 0xff, 0x0, 0x0, 0xff, 0xff, 0x0, 0x0,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 0x0, 0x0		 //tile:14
, 0xff, 0xff, 0xff, 0xff, 0xff, 0xff, 0x0, 0x0, 0xff, 0xff, 0x0, 0x0,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 0x0, 0x0		 //tile:15
, 0x0, 0xff, 0xff, 0xff, 0xff, 0xff, 0x0, 0x0, 0xff, 0xff, 0x0, 0x0,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 0x0, 0x0		 //tile:16
, 0xff, 0xff, 0xff, 0xff, 0xff, 0xff, 0x0, 0x0, 0xff, 0xff, 0x0, 0x0,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 0x0, 0x0		 //tile:17
, 0x0, 0xff, 0xff, 0xff, 0xff, 0x0, 0x0, 0x0, 0xff, 0xff, 0x0, 0x0,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 0x0, 0x0		 //tile:18
, 0x0, 0xff, 0xff, 0xff, 0xff, 0xff, 0xff, 0x0, 0x0, 0x0, 0x0, 0xff,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 0x0, 0x0		 //tile:19
, 0xff, 0xff, 0x0, 0x0, 0x0, 0xff, 0xff, 0x0, 0xff, 0xff, 0x0, 0x0,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 0x0, 0x0		 //tile:20
, 0xff, 0xff, 0x0, 0x0, 0x0, 0xff, 0xff, 0x0, 0xff, 0xff, 0x0, 0x0,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 0x0, 0x0		 //tile:21
, 0xff, 0xff, 0x0, 0x0, 0x0, 0xff, 0xff, 0x0, 0xff, 0xff, 0x0, 0x0,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 0x0, 0x0		 //tile:22
, 0xff, 0xff, 0x0, 0x0, 0x0, 0xff, 0xff, 0x0, 0xff, 0xff, 0xff, 0x0,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 0x0, 0x0		 //tile:23
, 0x0, 0xff, 0xff, 0x0, 0x0, 0xff, 0xff, 0x0, 0x0, 0xff, 0xff, 0x0,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 0x0, 0x0		 //tile:24
, 0xff, 0xff, 0xff, 0xff, 0xff, 0xff, 0xff, 0x0, 0x0, 0x0, 0x0, 0x0,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 0x0, 0x0		 //tile:25
, 0x0, 0xff, 0xff, 0xff, 0xff, 0xff, 0x0, 0x0, 0xff, 0xff, 0xff, 0xff,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 0x0, 0x0		 //tile:26
, 0x0, 0x0, 0x0, 0x0, 0x0, 0x0, 0x0, 0x0, 0x0, 0x0, 0x0, 0x0,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 0x0, 0x0		 //tile:27
};
#define MAPHISCORE1_WIDTH 3
#define MAPHISCORE1_HEIGHT 1
const char mapHiScore1[] PROGMEM ={
3,1
,0x1,0x2,0x3};

#define MAP1UP1_WIDTH 1
#define MAP1UP1_HEIGHT 1
const char map1UP1[] PROGMEM ={
1,1
,0x4};

#define MAPDIGITS1_WIDTH 10
#define MAPDIGITS1_HEIGHT 1
const char mapDigits1[] PROGMEM ={
10,1
,0x5,0x6,0x7,0x8,0x9,0xa,0xb,0xc,0xd,0xe};

#define MAPBEAMBLUE1_WIDTH 1
#define MAPBEAMBLUE1_HEIGHT 1
const char mapBeamBlue1[] PROGMEM ={
1,1
,0xf};

#define MAPDKLADDER_WIDTH 3
#define MAPDKLADDER_HEIGHT 3
const char mapDKLadder[] PROGMEM ={
3,3
,0x17,0x18,0x19,0x24,0x25,0x26,0x2e,0x2f,0x30};

#define MAPDKTAUNT10_WIDTH 4
#define MAPDKTAUNT10_HEIGHT 4
const char mapDKTaunt10[] PROGMEM ={
4,4
,0x0,0x0,0x0,0x0,0x1a,0x1b,0x1c,0x0,0x27,0x28,0x26,0x0,0x31,0x32,0x33,0x0};

#define MAPDKTAUNT11_WIDTH 4
#define MAPDKTAUNT11_HEIGHT 4
const char mapDKTaunt11[] PROGMEM ={
4,4
,0x0,0x0,0x0,0x0,0x1d,0x1e,0x1f,0x0,0x24,0x29,0x2a,0x0,0x34,0x35,0x36,0x0};

#define MAPALPHABET_WIDTH 27
#define MAPALPHABET_HEIGHT 1
const char mapAlphabet[] PROGMEM ={
27,1
,0x3a,0x3b,0x3c,0x3d,0x3e,0x3f,0x40,0x41,0x42,0x43,0x44,0x45,0x46,0x47,0x48,0x49,0x4a,0x4b,0x4c,0x4d
,0x4e,0x4f,0x50,0x51,0x52,0x53,0x54};

#define MAPMETERS_WIDTH 1
#define MAPMETERS_HEIGHT 1
const char mapMeters[] PROGMEM ={
1,1
,0x55};

#define MAPPRESSSTART0_WIDTH 11
#define MAPPRESSSTART0_HEIGHT 1
const char mapPressStart0[] PROGMEM ={
11,1
,0x49,0x4b,0x3e,0x4c,0x4c,0x0,0x4c,0x4d,0x3a,0x4b,0x4d};

#define MAPPRESSSTART1_WIDTH 11
#define MAPPRESSSTART1_HEIGHT 1
const char mapPressStart1[] PROGMEM ={
11,1
,0x0,0x0,0x0,0x0,0x0,0x0,0x0,0x0,0x0,0x0,0x0};

#define MAPHOWHIGH_WIDTH 22
#define MAPHOWHIGH_HEIGHT 1
const char mapHowHigh[] PROGMEM ={
22,1
,0x41,0x48,0x50,0x0,0x41,0x42,0x40,0x41,0x0,0x3c,0x3a,0x47,0x0,0x52,0x48,0x4e,0x0,0x4d,0x4b,0x52
,0x0,0x54};

#define MAPRANK_WIDTH 4
#define MAPRANK_HEIGHT 1
const char mapRank[] PROGMEM ={
4,1
,0x4b,0x3a,0x47,0x44};

#define MAPSCORE_WIDTH 5
#define MAPSCORE_HEIGHT 1
const char mapScore[] PROGMEM ={
5,1
,0x4c,0x3c,0x48,0x4b,0x3e};

#define MAPNAME_WIDTH 4
#define MAPNAME_HEIGHT 1
const char mapName[] PROGMEM ={
4,1
,0x47,0x3a,0x46,0x3e};

#define MAP1ST_WIDTH 3
#define MAP1ST_HEIGHT 1
const char map1st[] PROGMEM ={
3,1
,0x6,0x4c,0x4d};

#define MAP2ND_WIDTH 3
#define MAP2ND_HEIGHT 1
const char map2nd[] PROGMEM ={
3,1
,0x7,0x47,0x3d};

#define MAP3RD_WIDTH 3
#define MAP3RD_HEIGHT 1
const char map3rd[] PROGMEM ={
3,1
,0x8,0x4b,0x3d};

#define MAP4TH_WIDTH 3
#define MAP4TH_HEIGHT 1
const char map4th[] PROGMEM ={
3,1
,0x9,0x4d,0x41};

#define MAPDONKEYTITLE_WIDTH 25
#define MAPDONKEYTITLE_HEIGHT 5
const char mapDonkeyTitle[] PROGMEM ={
25,5
,0xf,0xf,0x0,0x0,0xf,0xf,0xf,0x0,0xf,0x0,0x0,0xf,0x0,0xf,0x0,0x0,0xf,0x0,0xf,0xf
,0xf,0x0,0xf,0x0,0xf,0xf,0x0,0xf,0x0,0xf,0x0,0xf,0x0,0xf,0xf,0x0,0xf,0x0,0xf,0x0
,0xf,0x0,0x0,0xf,0x0,0x0,0x0,0xf,0x0,0xf,0xf,0x0,0xf,0x0,0xf,0x0,0xf,0x0,0xf,0xf
,0xf,0xf,0x0,0xf,0xf,0xf,0x0,0x0,0xf,0xf,0xf,0x0,0xf,0xf,0xf,0xf,0x0,0xf,0x0,0xf
,0x0,0xf,0x0,0xf,0x0,0xf,0xf,0x0,0xf,0x0,0xf,0x0,0x0,0xf,0x0,0x0,0x0,0x0,0xf,0x0
,0xf,0xf,0x0,0x0,0xf,0xf,0xf,0x0,0xf,0x0,0x0,0xf,0x0,0xf,0x0,0x0,0xf,0x0,0xf,0xf
,0xf,0x0,0x0,0xf,0x0};

#define MAPKONGTITLE_WIDTH 20
#define MAPKONGTITLE_HEIGHT 5
const char mapKongTitle[] PROGMEM ={
20,5
,0xf,0xf,0x0,0xf,0x0,0xf,0xf,0xf,0xf,0x0,0xf,0x0,0x0,0xf,0x0,0x0,0xf,0xf,0xf,0x0
,0xf,0xf,0xf,0xf,0x0,0xf,0xf,0x0,0xf,0x0,0xf,0xf,0x0,0xf,0x0,0xf,0xf,0x0,0x0,0x0
,0xf,0xf,0xf,0x0,0x0,0xf,0xf,0x0,0xf,0x0,0xf,0xf,0xf,0xf,0x0,0xf,0xf,0x0,0xf,0xf
,0xf,0xf,0x0,0xf,0x0,0xf,0xf,0x0,0xf,0x0,0xf,0x0,0xf,0xf,0x0,0xf,0xf,0x0,0x0,0xf
,0xf,0xf,0x0,0xf,0x0,0xf,0xf,0xf,0xf,0x0,0xf,0x0,0x0,0xf,0x0,0x0,0xf,0xf,0xf,0x0};


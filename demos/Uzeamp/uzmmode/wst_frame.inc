; wst_frame.inc -- the text frame streaming a song, and the blank's fill, GENERATED by
; gen_wst.py; do not edit. Cycles in the comments: from the entry line's start in the
; prologues, then from the line's start in the line programs.

; after the kernel's .text, so that mode 5's and the kernel's rcalls stay in reach
.section .text.wst

sub_video_wst:                               ;  479
	lds   r16, sound_stream                ;  479
	sbrc  r16, 0                           ;  481
	rjmp  wst_p31                          ;  482: 31.5 kHz at 484
	rjmp  wst_p15                          ;  483: 15.7 kHz at 485

wst_p31:                                     ;  484
	lds   r4, sound_stream_w               ;  484
	lds   r5, sound_stream_w+1             ;  486
	sts   wst+WST_O_W0, r4                 ;  488
	sts   wst+WST_O_W0+1, r5               ;  490
	lds   r6, mix_pos                      ;  492
	lds   r7, mix_pos+1                    ;  494
	lds   r8, wst+WST_O_K                  ;  496
	lds   r9, wst+WST_O_K+1                ;  498
	clr   r11                              ;  500
	clr   r12                              ;  501
	lds   r13, wst+WST_O_OFF               ;  502
	ldi   r16, lo8(mix_buf)                ;  504
	mov   r14, r16                         ;  505
	ldi   r16, hi8(mix_buf)                ;  506
	mov   r15, r16                         ;  507
	ldi   YL, lo8(vram)                    ;  508
	ldi   YH, hi8(vram)                    ;  509
	lds   r10, render_lines_count          ;  510
	clr   r22                              ;  512
	ldi   r23, TILE_WIDTH                  ;  513
	ldi   r16, (1 << SPE) | (1 << MSTR)    ;  514
	ldi   r17, (1 << SPI2X)                ;  515
	sbrs  r13, 0                           ;  516
	out   _SFR_IO_ADDR(SPCR), r16          ;
	sbrs  r13, 0                           ;  518
	out   _SFR_IO_ADDR(SPSR), r17          ;
	mov   r16, r13                         ;  520
	com   r16                              ;  521
	and   r8, r16                          ;  522
	and   r9, r16                          ;  523
	WAIT  r19, 408                          ;  524
	movw  ZL, r6                           ;  932
	ld    r16, Z                           ;  933
	sts   _SFR_MEM_ADDR(OCR2A), r16        ;  935
	cp    ZL, r4                           ;  937
	cpc   ZH, r5                           ;
	breq  1f                               ;
	ldi   r16, 0x80                        ;
	st    Z+, r16                          ;
	rjmp  2f                               ;
1:
	ldi   r16, 1                           ;
	or    r12, r16                         ;
	rjmp  .                                ;
2:
	ldi   r16, hi8(mix_buf+MIX_BUF_SIZE)   ;  945
	cpi   ZL, lo8(mix_buf+MIX_BUF_SIZE)    ;  946
	cpc   ZH, r16                          ;  947
	brne  .+2                              ;  948
	movw  ZL, r14                          ;
	movw  r6, ZL                           ;  950
	WAIT  r19, 869                          ;  951

wst_line31:                                  ; 1820 = 0 of the first line
	movw  ZL, r6                           ;    0
	nop                                    ;    1
	nop                                    ;    2
	cbi   _SFR_IO_ADDR(SYNC_PORT), SYNC_PIN ;    3
	nop                                    ;    5
	nop                                    ;    6
	nop                                    ;    7
	nop                                    ;    8
	nop                                    ;    9
	nop                                    ;   10
	nop                                    ;   11
	nop                                    ;   12
	nop                                    ;   13
	nop                                    ;   14
	nop                                    ;   15
	nop                                    ;   16
	nop                                    ;   17
	nop                                    ;   18
	nop                                    ;   19
	nop                                    ;   20
	nop                                    ;   21
	nop                                    ;   22
	nop                                    ;   23
	ld    r19, Z                           ;   24
	sts   _SFR_MEM_ADDR(OCR2A), r19        ;   26
	cp    ZL, r4                           ;   28
	cpc   ZH, r5                           ;
	breq  1f                               ;
	ldi   r16, 0x80                        ;
	st    Z+, r16                          ;
	rjmp  2f                               ;
1:
	ldi   r16, 1                           ;
	or    r12, r16                         ;
	rjmp  .                                ;
2:
	ldi   r16, hi8(mix_buf+MIX_BUF_SIZE)   ;   36
	cpi   ZL, lo8(mix_buf+MIX_BUF_SIZE)    ;   37
	cpc   ZH, r16                          ;
	brne  .+2                              ;
	movw  ZL, r14                          ;
	ld    r3, Z                            ;   41
	cp    ZL, r4                           ;   43
	cpc   ZH, r5                           ;
	breq  1f                               ;
	ldi   r16, 0x80                        ;
	st    Z+, r16                          ;
	rjmp  2f                               ;
1:
	ldi   r16, 1                           ;
	or    r12, r16                         ;
	rjmp  .                                ;
2:
	ldi   r16, hi8(mix_buf+MIX_BUF_SIZE)   ;   51
	cpi   ZL, lo8(mix_buf+MIX_BUF_SIZE)    ;   52
	cpc   ZH, r16                          ;
	brne  .+2                              ;
	movw  ZL, r14                          ;
	movw  r6, ZL                           ;   56
	ldi   r16, 12                          ;   57
	mov   r2, r16                          ;   58
	ldi   r20, 0xFF                        ;   59
	sbrs  r13, 0                           ;   60
	out   SPDR_IO, r20                     ;
	nop                                    ;   62
	nop                                    ;   63
	nop                                    ;   64
	nop                                    ;   65
	nop                                    ;   66
	nop                                    ;   67
	nop                                    ;   68
	nop                                    ;   69
	nop                                    ;   70
	nop                                    ;   71
	nop                                    ;   72
	nop                                    ;   73
	nop                                    ;   74
	nop                                    ;   75
	nop                                    ;   76
	nop                                    ;   77
	in    r17, SPDR_IO                     ;   78
	sbrs  r13, 0                           ;   79
	out   SPDR_IO, r20                     ;
	or    r17, r13                         ;   81
	lds   r24, wst+WST_O_LEFT              ;   82
	lds   r25, wst+WST_O_LEFT+1            ;   84
	ldi   r16, 2                           ;   86
	cp    r16, r8                          ;   87
	cpc   r11, r9                          ;
	sbc   r16, r16                         ;
	sbiw  r24, 1                           ;   90
	sbc   r18, r18                         ;
	com   r18                              ;   93
	and   r16, r18                         ;   94
	sbrc  r16, 0                           ;   95
	sts   wst+WST_O_LEFT, r24              ;
	sbrc  r16, 0                           ;   98
	sts   wst+WST_O_LEFT+1, r25            ;
	mov   r21, r17                         ;  101
	sbrs  r16, 0                           ;  102
	ldi   r21, 0x80                        ;
	movw  XL, r4                           ;  104
	st    X+, r21                          ;  105
	ldi   r18, hi8(mix_buf+MIX_BUF_SIZE)   ;  107
	cpi   XL, lo8(mix_buf+MIX_BUF_SIZE)    ;  108
	cpc   XH, r18                          ;
	brne  .+2                              ;
	movw  XL, r14                          ;
	sbrc  r16, 0                           ;  112
	movw  r4, XL                           ;
	movw  r24, r8                          ;  114
	sbiw  r24, 1                           ;
	brcs  1f                               ;
	movw  r8, r24                          ;
	rjmp  .                                ;
	rjmp  .                                ;
	rjmp  .                                ;
	rjmp  .                                ;
	nop                                    ;
	rjmp  2f                               ;
1:
	cpi   r17, 0xFE                        ;
	ldi   r16, 0                           ;
	brne  .+2                              ;
	ldi   r16, 0xFF                        ;
	cpi   r17, 0xFE                        ;
	sbc   r18, r18                         ;
	or    r13, r18                         ;
	ldi   r24, 2                           ;
	and   r24, r16                         ;
	mov   r25, r24                         ;
	movw  r8, r24                          ;
2:
	in    r17, SPDR_IO                     ;  130
	or    r17, r13                         ;  131
	lds   r24, wst+WST_O_LEFT              ;  132
	lds   r25, wst+WST_O_LEFT+1            ;  134
	ldi   r16, 2                           ;  136
	nop                                    ;  137
	nop                                    ;  138
	sbi   _SFR_IO_ADDR(SYNC_PORT), SYNC_PIN ;  139
	cp    r16, r8                          ;  141
	cpc   r11, r9                          ;
	sbc   r16, r16                         ;
	sbiw  r24, 1                           ;  144
	sbc   r18, r18                         ;
	com   r18                              ;  147
	and   r16, r18                         ;  148
	sbrc  r16, 0                           ;  149
	sts   wst+WST_O_LEFT, r24              ;
	sbrc  r16, 0                           ;  152
	sts   wst+WST_O_LEFT+1, r25            ;
	mov   r21, r17                         ;  155
	sbrs  r16, 0                           ;  156
	ldi   r21, 0x80                        ;
	movw  XL, r4                           ;  158
	st    X+, r21                          ;  159
	ldi   r18, hi8(mix_buf+MIX_BUF_SIZE)   ;  161
	cpi   XL, lo8(mix_buf+MIX_BUF_SIZE)    ;  162
	cpc   XH, r18                          ;
	brne  .+2                              ;
	movw  XL, r14                          ;
	sbrc  r16, 0                           ;  166
	movw  r4, XL                           ;
	movw  r24, r8                          ;  168
	sbiw  r24, 1                           ;
	brcs  1f                               ;
	movw  r8, r24                          ;
	rjmp  .                                ;
	rjmp  .                                ;
	rjmp  .                                ;
	rjmp  .                                ;
	nop                                    ;
	rjmp  2f                               ;
1:
	cpi   r17, 0xFE                        ;
	ldi   r16, 0                           ;
	brne  .+2                              ;
	ldi   r16, 0xFF                        ;
	cpi   r17, 0xFE                        ;
	sbc   r18, r18                         ;
	or    r13, r18                         ;
	ldi   r24, 2                           ;
	and   r24, r16                         ;
	mov   r25, r24                         ;
	movw  r8, r24                          ;
2:
	nop                                    ;  184
	nop                                    ;  185
	nop                                    ;  186
	nop                                    ;  187
	nop                                    ;  188
	nop                                    ;  189
	nop                                    ;  190
	nop                                    ;  191
	nop                                    ;  192
	nop                                    ;  193
	nop                                    ;  194
	nop                                    ;  195
	nop                                    ;  196
	nop                                    ;  197
	nop                                    ;  198
	nop                                    ;  199
	nop                                    ;  200
	nop                                    ;  201
	nop                                    ;  202
	nop                                    ;  203
	nop                                    ;  204
	nop                                    ;  205
	nop                                    ;  206
	nop                                    ;  207
	nop                                    ;  208
	nop                                    ;  209
	nop                                    ;  210
	nop                                    ;  211
	nop                                    ;  212
	nop                                    ;  213
	nop                                    ;  214
	nop                                    ;  215
	nop                                    ;  216
	nop                                    ;  217
	nop                                    ;  218
	nop                                    ;  219
	nop                                    ;  220
	nop                                    ;  221
	nop                                    ;  222
	nop                                    ;  223
	nop                                    ;  224
	nop                                    ;  225
	nop                                    ;  226
	nop                                    ;  227
	nop                                    ;  228
	nop                                    ;  229
	nop                                    ;  230
	nop                                    ;  231
	nop                                    ;  232
	nop                                    ;  233
	nop                                    ;  234
	nop                                    ;  235
	nop                                    ;  236
	nop                                    ;  237
	nop                                    ;  238
	nop                                    ;  239
	nop                                    ;  240
	nop                                    ;  241
	nop                                    ;  242
	nop                                    ;  243
	nop                                    ;  244
	nop                                    ;  245
	nop                                    ;  246
	nop                                    ;  247
	nop                                    ;  248
	nop                                    ;  249
	nop                                    ;  250
	nop                                    ;  251
	nop                                    ;  252
	nop                                    ;  253
	nop                                    ;  254
	nop                                    ;  255
	nop                                    ;  256
	nop                                    ;  257
	nop                                    ;  258
	nop                                    ;  259
	nop                                    ;  260
	nop                                    ;  261
	nop                                    ;  262
	nop                                    ;  263
	nop                                    ;  264
	nop                                    ;  265
	nop                                    ;  266
	nop                                    ;  267
	nop                                    ;  268
	nop                                    ;  269
	nop                                    ;  270
	nop                                    ;  271
	nop                                    ;  272
	nop                                    ;  273
	nop                                    ;  274
	nop                                    ;  275
	nop                                    ;  276
	nop                                    ;  277
	nop                                    ;  278
	nop                                    ;  279
	nop                                    ;  280
	nop                                    ;  281
	nop                                    ;  282
	nop                                    ;  283
	nop                                    ;  284
	nop                                    ;  285
	movw  XL, YL                           ;  286
	ldi   r17, TILE_HEIGHT*TILE_WIDTH      ;  287
	lds   r24, tile_table_lo               ;  288
	lds   r25, tile_table_hi               ;  290
	mul   r22, r23                         ;  292
	add   r24, r0                          ;  294
	adc   r25, r1                          ;  295
	ld    r20, X+                          ;  296
	mul   r20, r17                         ;  298
	add   r0, r24                          ;  300
	adc   r1, r25                          ;  301
	movw  ZL, r0                           ;  302
	ldi   r18, SCREEN_TILES_H              ;  303
wst_loop31:                                  ;  304 + 48k
	lpm   r16, Z+                          ;  304 + 48k
	out   VIDEO_PORT, r16                  ;  307 + 48k
	lpm   r16, Z+                          ;  308 + 48k
	sts   _SFR_MEM_ADDR(OCR2A), r19        ;  311 + 48k
	out   VIDEO_PORT, r16                  ;  313 + 48k
	ld    r20, X+                          ;  314 + 48k
	lpm   r16, Z+                          ;  316 + 48k
	out   VIDEO_PORT, r16                  ;  319 + 48k
	mul   r20, r17                         ;  320 + 48k
	lpm   r16, Z+                          ;  322 + 48k
	out   VIDEO_PORT, r16                  ;  325 + 48k
	movw  r20, r24                         ;  326 + 48k
	add   r20, r0                          ;  327 + 48k
	lpm   r16, Z+                          ;  328 + 48k
	out   VIDEO_PORT, r16                  ;  331 + 48k
	adc   r21, r1                          ;  332 + 48k
	dec   r2                               ;  333 + 48k
	lpm   r16, Z+                          ;  334 + 48k
	out   VIDEO_PORT, r16                  ;  337 + 48k
	sbrc  r2, 7                            ;  338 + 48k
	mov   r19, r3                          ;  339 + 48k
	lpm   r16, Z+                          ;  340 + 48k
	out   VIDEO_PORT, r16                  ;  343 + 48k
	lpm   r16, Z+                          ;  344 + 48k
	movw  ZL, r20                          ;  347 + 48k
	dec   r18                              ;  348 + 48k
	out   VIDEO_PORT, r16                  ;  349 + 48k
	brne  wst_loop31                       ;  350 + 48k
	sts   mix_pos, r6                      ; 1743
	sts   mix_pos+1, r7                    ; 1745
	out   VIDEO_PORT, r11                  ; 1747
	sts   sound_stream_w, r4               ; 1748
	sts   sound_stream_w+1, r5             ; 1750
	inc   r22                              ; 1752
	cpi   r22, 8                           ; 1753
	ldi   r16, 0                           ;
	brne  .+2                              ;
	ldi   r16, VRAM_TILES_H                ;
	add   YL, r16                          ; 1757
	adc   YH, r11                          ;
	andi  r22, 7                           ; 1759
	nop                                    ; 1760
	nop                                    ; 1761
	nop                                    ; 1762
	nop                                    ; 1763
	nop                                    ; 1764
	nop                                    ; 1765
	nop                                    ; 1766
	nop                                    ; 1767
	nop                                    ; 1768
	nop                                    ; 1769
	nop                                    ; 1770
	nop                                    ; 1771
	nop                                    ; 1772
	nop                                    ; 1773
	nop                                    ; 1774
	nop                                    ; 1775
	nop                                    ; 1776
	nop                                    ; 1777
	nop                                    ; 1778
	nop                                    ; 1779
	nop                                    ; 1780
	nop                                    ; 1781
	nop                                    ; 1782
	nop                                    ; 1783
	nop                                    ; 1784
	nop                                    ; 1785
	nop                                    ; 1786
	nop                                    ; 1787
	nop                                    ; 1788
	nop                                    ; 1789
	nop                                    ; 1790
	nop                                    ; 1791
	nop                                    ; 1792
	nop                                    ; 1793
	nop                                    ; 1794
	nop                                    ; 1795
	nop                                    ; 1796
	nop                                    ; 1797
	nop                                    ; 1798
	nop                                    ; 1799
	nop                                    ; 1800
	nop                                    ; 1801
	nop                                    ; 1802
	nop                                    ; 1803
	nop                                    ; 1804
	nop                                    ; 1805
	nop                                    ; 1806
	nop                                    ; 1807
	nop                                    ; 1808
	nop                                    ; 1809
	nop                                    ; 1810
	nop                                    ; 1811
	nop                                    ; 1812
	nop                                    ; 1813
	nop                                    ; 1814
	dec   r10                              ; 1815
	brne  2f                               ; 1816: taken, at 1818
	nop                                    ; 1817
	nop                                    ; 1818
	call  hsync_pulse                      ; 1819: the last line: its cbi at 3, A at 26
	jmp   wst_end
2:	rjmp  wst_line31                       ; 1818

wst_p15:                                     ;  485
	lds   r4, sound_stream_w               ;  485
	lds   r5, sound_stream_w+1             ;  487
	sts   wst+WST_O_W0, r4                 ;  489
	sts   wst+WST_O_W0+1, r5               ;  491
	lds   r6, mix_pos                      ;  493
	lds   r7, mix_pos+1                    ;  495
	lds   r8, wst+WST_O_K                  ;  497
	lds   r9, wst+WST_O_K+1                ;  499
	clr   r11                              ;  501
	clr   r12                              ;  502
	lds   r13, wst+WST_O_OFF               ;  503
	ldi   r16, lo8(mix_buf)                ;  505
	mov   r14, r16                         ;  506
	ldi   r16, hi8(mix_buf)                ;  507
	mov   r15, r16                         ;  508
	ldi   YL, lo8(vram)                    ;  509
	ldi   YH, hi8(vram)                    ;  510
	lds   r10, render_lines_count          ;  511
	clr   r22                              ;  513
	ldi   r23, TILE_WIDTH                  ;  514
	ldi   r16, (1 << SPE) | (1 << MSTR)    ;  515
	ldi   r17, (1 << SPI2X)                ;  516
	sbrs  r13, 0                           ;  517
	out   _SFR_IO_ADDR(SPCR), r16          ;
	sbrs  r13, 0                           ;  519
	out   _SFR_IO_ADDR(SPSR), r17          ;
	mov   r16, r13                         ;  521
	com   r16                              ;  522
	and   r8, r16                          ;  523
	and   r9, r16                          ;  524
	WAIT  r19, 1295                         ;  525

wst_line15:                                  ; 1820 = 0 of the first line
	movw  ZL, r6                           ;    0
	nop                                    ;    1
	nop                                    ;    2
	cbi   _SFR_IO_ADDR(SYNC_PORT), SYNC_PIN ;    3
	nop                                    ;    5
	nop                                    ;    6
	nop                                    ;    7
	nop                                    ;    8
	nop                                    ;    9
	nop                                    ;   10
	nop                                    ;   11
	nop                                    ;   12
	nop                                    ;   13
	nop                                    ;   14
	nop                                    ;   15
	nop                                    ;   16
	nop                                    ;   17
	nop                                    ;   18
	nop                                    ;   19
	nop                                    ;   20
	nop                                    ;   21
	nop                                    ;   22
	nop                                    ;   23
	ld    r19, Z                           ;   24
	sts   _SFR_MEM_ADDR(OCR2A), r19        ;   26
	cp    ZL, r4                           ;   28
	cpc   ZH, r5                           ;
	breq  1f                               ;
	ldi   r16, 0x80                        ;
	st    Z+, r16                          ;
	rjmp  2f                               ;
1:
	ldi   r16, 1                           ;
	or    r12, r16                         ;
	rjmp  .                                ;
2:
	ldi   r16, hi8(mix_buf+MIX_BUF_SIZE)   ;   36
	cpi   ZL, lo8(mix_buf+MIX_BUF_SIZE)    ;   37
	cpc   ZH, r16                          ;
	brne  .+2                              ;
	movw  ZL, r14                          ;
	movw  r6, ZL                           ;   41
	mov   r3, r19                          ;   42
	ldi   r16, 12                          ;   43
	mov   r2, r16                          ;   44
	ldi   r20, 0xFF                        ;   45
	sbrs  r13, 0                           ;   46
	out   SPDR_IO, r20                     ;
	nop                                    ;   48
	nop                                    ;   49
	nop                                    ;   50
	nop                                    ;   51
	nop                                    ;   52
	nop                                    ;   53
	nop                                    ;   54
	nop                                    ;   55
	nop                                    ;   56
	nop                                    ;   57
	nop                                    ;   58
	nop                                    ;   59
	nop                                    ;   60
	nop                                    ;   61
	nop                                    ;   62
	nop                                    ;   63
	in    r17, SPDR_IO                     ;   64
	or    r17, r13                         ;   65
	lds   r24, wst+WST_O_LEFT              ;   66
	lds   r25, wst+WST_O_LEFT+1            ;   68
	ldi   r16, 2                           ;   70
	cp    r16, r8                          ;   71
	cpc   r11, r9                          ;
	sbc   r16, r16                         ;
	sbiw  r24, 1                           ;   74
	sbc   r18, r18                         ;
	com   r18                              ;   77
	and   r16, r18                         ;   78
	sbrc  r16, 0                           ;   79
	sts   wst+WST_O_LEFT, r24              ;
	sbrc  r16, 0                           ;   82
	sts   wst+WST_O_LEFT+1, r25            ;
	mov   r21, r17                         ;   85
	sbrs  r16, 0                           ;   86
	ldi   r21, 0x80                        ;
	movw  XL, r4                           ;   88
	st    X+, r21                          ;   89
	ldi   r18, hi8(mix_buf+MIX_BUF_SIZE)   ;   91
	cpi   XL, lo8(mix_buf+MIX_BUF_SIZE)    ;   92
	cpc   XH, r18                          ;
	brne  .+2                              ;
	movw  XL, r14                          ;
	sbrc  r16, 0                           ;   96
	movw  r4, XL                           ;
	movw  r24, r8                          ;   98
	sbiw  r24, 1                           ;
	brcs  1f                               ;
	movw  r8, r24                          ;
	rjmp  .                                ;
	rjmp  .                                ;
	rjmp  .                                ;
	rjmp  .                                ;
	nop                                    ;
	rjmp  2f                               ;
1:
	cpi   r17, 0xFE                        ;
	ldi   r16, 0                           ;
	brne  .+2                              ;
	ldi   r16, 0xFF                        ;
	cpi   r17, 0xFE                        ;
	sbc   r18, r18                         ;
	or    r13, r18                         ;
	ldi   r24, 2                           ;
	and   r24, r16                         ;
	mov   r25, r24                         ;
	movw  r8, r24                          ;
2:
	nop                                    ;  114
	nop                                    ;  115
	nop                                    ;  116
	nop                                    ;  117
	nop                                    ;  118
	nop                                    ;  119
	nop                                    ;  120
	nop                                    ;  121
	nop                                    ;  122
	nop                                    ;  123
	nop                                    ;  124
	nop                                    ;  125
	nop                                    ;  126
	nop                                    ;  127
	nop                                    ;  128
	nop                                    ;  129
	nop                                    ;  130
	nop                                    ;  131
	nop                                    ;  132
	nop                                    ;  133
	nop                                    ;  134
	nop                                    ;  135
	nop                                    ;  136
	nop                                    ;  137
	nop                                    ;  138
	sbi   _SFR_IO_ADDR(SYNC_PORT), SYNC_PIN ;  139
	nop                                    ;  141
	nop                                    ;  142
	nop                                    ;  143
	nop                                    ;  144
	nop                                    ;  145
	nop                                    ;  146
	nop                                    ;  147
	nop                                    ;  148
	nop                                    ;  149
	nop                                    ;  150
	nop                                    ;  151
	nop                                    ;  152
	nop                                    ;  153
	nop                                    ;  154
	nop                                    ;  155
	nop                                    ;  156
	nop                                    ;  157
	nop                                    ;  158
	nop                                    ;  159
	nop                                    ;  160
	nop                                    ;  161
	nop                                    ;  162
	nop                                    ;  163
	nop                                    ;  164
	nop                                    ;  165
	nop                                    ;  166
	nop                                    ;  167
	nop                                    ;  168
	nop                                    ;  169
	nop                                    ;  170
	nop                                    ;  171
	nop                                    ;  172
	nop                                    ;  173
	nop                                    ;  174
	nop                                    ;  175
	nop                                    ;  176
	nop                                    ;  177
	nop                                    ;  178
	nop                                    ;  179
	nop                                    ;  180
	nop                                    ;  181
	nop                                    ;  182
	nop                                    ;  183
	nop                                    ;  184
	nop                                    ;  185
	nop                                    ;  186
	nop                                    ;  187
	nop                                    ;  188
	nop                                    ;  189
	nop                                    ;  190
	nop                                    ;  191
	nop                                    ;  192
	nop                                    ;  193
	nop                                    ;  194
	nop                                    ;  195
	nop                                    ;  196
	nop                                    ;  197
	nop                                    ;  198
	nop                                    ;  199
	nop                                    ;  200
	nop                                    ;  201
	nop                                    ;  202
	nop                                    ;  203
	nop                                    ;  204
	nop                                    ;  205
	nop                                    ;  206
	nop                                    ;  207
	nop                                    ;  208
	nop                                    ;  209
	nop                                    ;  210
	nop                                    ;  211
	nop                                    ;  212
	nop                                    ;  213
	nop                                    ;  214
	nop                                    ;  215
	nop                                    ;  216
	nop                                    ;  217
	nop                                    ;  218
	nop                                    ;  219
	nop                                    ;  220
	nop                                    ;  221
	nop                                    ;  222
	nop                                    ;  223
	nop                                    ;  224
	nop                                    ;  225
	nop                                    ;  226
	nop                                    ;  227
	nop                                    ;  228
	nop                                    ;  229
	nop                                    ;  230
	nop                                    ;  231
	nop                                    ;  232
	nop                                    ;  233
	nop                                    ;  234
	nop                                    ;  235
	nop                                    ;  236
	nop                                    ;  237
	nop                                    ;  238
	nop                                    ;  239
	nop                                    ;  240
	nop                                    ;  241
	nop                                    ;  242
	nop                                    ;  243
	nop                                    ;  244
	nop                                    ;  245
	nop                                    ;  246
	nop                                    ;  247
	nop                                    ;  248
	nop                                    ;  249
	nop                                    ;  250
	nop                                    ;  251
	nop                                    ;  252
	nop                                    ;  253
	nop                                    ;  254
	nop                                    ;  255
	nop                                    ;  256
	nop                                    ;  257
	nop                                    ;  258
	nop                                    ;  259
	nop                                    ;  260
	nop                                    ;  261
	nop                                    ;  262
	nop                                    ;  263
	nop                                    ;  264
	nop                                    ;  265
	nop                                    ;  266
	nop                                    ;  267
	nop                                    ;  268
	nop                                    ;  269
	nop                                    ;  270
	nop                                    ;  271
	nop                                    ;  272
	nop                                    ;  273
	nop                                    ;  274
	nop                                    ;  275
	nop                                    ;  276
	nop                                    ;  277
	nop                                    ;  278
	nop                                    ;  279
	nop                                    ;  280
	nop                                    ;  281
	nop                                    ;  282
	nop                                    ;  283
	nop                                    ;  284
	nop                                    ;  285
	movw  XL, YL                           ;  286
	ldi   r17, TILE_HEIGHT*TILE_WIDTH      ;  287
	lds   r24, tile_table_lo               ;  288
	lds   r25, tile_table_hi               ;  290
	mul   r22, r23                         ;  292
	add   r24, r0                          ;  294
	adc   r25, r1                          ;  295
	ld    r20, X+                          ;  296
	mul   r20, r17                         ;  298
	add   r0, r24                          ;  300
	adc   r1, r25                          ;  301
	movw  ZL, r0                           ;  302
	ldi   r18, SCREEN_TILES_H              ;  303
wst_loop15:                                  ;  304 + 48k
	lpm   r16, Z+                          ;  304 + 48k
	out   VIDEO_PORT, r16                  ;  307 + 48k
	lpm   r16, Z+                          ;  308 + 48k
	sts   _SFR_MEM_ADDR(OCR2A), r19        ;  311 + 48k
	out   VIDEO_PORT, r16                  ;  313 + 48k
	ld    r20, X+                          ;  314 + 48k
	lpm   r16, Z+                          ;  316 + 48k
	out   VIDEO_PORT, r16                  ;  319 + 48k
	mul   r20, r17                         ;  320 + 48k
	lpm   r16, Z+                          ;  322 + 48k
	out   VIDEO_PORT, r16                  ;  325 + 48k
	movw  r20, r24                         ;  326 + 48k
	add   r20, r0                          ;  327 + 48k
	lpm   r16, Z+                          ;  328 + 48k
	out   VIDEO_PORT, r16                  ;  331 + 48k
	adc   r21, r1                          ;  332 + 48k
	dec   r2                               ;  333 + 48k
	lpm   r16, Z+                          ;  334 + 48k
	out   VIDEO_PORT, r16                  ;  337 + 48k
	sbrc  r2, 7                            ;  338 + 48k
	mov   r19, r3                          ;  339 + 48k
	lpm   r16, Z+                          ;  340 + 48k
	out   VIDEO_PORT, r16                  ;  343 + 48k
	lpm   r16, Z+                          ;  344 + 48k
	movw  ZL, r20                          ;  347 + 48k
	dec   r18                              ;  348 + 48k
	out   VIDEO_PORT, r16                  ;  349 + 48k
	brne  wst_loop15                       ;  350 + 48k
	sts   mix_pos, r6                      ; 1743
	sts   mix_pos+1, r7                    ; 1745
	out   VIDEO_PORT, r11                  ; 1747
	sts   sound_stream_w, r4               ; 1748
	sts   sound_stream_w+1, r5             ; 1750
	inc   r22                              ; 1752
	cpi   r22, 8                           ; 1753
	ldi   r16, 0                           ;
	brne  .+2                              ;
	ldi   r16, VRAM_TILES_H                ;
	add   YL, r16                          ; 1757
	adc   YH, r11                          ;
	andi  r22, 7                           ; 1759
	nop                                    ; 1760
	nop                                    ; 1761
	nop                                    ; 1762
	nop                                    ; 1763
	nop                                    ; 1764
	nop                                    ; 1765
	nop                                    ; 1766
	nop                                    ; 1767
	nop                                    ; 1768
	nop                                    ; 1769
	nop                                    ; 1770
	nop                                    ; 1771
	nop                                    ; 1772
	nop                                    ; 1773
	nop                                    ; 1774
	nop                                    ; 1775
	nop                                    ; 1776
	nop                                    ; 1777
	nop                                    ; 1778
	nop                                    ; 1779
	nop                                    ; 1780
	nop                                    ; 1781
	nop                                    ; 1782
	nop                                    ; 1783
	nop                                    ; 1784
	nop                                    ; 1785
	nop                                    ; 1786
	nop                                    ; 1787
	nop                                    ; 1788
	nop                                    ; 1789
	nop                                    ; 1790
	nop                                    ; 1791
	nop                                    ; 1792
	nop                                    ; 1793
	nop                                    ; 1794
	nop                                    ; 1795
	nop                                    ; 1796
	nop                                    ; 1797
	nop                                    ; 1798
	nop                                    ; 1799
	nop                                    ; 1800
	nop                                    ; 1801
	nop                                    ; 1802
	nop                                    ; 1803
	nop                                    ; 1804
	nop                                    ; 1805
	nop                                    ; 1806
	nop                                    ; 1807
	nop                                    ; 1808
	nop                                    ; 1809
	nop                                    ; 1810
	nop                                    ; 1811
	nop                                    ; 1812
	nop                                    ; 1813
	nop                                    ; 1814
	dec   r10                              ; 1815
	brne  2f                               ; 1816: taken, at 1818
	nop                                    ; 1817
	nop                                    ; 1818
	call  hsync_pulse                      ; 1819: the last line: its cbi at 3, A at 26
	jmp   wst_end
2:	rjmp  wst_line15                       ; 1818

wst_end:                                ; (after the last line's hsync_pulse)

	; a sample held (the ring was empty)
	tst   r12
	breq  2f
	sts   sound_stream_held, r12
2:
	; the data bytes stored: (W - W at the start) mod the ring (at most a frame's lines' worth)
	lds   r24, wst+WST_O_W0
	lds   r25, wst+WST_O_W0+1
	movw  r26, r4
	sub   r26, r24
	sbc   r27, r25
	brcc  1f
	subi  r26, lo8(-(MIX_BUF_SIZE))
	sbci  r27, hi8(-(MIX_BUF_SIZE))
1:	lds   r24, wst+WST_O_STORED
	lds   r25, wst+WST_O_STORED+1
	add   r24, r26
	adc   r25, r27
	sts   wst+WST_O_STORED, r24
	sts   wst+WST_O_STORED+1, r25
	sts   sound_stream_w, r4
	sts   sound_stream_w+1, r5
	sts   wst+WST_O_K, r8
	sts   wst+WST_O_K+1, r9

	; the SPI off if the frame had it (nothing is being clocked: each line read its bytes)
	lds   r16, wst+WST_O_OFF
	ldi   r17, (1 << MSTR)
	sbrs  r16, 0
	out   _SFR_IO_ADDR(SPCR), r17
	sts   wst+WST_O_OFF, r13
	lds   r24, wst+WST_O_FRAMES
	lds   r25, wst+WST_O_FRAMES+1
	adiw  r24, 1
	sts   wst+WST_O_FRAMES, r24
	sts   wst+WST_O_FRAMES+1, r25

	; the inline pulses did not count down sync_pulse; hsync_pulse did, once
	lds   r24, sync_pulse
	lds   r25, render_lines_count
	sub   r24, r25
	sts   sync_pulse, r24

	; vsync flag, field flip
	lds   ZL, sync_flags
	ldi   r20, SYNC_FLAG_FIELD
	ori   ZL, SYNC_FLAG_VSYNC
	eor   ZL, r20
	sts   sync_flags, ZL

	; clear any pending timer interrupt
	ldi   ZL, (1 << OCF1A)
	sts   _SFR_MEM_ADDR(TIFR1), ZL
	ret

;
; uint16_t wst_fill(uint16_t max)
;
; The blank's share of the stream: bytes from the open read through the state machine, as the
; frame takes them, until WST_FILL_MAX are unread in the ring, max data bytes are stored (give
; or take 16: the song's end), the read stops (an error token), or the next frame is two lines
; away. Interrupts stay on. Returns the data bytes stored (also added to wst.stored); nothing is
; being clocked when it returns, and the SPI is off. Does nothing when wst.off is set.
;
wst_fill:
	lds   r24, wst+WST_O_OFF
	tst   r24
	breq  1f
	clr   r24
	clr   r25
	ret
1:	push  r2
	push  r3
	push  r4
	push  r5
	push  r8
	push  r9
	push  r11
	push  r13
	push  r14
	push  r15
	push  r16
	push  r17
	push  r28
	push  r29
	movw  r2, r24                      ; max
	lds   r4, sound_stream_w
	lds   r5, sound_stream_w+1
	lds   r8, wst+WST_O_K
	lds   r9, wst+WST_O_K+1
	clr   r11
	clr   r13
	ldi   r16, lo8(mix_buf)
	mov   r14, r16
	ldi   r16, hi8(mix_buf)
	mov   r15, r16
	movw  YL, r4                       ; W at the last count
	clr   r22                          ; r23:r22: the data bytes stored
	clr   r23
	ldi   r20, 0xFF
	lds   r18, first_render_line
	lds   r19, render_lines_count
	ldi   ZL, 255
	sub   ZL, r18                      ; hi: two lines before the frame
	ldi   ZH, 253
	sub   ZH, r18
	sub   ZH, r19                      ; lo: the frame's last line
	ldi   r16, (1 << SPE) | (1 << MSTR)
	out   _SFR_IO_ADDR(SPCR), r16
	ldi   r16, (1 << SPI2X)
	out   _SFR_IO_ADDR(SPSR), r16
	out   SPDR_IO, r20                 ; the first byte

w_check:                               ; (at least 17 cycles from the last out to the next in)
	lds   r16, sync_phase
	sbrs  r16, 0
	rjmp  w_room                       ; the vsync's pulses: no frame near
	lds   r16, sync_pulse
	cp    ZH, r16
	brsh  w_room                       ; after the frame
	cp    ZL, r16
	brlo  w_room
	rjmp  w_stop                       ; the frame is two lines away or less
w_room:
	movw  r24, r4                      ; stored since the last count: (W - Y) mod the ring
	sub   r24, YL
	sbc   r25, YH
	brcc  2f
	subi  r24, lo8(-(MIX_BUF_SIZE))
	sbci  r25, hi8(-(MIX_BUF_SIZE))
2:	add   r22, r24
	adc   r23, r25
	movw  YL, r4
	cli                                ; W for the kernel's reads (they stop there)
	sts   sound_stream_w, r4
	sts   sound_stream_w+1, r5
	sei
	tst   r13
	breq  6f
	rjmp  w_stop                       ; an error token: the read has stopped
6:	cp    r22, r2
	cpc   r23, r3
	brlo  7f
	rjmp  w_stop                       ; max stored
7:	cli                               ; unread: (W - mix_pos) mod the ring
	lds   r24, mix_pos
	lds   r25, mix_pos+1
	sei
	movw  r18, r4
	sub   r18, r24
	sbc   r19, r25
	brcc  3f
	subi  r18, lo8(-(MIX_BUF_SIZE))
	sbci  r19, hi8(-(MIX_BUF_SIZE))
3:	cpi   r18, lo8(WST_FILL_MAX)
	ldi   r16, hi8(WST_FILL_MAX)
	cpc   r19, r16
	brlo  8f
	rjmp  w_stop                       ; the ring is full enough
8:	ldi   r19, 16
w_slot:
	in    r17, SPDR_IO
	sbrs  r13, 0
	out   SPDR_IO, r20
	or    r17, r13
	lds   r24, wst+WST_O_LEFT
	lds   r25, wst+WST_O_LEFT+1
	ldi   r16, 2
	cp    r16, r8
	cpc   r11, r9
	sbc   r16, r16
	sbiw  r24, 1
	sbc   r18, r18
	com   r18
	and   r16, r18
	sbrc  r16, 0
	sts   wst+WST_O_LEFT, r24
	sbrc  r16, 0
	sts   wst+WST_O_LEFT+1, r25
	mov   r21, r17
	sbrs  r16, 0
	ldi   r21, 0x80
	movw  XL, r4
	cli
	st    X+, r21
	ldi   r18, hi8(mix_buf+MIX_BUF_SIZE)
	cpi   XL, lo8(mix_buf+MIX_BUF_SIZE)
	cpc   XH, r18
	brne  .+2
	movw  XL, r14
	sbrc  r16, 0
	movw  r4, XL
	sts   sound_stream_w, r4
	sts   sound_stream_w+1, r5
	sei
	movw  r24, r8
	sbiw  r24, 1
	brcs  1f
	movw  r8, r24
	rjmp  .
	rjmp  .
	rjmp  .
	rjmp  .
	nop
	rjmp  2f
1:
	cpi   r17, 0xFE
	ldi   r16, 0
	brne  .+2
	ldi   r16, 0xFF
	cpi   r17, 0xFE
	sbc   r18, r18
	or    r13, r18
	ldi   r24, 2
	and   r24, r16
	mov   r25, r24
	movw  r8, r24
2:
	dec   r19
	breq  .+2
	rjmp  w_slot
	rjmp  w_check

w_stop:                                ; a byte may be being clocked: let it in
	ldi   r16, 6
4:	dec   r16
	brne  4b
	in    r17, SPDR_IO
	or    r17, r13
	lds   r24, wst+WST_O_LEFT
	lds   r25, wst+WST_O_LEFT+1
	ldi   r16, 2
	cp    r16, r8
	cpc   r11, r9
	sbc   r16, r16
	sbiw  r24, 1
	sbc   r18, r18
	com   r18
	and   r16, r18
	sbrc  r16, 0
	sts   wst+WST_O_LEFT, r24
	sbrc  r16, 0
	sts   wst+WST_O_LEFT+1, r25
	mov   r21, r17
	sbrs  r16, 0
	ldi   r21, 0x80
	movw  XL, r4
	cli
	st    X+, r21
	ldi   r18, hi8(mix_buf+MIX_BUF_SIZE)
	cpi   XL, lo8(mix_buf+MIX_BUF_SIZE)
	cpc   XH, r18
	brne  .+2
	movw  XL, r14
	sbrc  r16, 0
	movw  r4, XL
	sts   sound_stream_w, r4
	sts   sound_stream_w+1, r5
	sei
	movw  r24, r8
	sbiw  r24, 1
	brcs  1f
	movw  r8, r24
	rjmp  .
	rjmp  .
	rjmp  .
	rjmp  .
	nop
	rjmp  2f
1:
	cpi   r17, 0xFE
	ldi   r16, 0
	brne  .+2
	ldi   r16, 0xFF
	cpi   r17, 0xFE
	sbc   r18, r18
	or    r13, r18
	ldi   r24, 2
	and   r24, r16
	mov   r25, r24
	movw  r8, r24
2:
	ldi   r16, (1 << MSTR)             ; the SPI off: the clock stops, the card stays selected
	out   _SFR_IO_ADDR(SPCR), r16
	movw  r24, r4
	sub   r24, YL
	sbc   r25, YH
	brcc  5f
	subi  r24, lo8(-(MIX_BUF_SIZE))
	sbci  r25, hi8(-(MIX_BUF_SIZE))
5:	add   r22, r24
	adc   r23, r25
	sts   sound_stream_w, r4
	sts   sound_stream_w+1, r5
	sts   wst+WST_O_K, r8
	sts   wst+WST_O_K+1, r9
	sts   wst+WST_O_OFF, r13
	lds   r24, wst+WST_O_STORED
	lds   r25, wst+WST_O_STORED+1
	add   r24, r22
	adc   r25, r23
	sts   wst+WST_O_STORED, r24
	sts   wst+WST_O_STORED+1, r25
	movw  r24, r22
	pop   r29
	pop   r28
	pop   r17
	pop   r16
	pop   r15
	pop   r14
	pop   r13
	pop   r11
	pop   r9
	pop   r8
	pop   r5
	pop   r4
	pop   r3
	pop   r2
	ret

.section .text

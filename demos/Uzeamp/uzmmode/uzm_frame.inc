; uzm_frame.inc -- the video frame of Uzeamp's mode, GENERATED by gen_uzm.py; do not edit.
; Cycles in the comments: from the entry line's start in the prologue, then from the line's
; start in the line program.

sub_video_uzm:
	lds   r16, uzm+UZM_O_ON                ;  467
	sbrs  r16, 0                           ;  469  video: skips the jmp (3 cycles)
	jmp   sub_video_mode5                  ;  470  text: mode 5 entered at 473
	lds   XL, uzm+UZM_O_X                  ;  472
	lds   XH, uzm+UZM_O_X+1                ;  474
	lds   YL, uzm+UZM_O_Y                  ;  476
	lds   YH, uzm+UZM_O_Y+1                ;  478
	movw  r12, YL                          ;  480
	lds   r8, uzm+UZM_O_PC                 ;  481
	lds   r9, uzm+UZM_O_PC+1               ;  483
	lds   r10, uzm+UZM_O_CC                ;  485
	lds   r11, uzm+UZM_O_CC+1              ;  487
	lds   r6, uzm+UZM_O_AW                 ;  489
	lds   r7, uzm+UZM_O_AW+1               ;  491
	lds   r4, mix_pos                      ;  493
	lds   r5, mix_pos+1                    ;  495
	ldi   r20, 0xFF                        ;  497
	clr   r0                               ;  498
	clr   r14                              ;  499
	clr   r15                              ;  500
	ldi   r25, 228                         ;  501
	ldi   r19, (1 << SPI2X)                ;  502
	out   _SFR_IO_ADDR(SPSR), r19          ;  503
	movw  r22, r8                          ;  504
	sub   r22, r10                         ;  505
	sbc   r23, r11                         ;
	ldi   r21, 0xFE                        ;  507
	ldi   r19, hi8(UZM_STALL)              ;  508
	cpi   r22, lo8(UZM_STALL)              ;  509
	cpc   r23, r19                         ;
	brlt  .+2                              ;
	ldi   r21, 0                           ;
	lds   r19, uzm+UZM_O_PROD              ;  513
	and   r21, r19                         ;  515
	mov   r19, r21                         ;  516
	andi  r19, 0x40                        ;  517
	ori   r19, (1 << MSTR)                 ;  518
	out   _SFR_IO_ADDR(SPCR), r19          ;  519
	WAIT  r19, 1300                          ;  520

uzm_line:                                    ; 1820 = 0 of the first line
	out   SPDR_IO, r20                     ;    0
	sbrs  r14, 1                           ;    1
	movw  r2, XL                           ;
	cbi   _SFR_IO_ADDR(SYNC_PORT), SYNC_PIN ;    3
	sbrc  r14, 1                           ;    5
	movw  XL, r2                           ;
	mov   r19, r14                         ;    7
	cpi   r19, 10                          ;
	ldi   r19, 0                           ;
	brne  .+2                              ;
	ldi   r19, 32                          ;
	mov   r15, r19                         ;   12
	subi  XL, lo8(-161)                    ;   13
	sbci  XH, hi8(-161)                    ;
	nop                                    ;   15
	nop                                    ;   16
	in    r17, SPDR_IO                     ;   17
	out   SPDR_IO, r20                     ;   18
	st    Y, r17                           ;   19
	cp    r17, r21                         ;   21
	adc   YL, r1                           ;   22
	adc   YH, r1                           ;   23
	andi  YH, 0x0F                         ;   24
	ori   YH, 0x08                         ;   25
	cpi   r25, 1                           ;   26
	ldi   r16, 0                           ;
	brne  .+2                              ;
	ldi   r16, 4                           ;
	cp    r1, r15                          ;   30
	sbc   r18, r18                         ;
	and   r16, r18                         ;   32
	ldi   ZL, lo8(uzm_dummy)               ;   33
	ldi   ZH, hi8(uzm_dummy)               ;   34
	in    r17, SPDR_IO                     ;   35
	out   SPDR_IO, r20                     ;   36
	st    Y, r17                           ;   37
	cp    r17, r21                         ;   39
	adc   YL, r1                           ;   40
	adc   YH, r1                           ;   41
	andi  YH, 0x0F                         ;   42
	ori   YH, 0x08                         ;   43
	sbrc  r18, 0                           ;   44
	movw  ZL, r6                           ;
	sub   ZL, r16                          ;   46
	sbc   ZH, r1                           ;
	ld    r19, X+                          ;   48
	st    Z+, r19                          ;   50
	nop                                    ;   52
	in    r17, SPDR_IO                     ;   53
	out   SPDR_IO, r20                     ;   54
	st    Y, r17                           ;   55
	cp    r17, r21                         ;   57
	adc   YL, r1                           ;   58
	adc   YH, r1                           ;   59
	andi  YH, 0x0F                         ;   60
	ori   YH, 0x08                         ;   61
	ld    r19, X+                          ;   62
	st    Z+, r19                          ;   64
	ld    r19, X+                          ;   66
	st    Z+, r19                          ;   68
	nop                                    ;   70
	in    r17, SPDR_IO                     ;   71
	out   SPDR_IO, r20                     ;   72
	st    Y, r17                           ;   73
	cp    r17, r21                         ;   75
	adc   YL, r1                           ;   76
	adc   YH, r1                           ;   77
	andi  YH, 0x0F                         ;   78
	ori   YH, 0x08                         ;   79
	ld    r19, X+                          ;   80
	st    Z+, r19                          ;   82
	ld    r19, X+                          ;   84
	st    Z+, r19                          ;   86
	nop                                    ;   88
	in    r17, SPDR_IO                     ;   89
	out   SPDR_IO, r20                     ;   90
	st    Y, r17                           ;   91
	cp    r17, r21                         ;   93
	adc   YL, r1                           ;   94
	adc   YH, r1                           ;   95
	andi  YH, 0x0F                         ;   96
	ori   YH, 0x08                         ;   97
	ld    r19, X+                          ;   98
	st    Z+, r19                          ;  100
	ld    r19, X+                          ;  102
	st    Z+, r19                          ;  104
	nop                                    ;  106
	in    r17, SPDR_IO                     ;  107
	out   SPDR_IO, r20                     ;  108
	st    Y, r17                           ;  109
	cp    r17, r21                         ;  111
	adc   YL, r1                           ;  112
	adc   YH, r1                           ;  113
	andi  YH, 0x0F                         ;  114
	ori   YH, 0x08                         ;  115
	sbrc  r18, 0                           ;  116
	movw  r6, ZL                           ;
	ld    r19, X+                          ;  118
	sts   uzm+UZM_O_MARK+0, r19            ;  120
	ld    r19, X+                          ;  122
	nop                                    ;  124
	in    r17, SPDR_IO                     ;  125
	out   SPDR_IO, r20                     ;  126
	st    Y, r17                           ;  127
	cp    r17, r21                         ;  129
	adc   YL, r1                           ;  130
	adc   YH, r1                           ;  131
	andi  YH, 0x0F                         ;  132
	ori   YH, 0x08                         ;  133
	sts   uzm+UZM_O_MARK+1, r19            ;  134
	ld    r19, X+                          ;  136
	nop                                    ;  138
	sbi   _SFR_IO_ADDR(SYNC_PORT), SYNC_PIN ;  139
	sts   uzm+UZM_O_MARK+2, r19            ;  141
	in    r17, SPDR_IO                     ;  143
	out   SPDR_IO, r20                     ;  144
	st    Y, r17                           ;  145
	cp    r17, r21                         ;  147
	adc   YL, r1                           ;  148
	adc   YH, r1                           ;  149
	andi  YH, 0x0F                         ;  150
	ori   YH, 0x08                         ;  151
	ld    r19, X+                          ;  152
	sts   uzm+UZM_O_MARK+3, r19            ;  154
	movw  XL, r2                           ;  156
	movw  ZL, r4                           ;  157
	ld    r19, Z+                          ;  158
	nop                                    ;  160
	in    r17, SPDR_IO                     ;  161
	out   SPDR_IO, r20                     ;  162
	st    Y, r17                           ;  163
	cp    r17, r21                         ;  165
	adc   YL, r1                           ;  166
	adc   YH, r1                           ;  167
	andi  YH, 0x0F                         ;  168
	ori   YH, 0x08                         ;  169
	sts   _SFR_MEM_ADDR(OCR2A), r19        ;  170
	ldi   r22, hi8(mix_buf+MIX_BUF_SIZE)   ;  172
	cpi   ZL, lo8(mix_buf+MIX_BUF_SIZE)    ;  173
	cpc   ZH, r22                          ;
	ldi   r22, lo8(mix_buf)                ;
	ldi   r23, hi8(mix_buf)                ;
	brlo  .+2                              ;
	movw  ZL, r22                          ;
	in    r17, SPDR_IO                     ;  179
	out   SPDR_IO, r20                     ;  180
	st    Y, r17                           ;  181
	cp    r17, r21                         ;  183
	adc   YL, r1                           ;  184
	adc   YH, r1                           ;  185
	andi  YH, 0x0F                         ;  186
	ori   YH, 0x08                         ;  187
	movw  r4, ZL                           ;  188
	ldi   r24, 80                          ;  189
	nop                                    ;  190
	nop                                    ;  191
	nop                                    ;  192
	nop                                    ;  193
	nop                                    ;  194
	nop                                    ;  195
	nop                                    ;  196
	in    r17, SPDR_IO                     ;  197
	out   SPDR_IO, r20                     ;  198
	st    Y, r17                           ;  199
	cp    r17, r21                         ;  201
	adc   YL, r1                           ;  202
	adc   YH, r1                           ;  203
	andi  YH, 0x0F                         ;  204
	ori   YH, 0x08                         ;  205
	nop                                    ;  206
	nop                                    ;  207
	nop                                    ;  208
	nop                                    ;  209
	nop                                    ;  210
	nop                                    ;  211
	nop                                    ;  212
	nop                                    ;  213
	nop                                    ;  214
	in    r17, SPDR_IO                     ;  215
	out   SPDR_IO, r20                     ;  216
	st    Y, r17                           ;  217
	cp    r17, r21                         ;  219
	adc   YL, r1                           ;  220
	adc   YH, r1                           ;  221
	andi  YH, 0x0F                         ;  222
	ori   YH, 0x08                         ;  223
	nop                                    ;  224
	nop                                    ;  225
	nop                                    ;  226
	nop                                    ;  227
	nop                                    ;  228
	nop                                    ;  229
	nop                                    ;  230
	nop                                    ;  231
	nop                                    ;  232
	in    r17, SPDR_IO                     ;  233
	out   SPDR_IO, r20                     ;  234
	st    Y, r17                           ;  235
	cp    r17, r21                         ;  237
	adc   YL, r1                           ;  238
	adc   YH, r1                           ;  239
	andi  YH, 0x0F                         ;  240
	ori   YH, 0x08                         ;  241
	nop                                    ;  242
	nop                                    ;  243
	nop                                    ;  244
	nop                                    ;  245
	nop                                    ;  246
	nop                                    ;  247
	nop                                    ;  248
	nop                                    ;  249
	nop                                    ;  250
	in    r17, SPDR_IO                     ;  251
	out   SPDR_IO, r20                     ;  252
	st    Y, r17                           ;  253
	cp    r17, r21                         ;  255
	adc   YL, r1                           ;  256
	adc   YH, r1                           ;  257
	andi  YH, 0x0F                         ;  258
	ori   YH, 0x08                         ;  259
	nop                                    ;  260
	nop                                    ;  261
	nop                                    ;  262
	nop                                    ;  263
	nop                                    ;  264
	nop                                    ;  265
	nop                                    ;  266
	nop                                    ;  267
	nop                                    ;  268
	in    r17, SPDR_IO                     ;  269
	out   SPDR_IO, r20                     ;  270
	st    Y, r17                           ;  271
	cp    r17, r21                         ;  273
	adc   YL, r1                           ;  274
	adc   YH, r1                           ;  275
	andi  YH, 0x0F                         ;  276
	ori   YH, 0x08                         ;  277
	nop                                    ;  278
	nop                                    ;  279
	nop                                    ;  280
	nop                                    ;  281
	nop                                    ;  282
	nop                                    ;  283
	nop                                    ;  284
	nop                                    ;  285
	nop                                    ;  286
	in    r17, SPDR_IO                     ;  287
	out   SPDR_IO, r20                     ;  288
	st    Y, r17                           ;  289
	cp    r17, r21                         ;  291
	adc   YL, r1                           ;  292
	adc   YH, r1                           ;  293
	andi  YH, 0x0F                         ;  294
	ori   YH, 0x08                         ;  295
	nop                                    ;  296
	nop                                    ;  297
	nop                                    ;  298
	nop                                    ;  299
	nop                                    ;  300
	nop                                    ;  301
	nop                                    ;  302
uzm_loop:                                    ;  303
	ld    r16, X+                          ;  303 + 18k
	ld    r18, X+                          ;  305 + 18k
	out   VIDEO_PORT, r16                  ;  307 + 18k
	in    r17, SPDR_IO                     ;  308 + 18k
	out   SPDR_IO, r20                     ;  309 + 18k
	st    Y, r17                           ;  310 + 18k
	cp    r17, r21                         ;  312 + 18k
	adc   YL, r1                           ;  313 + 18k
	adc   YH, r1                           ;  314 + 18k
	andi  YH, 0x0F                         ;  315 + 18k
	out   VIDEO_PORT, r18                  ;  316 + 18k
	ori   YH, 0x08                         ;  317 + 18k
	dec   r24                              ;  318 + 18k
	brne  uzm_loop                         ;  319 + 18k (falls through at 1741 on the last)
	add   XL, r15                          ; 1742
	adc   XH, r1                           ;
	sbrc  XH, 4                            ; 1744
	ldi   XH, 0x08                         ;
	nop                                    ; 1746
	out   VIDEO_PORT, r1                   ; 1747
	in    r17, SPDR_IO                     ; 1748
	st    Y, r17                           ; 1749
	cp    r17, r21                         ; 1751
	adc   YL, r1                           ; 1752
	adc   YH, r1                           ; 1753
	andi  YH, 0x0F                         ; 1754
	ori   YH, 0x08                         ; 1755
	movw  r22, YL                          ; 1756
	sub   r22, r12                         ; 1757
	sbc   r23, r13                         ;
	andi  r23, 0x07                        ; 1759
	add   r8, r22                          ; 1760
	adc   r9, r23                          ;
	movw  r12, YL                          ; 1762
	add   r10, r15                         ; 1763
	adc   r11, r1                          ;
	ldi   r22, 0                           ; 1765
	sbrc  r14, 1                           ; 1766
	ldi   r22, 160                         ;
	add   r10, r22                         ; 1768
	adc   r11, r1                          ;
	movw  r22, r8                          ; 1770
	sub   r22, r10                         ; 1771
	sbc   r23, r11                         ;
	cpi   r22, 160                         ; 1773
	cpc   r23, r1                          ;
	brge  .+2                              ;
	inc   r0                               ;
	ldi   r21, 0xFE                        ; 1777
	ldi   r19, hi8(UZM_STALL)              ; 1778
	cpi   r22, lo8(UZM_STALL)              ; 1779
	cpc   r23, r19                         ;
	brlt  .+2                              ;
	ldi   r21, 0                           ;
	lds   r19, uzm+UZM_O_PROD              ; 1783
	and   r21, r19                         ; 1785
	mov   r19, r21                         ; 1786
	andi  r19, 0x40                        ; 1787
	ori   r19, (1 << MSTR)                 ; 1788
	out   _SFR_IO_ADDR(SPCR), r19          ; 1789
	inc   r14                              ; 1790
	inc   r14                              ; 1791
	mov   r19, r14                         ; 1792
	cpi   r19, 12                          ;
	brne  .+2                              ;
	clr   r14                              ;
	sts   mix_pos, r4                      ; 1796
	sts   mix_pos+1, r5                    ; 1798
	nop                                    ; 1800
	nop                                    ; 1801
	nop                                    ; 1802
	nop                                    ; 1803
	nop                                    ; 1804
	nop                                    ; 1805
	nop                                    ; 1806
	nop                                    ; 1807
	nop                                    ; 1808
	nop                                    ; 1809
	nop                                    ; 1810
	nop                                    ; 1811
	nop                                    ; 1812
	nop                                    ; 1813
	nop                                    ; 1814
	nop                                    ; 1815
	dec   r25                              ; 1816
	breq  uzm_end                          ; 1817
	rjmp  uzm_line                         ; 1818

uzm_end:
	nop                                 ; 1819 (the breq taken at 1817)
	rcall hsync_pulse                   ; 1820: its cbi at 3, as every line's

	sts   uzm+UZM_O_X, XL
	sts   uzm+UZM_O_X+1, XH
	sts   uzm+UZM_O_Y, YL
	sts   uzm+UZM_O_Y+1, YH
	sts   uzm+UZM_O_PC, r8
	sts   uzm+UZM_O_PC+1, r9
	sts   uzm+UZM_O_CC, r10
	sts   uzm+UZM_O_CC+1, r11
	sts   uzm+UZM_O_AW, r6
	sts   uzm+UZM_O_AW+1, r7
	lds   r24, uzm+UZM_O_UNDER
	lds   r25, uzm+UZM_O_UNDER+1
	add   r24, r0
	adc   r25, r1
	sts   uzm+UZM_O_UNDER, r24
	sts   uzm+UZM_O_UNDER+1, r25
	lds   r24, uzm+UZM_O_FRAMES
	lds   r25, uzm+UZM_O_FRAMES+1
	adiw  r24, 1
	sts   uzm+UZM_O_FRAMES, r24
	sts   uzm+UZM_O_FRAMES+1, r25

	; the bus is the program's until the next frame: the SPI off, nothing being clocked (the
	; last line's R took the last byte in)
	ldi   r19, (1 << MSTR)
	out   _SFR_IO_ADDR(SPCR), r19

	; the inline pulses did not count down sync_pulse; hsync_pulse did, once
	lds   r24, sync_pulse
	subi  r24, UZM_LINES
	sts   sync_pulse, r24

	; vsync flag, field flip
	lds   ZL, sync_flags
	ldi   r20, SYNC_FLAG_FIELD
	ori   ZL, SYNC_FLAG_VSYNC
	eor   ZL, r20
	sts   sync_flags, ZL

	; clear any pending timer interrupt
	ldi   ZL, (1 << OCF1A)
	sts   _SFR_MEM_ADDR(TIFR1), ZL
	ret


//*********************************//
// MIDI file: C:\Documents and Settings\Admin\My Documents\projet\atmel\uzebox2\music\tetrisnt_fast.mid
//*********************************//
const char song_testrisnt_fast[] PROGMEM ={
0x00,0xff,0x06,0x01,0x53,0x00,0xc0,0x10,0x00,0xc1,0x10,0x00,0xc2,0x0b,0x00,0x92,0x2d,0x5a,0x00,0x93,0x07,0x20,0x01,0x91,0x45,0x7f,0x0a,0x93,0x07,0x20,0x0e,0x90,
0x3d,0x62,0x00,0x91,0x45,0x7f,0x00,0x92,0x2d,0x5a,0x00,0x93,0x0e,0x20,0x0a,0x07,0x20,0x05,0x91,0x45,0x7f,0x0a,0x45,0x7f,0x00,0x92,0x28,0x5a,0x00,0x93,0x07,0x20,
0x0a,0x07,0x20,0x01,0x91,0x40,0x7f,0x0a,0x92,0x2c,0x5a,0x00,0x93,0x0e,0x20,0x04,0x90,0x3b,0x62,0x00,0x91,0x3e,0x7f,0x0a,0x40,0x7f,0x00,0x93,0x07,0x20,0x0a,0x92,
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0x00,0x93,0x0e,0x20,0x0b,0x91,0x51,0x7f,0x0a,0x93,0x07,0x20,0x1d,0xff,0x06,0x01,0x45,0x15,0xff,0x2f,0x00 };

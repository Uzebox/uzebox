//*********************************//
// MIDI file: C:\Documents and Settings\Admin\My Documents\projet\atmel\uzebox2\tetris\Korobeiniki-3tracks.mid
//*********************************//
const char song_korobeiniki[] PROGMEM ={
0x00,0xff,0x06,0x01,0x53,0x00,0xc0,0x00,0x00,0x90,0x4c,0x6b,0x00,0xc2,0x00,0x00,0x92,0x28,0x6b,0x00,0xc1,0x00,0x00,0x91,0x47,0x6b,0x17,0x92,0x34,0x6b,0x18,0x90,
0x47,0x6b,0x00,0x92,0x28,0x6b,0x00,0x91,0x44,0x6b,0x18,0x90,0x48,0x6b,0x00,0x92,0x34,0x6b,0x00,0x91,0x45,0x6b,0x18,0x90,0x4a,0x6b,0x00,0x92,0x28,0x6b,0x00,0x91,
0x47,0x6b,0x18,0x90,0x4c,0x6b,0x00,0x92,0x34,0x6b,0x00,0x91,0x44,0x6b,0x0c,0x90,0x4a,0x6b,0x0c,0x48,0x6b,0x00,0x92,0x28,0x6b,0x00,0x91,0x45,0x6b,0x18,0x90,0x47,
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0x2c,0x6b,0x18,0x34,0x6b,0x18,0xff,0x06,0x01,0x45,0x00,0xff,0x2f,0x00 };

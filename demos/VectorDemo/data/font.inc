/*
 * Transformation file: font.gconvert.xml
 * Source image: ../data/font.png
 * Tile width: 8px
 * Tile height: 8px
 * Output format: 1bpp
 */
#define FONT_SIZE 64
const char font[] PROGMEM={
 0x0, 0x0, 0x0, 0x0, 0x0, 0x0, 0x0, 0x0		 //tile:0
, 0xc, 0xc, 0x18, 0x10, 0x0, 0x60, 0x60, 0x0		 //tile:1
, 0x28, 0x28, 0x28, 0x0, 0x0, 0x0, 0x0, 0x0		 //tile:2
, 0x8, 0x2e, 0xf8, 0x28, 0x3e, 0xe8, 0x20, 0x0		 //tile:3
, 0x10, 0x7c, 0x90, 0x7c, 0x12, 0xfc, 0x10, 0x0		 //tile:4
, 0x42, 0xa4, 0xa8, 0x54, 0x2a, 0x4a, 0x84, 0x0		 //tile:5
, 0x18, 0x28, 0x28, 0x10, 0x6a, 0x44, 0x3a, 0x0		 //tile:6
, 0x30, 0x10, 0x20, 0x0, 0x0, 0x0, 0x0, 0x0		 //tile:7
, 0xc, 0x10, 0x20, 0x20, 0x20, 0x10, 0xc, 0x0		 //tile:8
, 0x30, 0x8, 0x4, 0x4, 0x4, 0x8, 0x30, 0x0		 //tile:9
, 0x10, 0x54, 0x38, 0x10, 0x38, 0x54, 0x10, 0x0		 //tile:10
, 0x0, 0x10, 0x10, 0x7c, 0x10, 0x10, 0x0, 0x0		 //tile:11
, 0x0, 0x0, 0x0, 0x0, 0x30, 0x10, 0x20, 0x0		 //tile:12
, 0x0, 0x0, 0x0, 0x7c, 0x0, 0x0, 0x0, 0x0		 //tile:13
, 0x0, 0x0, 0x0, 0x0, 0x0, 0x30, 0x30, 0x0		 //tile:14
, 0x2, 0x4, 0x8, 0x10, 0x20, 0x40, 0x80, 0x0		 //tile:15
, 0x7c, 0x86, 0x8a, 0x92, 0xa2, 0xc2, 0x7c, 0x0		 //tile:16
, 0x10, 0x30, 0x10, 0x10, 0x10, 0x10, 0x7c, 0x0		 //tile:17
, 0x7c, 0x82, 0x2, 0x1c, 0x60, 0x80, 0xfe, 0x0		 //tile:18
, 0xfe, 0x4, 0x18, 0x4, 0x2, 0x82, 0x7c, 0x0		 //tile:19
, 0xc, 0x14, 0x24, 0x44, 0x84, 0xfe, 0x4, 0x0		 //tile:20
, 0xfc, 0x80, 0xfc, 0x2, 0x2, 0x82, 0x7c, 0x0		 //tile:21
, 0x7c, 0x80, 0x80, 0xfc, 0x82, 0x82, 0x7c, 0x0		 //tile:22
, 0xfe, 0x82, 0x4, 0x8, 0x10, 0x10, 0x10, 0x0		 //tile:23
, 0x7c, 0x82, 0x82, 0x7c, 0x82, 0x82, 0x7c, 0x0		 //tile:24
, 0x7c, 0x82, 0x82, 0x7e, 0x2, 0x2, 0x7c, 0x0		 //tile:25
, 0x0, 0x30, 0x30, 0x0, 0x30, 0x30, 0x0, 0x0		 //tile:26
, 0x0, 0x30, 0x30, 0x0, 0x30, 0x10, 0x20, 0x0		 //tile:27
, 0x8, 0x10, 0x20, 0x40, 0x20, 0x10, 0x8, 0x0		 //tile:28
, 0x0, 0x0, 0x7c, 0x0, 0x7c, 0x0, 0x0, 0x0		 //tile:29
, 0x20, 0x10, 0x8, 0x4, 0x8, 0x10, 0x20, 0x0		 //tile:30
, 0x3c, 0x42, 0x2, 0xc, 0x10, 0x0, 0x10, 0x0		 //tile:31
, 0x7c, 0x82, 0x9a, 0xaa, 0xbc, 0x80, 0x7c, 0x0		 //tile:32
, 0x38, 0x44, 0x82, 0x82, 0xfe, 0x82, 0x82, 0x0		 //tile:33
, 0xfc, 0x82, 0x82, 0xfc, 0x82, 0x82, 0xfc, 0x0		 //tile:34
, 0x7c, 0x82, 0x80, 0x80, 0x80, 0x82, 0x7c, 0x0		 //tile:35
, 0xf8, 0x84, 0x82, 0x82, 0x82, 0x84, 0xf8, 0x0		 //tile:36
, 0xfe, 0x80, 0x80, 0xfc, 0x80, 0x80, 0xfe, 0x0		 //tile:37
, 0xfe, 0x80, 0x80, 0xfc, 0x80, 0x80, 0x80, 0x0		 //tile:38
, 0x7c, 0x82, 0x80, 0x80, 0x8e, 0x82, 0x7e, 0x0		 //tile:39
, 0x82, 0x82, 0x82, 0xfe, 0x82, 0x82, 0x82, 0x0		 //tile:40
, 0x7c, 0x10, 0x10, 0x10, 0x10, 0x10, 0x7c, 0x0		 //tile:41
, 0x1e, 0x4, 0x4, 0x4, 0x4, 0x84, 0x78, 0x0		 //tile:42
, 0x84, 0x88, 0x90, 0xf0, 0x88, 0x84, 0x82, 0x0		 //tile:43
, 0x40, 0x40, 0x40, 0x40, 0x40, 0x40, 0x7e, 0x0		 //tile:44
, 0x82, 0xc6, 0xaa, 0x92, 0x82, 0x82, 0x82, 0x0		 //tile:45
, 0x82, 0xc2, 0xa2, 0x92, 0x8a, 0x86, 0x82, 0x0		 //tile:46
, 0x7c, 0x82, 0x82, 0x82, 0x82, 0x82, 0x7c, 0x0		 //tile:47
, 0xfc, 0x82, 0x82, 0x82, 0xfc, 0x80, 0x80, 0x0		 //tile:48
, 0x7c, 0x82, 0x82, 0x92, 0x8a, 0x84, 0x7a, 0x0		 //tile:49
, 0xfc, 0x82, 0x82, 0x84, 0xf8, 0x84, 0x82, 0x0		 //tile:50
, 0x7c, 0x80, 0x80, 0x7c, 0x2, 0x2, 0xfc, 0x0		 //tile:51
, 0xfe, 0x10, 0x10, 0x10, 0x10, 0x10, 0x10, 0x0		 //tile:52
, 0x82, 0x82, 0x82, 0x82, 0x82, 0x82, 0x7c, 0x0		 //tile:53
, 0x82, 0x82, 0x82, 0x82, 0x44, 0x28, 0x10, 0x0		 //tile:54
, 0x82, 0x82, 0x82, 0x92, 0xaa, 0xc6, 0x82, 0x0		 //tile:55
, 0x82, 0x44, 0x28, 0x10, 0x28, 0x44, 0x82, 0x0		 //tile:56
, 0x82, 0x44, 0x28, 0x10, 0x10, 0x10, 0x10, 0x0		 //tile:57
, 0xfe, 0x4, 0x8, 0x10, 0x20, 0x40, 0xfe, 0x0		 //tile:58
, 0x1c, 0x10, 0x10, 0x10, 0x10, 0x10, 0x1c, 0x0		 //tile:59
, 0x80, 0x40, 0x20, 0x10, 0x8, 0x4, 0x2, 0x0		 //tile:60
, 0x70, 0x10, 0x10, 0x10, 0x10, 0x10, 0x70, 0x0		 //tile:61
, 0x10, 0x28, 0x44, 0x82, 0x0, 0x0, 0x0, 0x0		 //tile:62
, 0x0, 0x0, 0x0, 0x0, 0x0, 0x0, 0xfe, 0x0		 //tile:63
};

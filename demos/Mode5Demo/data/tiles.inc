/*
 * Transformation file: ../data/tiles.gconvert.xml
 * Source image: ..\data\tiles.png
 * Tile width: 6px
 * Tile height: 8px
 * Output format: 8bpp
 */
#define TILES_SIZE 37
const char tiles[] PROGMEM={
 0x0, 0x0, 0x0, 0x0, 0x0, 0x0, 0x0, 0x0, 0x0, 0x0, 0x0, 0x0, 0x0, 0x0, 0x0, 0x0, 0x0, 0x0, 0x0, 0x0, 0x0, 0x0, 0x0, 0x0, 0x0, 0x0, 0x0, 0x0, 0x0, 0x0, 0x0, 0x0, 0x0, 0x0, 0x0, 0x0, 0x0, 0x0, 0x0, 0x0, 0x0, 0x0, 0x0, 0x0, 0x0, 0x0, 0x0, 0x0		 //tile:0
, 0xff, 0xff, 0xff, 0x7f, 0x7f, 0x24, 0xff, 0xbb, 0xbb, 0xbb, 0x18, 0x24, 0xff, 0xbb, 0xff, 0xbd, 0x18, 0x24, 0x7f, 0xbb, 0xbd, 0x78, 0x18, 0x1a, 0x7f, 0xbb, 0x78, 0x78, 0x18, 0x1a, 0x7f, 0xbb, 0x78, 0x78, 0x18, 0x52, 0x7f, 0xbb, 0x18, 0x18, 0x18, 0x52, 0x24, 0x24, 0x1a, 0x1a, 0x52, 0x52		 //tile:1
, 0xff, 0xff, 0xff, 0x7f, 0x7f, 0x24, 0xff, 0xec, 0xec, 0xec, 0x90, 0x24, 0xff, 0xec, 0xff, 0xf5, 0x90, 0x24, 0x7f, 0xec, 0xf5, 0xd9, 0x90, 0x1a, 0x7f, 0xec, 0xd9, 0xd9, 0x90, 0x1a, 0x7f, 0xec, 0xd9, 0xd9, 0x90, 0x52, 0x7f, 0xec, 0x90, 0x90, 0x90, 0x52, 0x24, 0x24, 0x1a, 0x1a, 0x52, 0x52		 //tile:2
, 0xff, 0xff, 0xff, 0x7f, 0x7f, 0x24, 0xff, 0x6f, 0x6f, 0x6f, 0x14, 0x24, 0xff, 0x6f, 0xff, 0xb7, 0x14, 0x24, 0x7f, 0x6f, 0xb7, 0x1f, 0x14, 0x1a, 0x7f, 0x6f, 0x1f, 0x1f, 0x14, 0x1a, 0x7f, 0x6f, 0x1f, 0x1f, 0x14, 0x52, 0x7f, 0x6f, 0x14, 0x14, 0x14, 0x52, 0x24, 0x24, 0x1a, 0x1a, 0x52, 0x52		 //tile:3
, 0xff, 0xff, 0xff, 0x7f, 0x7f, 0x24, 0xff, 0x77, 0x77, 0x77, 0x1c, 0x24, 0xff, 0x77, 0xff, 0xb7, 0x1c, 0x24, 0x7f, 0x77, 0xb7, 0x2f, 0x1c, 0x1a, 0x7f, 0x77, 0x2f, 0x2f, 0x1c, 0x1a, 0x7f, 0x77, 0x2f, 0x2f, 0x1c, 0x52, 0x7f, 0x77, 0x1c, 0x1c, 0x1c, 0x52, 0x24, 0x24, 0x1a, 0x1a, 0x52, 0x52		 //tile:4
, 0xff, 0xff, 0xff, 0x7f, 0x7f, 0x24, 0xff, 0xe5, 0xe5, 0xe5, 0x8a, 0x24, 0xff, 0xe5, 0xff, 0xee, 0x8a, 0x24, 0x7f, 0xe5, 0xee, 0xcb, 0x8a, 0x1a, 0x7f, 0xe5, 0xcb, 0xcb, 0x8a, 0x1a, 0x7f, 0xe5, 0xcb, 0xcb, 0x8a, 0x52, 0x7f, 0xe5, 0x8a, 0x8a, 0x8a, 0x52, 0x24, 0x24, 0x1a, 0x1a, 0x52, 0x52		 //tile:5
, 0xff, 0xff, 0xff, 0x7f, 0x7f, 0x24, 0xff, 0xf3, 0xf3, 0xf3, 0x98, 0x24, 0xff, 0xf3, 0xff, 0xf5, 0x98, 0x24, 0x7f, 0xf3, 0xf5, 0xf0, 0x98, 0x1a, 0x7f, 0xf3, 0xf0, 0xf0, 0x98, 0x1a, 0x7f, 0xf3, 0xf0, 0xf0, 0x98, 0x52, 0x7f, 0xf3, 0x98, 0x98, 0x98, 0x52, 0x24, 0x24, 0x1a, 0x1a, 0x52, 0x52		 //tile:6
, 0xff, 0xff, 0xff, 0x7f, 0x7f, 0x24, 0xff, 0x5f, 0x5f, 0x5f, 0x4, 0x24, 0xff, 0x5f, 0xff, 0xaf, 0x4, 0x24, 0x7f, 0x5f, 0xaf, 0x7, 0x4, 0x1a, 0x7f, 0x5f, 0x7, 0x7, 0x4, 0x1a, 0x7f, 0x5f, 0x7, 0x7, 0x4, 0x52, 0x7f, 0x5f, 0x4, 0x4, 0x4, 0x52, 0x24, 0x24, 0x1a, 0x1a, 0x52, 0x52		 //tile:7
, 0xff, 0xff, 0xff, 0xff, 0xff, 0x52, 0xff, 0xad, 0xa4, 0xad, 0xa4, 0x52, 0xff, 0xa4, 0xad, 0xa4, 0xa4, 0x52, 0xff, 0xad, 0xad, 0xad, 0xa4, 0x52, 0xff, 0xad, 0xa4, 0xad, 0xa4, 0x52, 0xff, 0xad, 0xad, 0xa4, 0xa4, 0x52, 0xff, 0xa4, 0xa4, 0xa4, 0xa4, 0x52, 0x52, 0x52, 0x52, 0x52, 0x52, 0x52		 //tile:8
, 0xa4, 0xa4, 0xa4, 0xa4, 0xa4, 0xa4, 0xa4, 0x5b, 0x49, 0x5b, 0x49, 0xa4, 0xa4, 0x49, 0x5b, 0x49, 0x5b, 0xa4, 0xa4, 0x5b, 0x49, 0x5b, 0x49, 0xa4, 0xa4, 0x49, 0x5b, 0x49, 0x5b, 0xa4, 0xa4, 0x5b, 0x49, 0x5b, 0x49, 0xa4, 0xa4, 0x49, 0x5b, 0x49, 0x5b, 0xa4, 0xa4, 0xa4, 0xa4, 0xa4, 0xa4, 0xa4		 //tile:9
, 0xff, 0xff, 0xff, 0xff, 0xff, 0xff, 0xff, 0xff, 0xff, 0xff, 0xff, 0xff, 0xff, 0xff, 0xff, 0xff, 0xff, 0xff, 0xff, 0xff, 0xff, 0xff, 0xff, 0xff, 0xff, 0xff, 0xff, 0xff, 0xff, 0xff, 0xff, 0xff, 0xff, 0xff, 0xff, 0xff, 0xff, 0xff, 0xff, 0xff, 0xff, 0xff, 0xff, 0xff, 0xff, 0xff, 0xff, 0xff		 //tile:10
, 0xff, 0xff, 0x0, 0x0, 0x0, 0x0, 0xff, 0xf5, 0x7f, 0x0, 0x0, 0x0, 0xff, 0xec, 0xf5, 0x7f, 0x0, 0x0, 0x7f, 0xec, 0xff, 0xd9, 0x7f, 0x0, 0x7f, 0xec, 0xd9, 0xd9, 0x24, 0x0, 0x7f, 0xec, 0xd9, 0x24, 0x0, 0x0, 0x7f, 0xec, 0x24, 0x0, 0x0, 0x0, 0x24, 0x24, 0x0, 0x0, 0x0, 0x0		 //tile:11
, 0xff, 0xff, 0xff, 0xbf, 0xbf, 0x3f, 0xff, 0xfd, 0xfd, 0xfd, 0x70, 0x3f, 0xff, 0xfd, 0xff, 0xff, 0x70, 0x3f, 0xbf, 0xfd, 0xff, 0x78, 0x70, 0x2d, 0xbf, 0xfd, 0x78, 0x78, 0x70, 0x2d, 0xbf, 0xfd, 0x78, 0x78, 0x70, 0x5b, 0xbf, 0xfd, 0x70, 0x70, 0x70, 0x5b, 0x3f, 0x3f, 0x2d, 0x2d, 0x5b, 0x5b		 //tile:12
, 0xff, 0xff, 0xff, 0xbf, 0xbf, 0x3f, 0xff, 0xff, 0xff, 0xff, 0xd8, 0x3f, 0xff, 0xff, 0xff, 0xff, 0xd8, 0x3f, 0xbf, 0xff, 0xff, 0xf2, 0xd8, 0x2d, 0xbf, 0xff, 0xf2, 0xf2, 0xd8, 0x2d, 0xbf, 0xff, 0xf2, 0xf2, 0xd8, 0x5b, 0xbf, 0xff, 0xd8, 0xd8, 0xd8, 0x5b, 0x3f, 0x3f, 0x2d, 0x2d, 0x5b, 0x5b		 //tile:13
, 0xff, 0xff, 0xff, 0xbf, 0xbf, 0x3f, 0xff, 0xbf, 0xbf, 0xbf, 0x1f, 0x3f, 0xff, 0xbf, 0xff, 0xff, 0x1f, 0x3f, 0xbf, 0xbf, 0xff, 0x37, 0x1f, 0x2d, 0xbf, 0xbf, 0x37, 0x37, 0x1f, 0x2d, 0xbf, 0xbf, 0x37, 0x37, 0x1f, 0x5b, 0xbf, 0xbf, 0x1f, 0x1f, 0x1f, 0x5b, 0x3f, 0x3f, 0x2d, 0x2d, 0x5b, 0x5b		 //tile:14
, 0xff, 0xff, 0xff, 0xbf, 0xbf, 0x3f, 0xff, 0xbf, 0xbf, 0xbf, 0x37, 0x3f, 0xff, 0xbf, 0xff, 0xff, 0x37, 0x3f, 0xbf, 0xbf, 0xff, 0x3f, 0x37, 0x2d, 0xbf, 0xbf, 0x3f, 0x3f, 0x37, 0x2d, 0xbf, 0xbf, 0x3f, 0x3f, 0x37, 0x5b, 0xbf, 0xbf, 0x37, 0x37, 0x37, 0x5b, 0x3f, 0x3f, 0x2d, 0x2d, 0x5b, 0x5b		 //tile:15
, 0xff, 0xff, 0xff, 0xbf, 0xbf, 0x3f, 0xff, 0xff, 0xff, 0xff, 0xd5, 0x3f, 0xff, 0xff, 0xff, 0xff, 0xd5, 0x3f, 0xbf, 0xff, 0xff, 0xde, 0xd5, 0x2d, 0xbf, 0xff, 0xde, 0xde, 0xd5, 0x2d, 0xbf, 0xff, 0xde, 0xde, 0xd5, 0x5b, 0xbf, 0xff, 0xd5, 0xd5, 0xd5, 0x5b, 0x3f, 0x3f, 0x2d, 0x2d, 0x5b, 0x5b		 //tile:16
, 0xff, 0xff, 0xff, 0xbf, 0xbf, 0x3f, 0xff, 0xfd, 0xfd, 0xfd, 0xf0, 0x3f, 0xff, 0xfd, 0xff, 0xff, 0xf0, 0x3f, 0xbf, 0xfd, 0xff, 0xf8, 0xf0, 0x2d, 0xbf, 0xfd, 0xf8, 0xf8, 0xf0, 0x2d, 0xbf, 0xfd, 0xf8, 0xf8, 0xf0, 0x5b, 0xbf, 0xfd, 0xf0, 0xf0, 0xf0, 0x5b, 0x3f, 0x3f, 0x2d, 0x2d, 0x5b, 0x5b		 //tile:17
, 0xff, 0xff, 0xff, 0xbf, 0xbf, 0x3f, 0xff, 0xaf, 0xaf, 0xaf, 0x7, 0x3f, 0xff, 0xaf, 0xff, 0xff, 0x7, 0x3f, 0xbf, 0xaf, 0xff, 0x7, 0x7, 0x2d, 0xbf, 0xaf, 0x7, 0x7, 0x7, 0x2d, 0xbf, 0xaf, 0x7, 0x7, 0x7, 0x5b, 0xbf, 0xaf, 0x7, 0x7, 0x7, 0x5b, 0x3f, 0x3f, 0x2d, 0x2d, 0x5b, 0x5b		 //tile:18
, 0x9a, 0x9a, 0x9a, 0x9a, 0x9a, 0x9a, 0x9a, 0x48, 0x48, 0x48, 0x48, 0x9a, 0x9a, 0x48, 0x48, 0x48, 0x48, 0x9a, 0x9a, 0x48, 0x48, 0x48, 0x48, 0x9a, 0x9a, 0x48, 0x48, 0x48, 0x48, 0x9a, 0x9a, 0x48, 0x48, 0x48, 0x48, 0x9a, 0x9a, 0x48, 0x48, 0x48, 0x48, 0x9a, 0x9a, 0x9a, 0x9a, 0x9a, 0x9a, 0x9a		 //tile:19
, 0x0, 0x0, 0x0, 0x0, 0x0, 0x0, 0x0, 0x0, 0x0, 0x0, 0x0, 0x0, 0x0, 0x0, 0x0, 0x0, 0x0, 0x0, 0x0, 0x0, 0xff, 0x0, 0xff, 0x0, 0x0, 0x0, 0x0, 0xff, 0x0, 0x0, 0x0, 0x0, 0xff, 0x0, 0xff, 0x0, 0x0, 0x0, 0x0, 0x0, 0x0, 0x0, 0x0, 0x0, 0x0, 0x0, 0x0, 0x0		 //tile:20
, 0x99, 0x99, 0x99, 0x99, 0x99, 0x99, 0x99, 0x99, 0x99, 0x99, 0x99, 0x99, 0x99, 0x99, 0x99, 0x99, 0x99, 0x99, 0x99, 0x99, 0x99, 0x99, 0x99, 0x99, 0x99, 0x99, 0x99, 0x99, 0x99, 0x99, 0x99, 0x99, 0x99, 0x99, 0x99, 0x99, 0x99, 0x99, 0x99, 0x99, 0x99, 0x99, 0x99, 0x99, 0x99, 0x99, 0x99, 0x99		 //tile:21
, 0x48, 0x48, 0x48, 0x48, 0x48, 0x48, 0x48, 0x48, 0x48, 0x99, 0x48, 0x48, 0x48, 0x48, 0x48, 0xe2, 0x48, 0x48, 0x48, 0x48, 0x48, 0xea, 0x48, 0x48, 0x48, 0x99, 0xea, 0xfe, 0xea, 0x99, 0x48, 0x48, 0x48, 0xea, 0x48, 0x48, 0x48, 0x48, 0x48, 0xe2, 0x48, 0x48, 0x48, 0x48, 0x48, 0x99, 0x48, 0x48		 //tile:22
, 0x48, 0x48, 0x48, 0x48, 0x48, 0x48, 0x48, 0x48, 0x48, 0x48, 0x48, 0x48, 0x48, 0xe2, 0x48, 0x48, 0x48, 0xe2, 0x48, 0x48, 0xea, 0x48, 0xea, 0x48, 0x48, 0x48, 0x48, 0xfe, 0x48, 0x48, 0x48, 0x48, 0xea, 0x48, 0xea, 0x48, 0x48, 0xe2, 0x48, 0x48, 0x48, 0xe2, 0x48, 0x48, 0x48, 0x48, 0x48, 0x48		 //tile:23
, 0x48, 0x48, 0x48, 0x48, 0x48, 0x48, 0x48, 0x48, 0x48, 0x48, 0x48, 0x48, 0x48, 0x48, 0x48, 0x99, 0x48, 0x48, 0x48, 0x48, 0x48, 0xe2, 0x48, 0x48, 0x48, 0x48, 0xe2, 0xfe, 0xe2, 0x48, 0x48, 0x48, 0x48, 0xe2, 0x48, 0x48, 0x48, 0x48, 0x48, 0x99, 0x48, 0x48, 0x48, 0x48, 0x48, 0x48, 0x48, 0x48		 //tile:24
, 0x48, 0x48, 0x48, 0x48, 0x48, 0x48, 0x48, 0x48, 0x48, 0x48, 0x48, 0x48, 0x48, 0x99, 0x48, 0x48, 0x48, 0x48, 0x48, 0x48, 0xe2, 0x48, 0xe2, 0x48, 0x48, 0x48, 0x48, 0xfe, 0x48, 0x48, 0x48, 0x48, 0xe2, 0x48, 0xe2, 0x48, 0x48, 0x48, 0x48, 0x48, 0x48, 0x99, 0x48, 0x48, 0x48, 0x48, 0x48, 0x48		 //tile:25
, 0x48, 0x48, 0x48, 0x48, 0x48, 0x48, 0x48, 0x48, 0x48, 0x48, 0x48, 0x48, 0x48, 0x48, 0x48, 0x48, 0x48, 0x48, 0x48, 0x48, 0x48, 0x99, 0x48, 0x48, 0x48, 0x48, 0x99, 0xea, 0x99, 0x48, 0x48, 0x48, 0x48, 0x99, 0x48, 0x48, 0x48, 0x48, 0x48, 0x48, 0x48, 0x48, 0x48, 0x48, 0x48, 0x48, 0x48, 0x48		 //tile:26
, 0x48, 0x48, 0x48, 0x48, 0x48, 0x48, 0x48, 0x48, 0x48, 0x48, 0x48, 0x48, 0x48, 0x48, 0x48, 0x48, 0x48, 0x48, 0x48, 0x48, 0x99, 0x48, 0x99, 0x48, 0x48, 0x48, 0x48, 0xea, 0x48, 0x48, 0x48, 0x48, 0x99, 0x48, 0x99, 0x48, 0x48, 0x48, 0x48, 0x48, 0x48, 0x48, 0x48, 0x48, 0x48, 0x48, 0x48, 0x48		 //tile:27
, 0x48, 0x48, 0x48, 0x48, 0x48, 0x48, 0x48, 0x48, 0x48, 0x48, 0x48, 0x48, 0x48, 0x48, 0x48, 0x48, 0x48, 0x48, 0x48, 0x48, 0x48, 0x48, 0x48, 0x48, 0x48, 0x48, 0x48, 0xe2, 0x48, 0x48, 0x48, 0x48, 0x48, 0x48, 0x48, 0x48, 0x48, 0x48, 0x48, 0x48, 0x48, 0x48, 0x48, 0x48, 0x48, 0x48, 0x48, 0x48		 //tile:28
, 0x48, 0x48, 0x48, 0x48, 0x48, 0x48, 0x48, 0x48, 0x48, 0x48, 0x48, 0x48, 0x48, 0x48, 0x48, 0x48, 0x48, 0x48, 0x48, 0x48, 0x48, 0x48, 0x48, 0x48, 0x48, 0x48, 0x48, 0x48, 0x48, 0x48, 0x48, 0x48, 0x48, 0x48, 0x48, 0x48, 0x48, 0x48, 0x48, 0x48, 0x48, 0x48, 0x48, 0x48, 0x48, 0x48, 0x48, 0x48		 //tile:29
, 0x0, 0x0, 0x0, 0x0, 0x0, 0x0, 0x0, 0x0, 0x0, 0x99, 0x0, 0x0, 0x0, 0x0, 0x0, 0xe2, 0x0, 0x0, 0x0, 0x0, 0x0, 0xea, 0x0, 0x0, 0x0, 0x99, 0xea, 0xfe, 0xea, 0x99, 0x0, 0x0, 0x0, 0xea, 0x0, 0x0, 0x0, 0x0, 0x0, 0xe2, 0x0, 0x0, 0x0, 0x0, 0x0, 0x99, 0x0, 0x0		 //tile:30
, 0x0, 0x0, 0x0, 0x0, 0x0, 0x0, 0x0, 0x0, 0x0, 0x0, 0x0, 0x0, 0x0, 0xe2, 0x0, 0x0, 0x0, 0xe2, 0x0, 0x0, 0xea, 0x0, 0xea, 0x0, 0x0, 0x0, 0x0, 0xfe, 0x0, 0x0, 0x0, 0x0, 0xea, 0x0, 0xea, 0x0, 0x0, 0xe2, 0x0, 0x0, 0x0, 0xe2, 0x0, 0x0, 0x0, 0x0, 0x0, 0x0		 //tile:31
, 0x0, 0x0, 0x0, 0x0, 0x0, 0x0, 0x0, 0x0, 0x0, 0x0, 0x0, 0x0, 0x0, 0x0, 0x0, 0x99, 0x0, 0x0, 0x0, 0x0, 0x0, 0xe2, 0x0, 0x0, 0x0, 0x0, 0xe2, 0xfe, 0xe2, 0x0, 0x0, 0x0, 0x0, 0xe2, 0x0, 0x0, 0x0, 0x0, 0x0, 0x99, 0x0, 0x0, 0x0, 0x0, 0x0, 0x0, 0x0, 0x0		 //tile:32
, 0x0, 0x0, 0x0, 0x0, 0x0, 0x0, 0x0, 0x0, 0x0, 0x0, 0x0, 0x0, 0x0, 0x99, 0x0, 0x0, 0x0, 0x0, 0x0, 0x0, 0xe2, 0x0, 0xe2, 0x0, 0x0, 0x0, 0x0, 0xfe, 0x0, 0x0, 0x0, 0x0, 0xe2, 0x0, 0xe2, 0x0, 0x0, 0x0, 0x0, 0x0, 0x0, 0x99, 0x0, 0x0, 0x0, 0x0, 0x0, 0x0		 //tile:33
, 0x0, 0x0, 0x0, 0x0, 0x0, 0x0, 0x0, 0x0, 0x0, 0x0, 0x0, 0x0, 0x0, 0x0, 0x0, 0x0, 0x0, 0x0, 0x0, 0x0, 0x0, 0x99, 0x0, 0x0, 0x0, 0x0, 0x99, 0xea, 0x99, 0x0, 0x0, 0x0, 0x0, 0x99, 0x0, 0x0, 0x0, 0x0, 0x0, 0x0, 0x0, 0x0, 0x0, 0x0, 0x0, 0x0, 0x0, 0x0		 //tile:34
, 0x0, 0x0, 0x0, 0x0, 0x0, 0x0, 0x0, 0x0, 0x0, 0x0, 0x0, 0x0, 0x0, 0x0, 0x0, 0x0, 0x0, 0x0, 0x0, 0x0, 0x99, 0x0, 0x99, 0x0, 0x0, 0x0, 0x0, 0xea, 0x0, 0x0, 0x0, 0x0, 0x99, 0x0, 0x99, 0x0, 0x0, 0x0, 0x0, 0x0, 0x0, 0x0, 0x0, 0x0, 0x0, 0x0, 0x0, 0x0		 //tile:35
, 0x0, 0x0, 0x0, 0x0, 0x0, 0x0, 0x0, 0x0, 0x0, 0x0, 0x0, 0x0, 0x0, 0x0, 0x0, 0x0, 0x0, 0x0, 0x0, 0x0, 0x0, 0x0, 0x0, 0x0, 0x0, 0x0, 0x0, 0xe2, 0x0, 0x0, 0x0, 0x0, 0x0, 0x0, 0x0, 0x0, 0x0, 0x0, 0x0, 0x0, 0x0, 0x0, 0x0, 0x0, 0x0, 0x0, 0x0, 0x0		 //tile:36
};

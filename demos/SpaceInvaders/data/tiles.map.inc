
#define mapBackground_Width   (30)
#define mapBackground_Height  (28)

const char mapBackground[30 * 28 + 2] PROGMEM=
{mapBackground_Width,mapBackground_Height,
    1,  2,  3,  3,  3,  3,  3,  3,  3,  3,  3,  4,  5,  6,  7,  8,  9, 10,  3,
    3,  3,  3,  3,  3,  3,  3,  3,  3, 11, 12,
    1,  2,  3,  3,  3,  3,  3,  3, 13, 14, 15, 16, 17, 18, 19, 20, 21, 22, 23,
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  233,233,236,237,233,233,236,237,233,238, 11
};

#define mapAlienGreen0_Width   (1)
#define mapAlienGreen0_Height  (1)

const char mapAlienGreen0[1 * 1 + 2] PROGMEM=
{mapAlienGreen0_Width,mapAlienGreen0_Height,
   88
};

#define mapAlienGreen1_Width   (2)
#define mapAlienGreen1_Height  (1)

const char mapAlienGreen1[2 * 1 + 2] PROGMEM=
{mapAlienGreen1_Width,mapAlienGreen1_Height,
   90, 91
};

#define mapAlienGreen2_Width   (1)
#define mapAlienGreen2_Height  (2)

const char mapAlienGreen2[1 * 2 + 2] PROGMEM=
{mapAlienGreen2_Width,mapAlienGreen2_Height,
   89,
   94
};

#define mapAlienGreen3_Width   (2)
#define mapAlienGreen3_Height  (2)

const char mapAlienGreen3[2 * 2 + 2] PROGMEM=
{mapAlienGreen3_Width,mapAlienGreen3_Height,
   92, 93,
   95, 96
};

#define mapAlienPink0_Width   (1)
#define mapAlienPink0_Height  (1)

const char mapAlienPink0[1 * 1 + 2] PROGMEM=
{mapAlienPink0_Width,mapAlienPink0_Height,
   97
};

#define mapAlienPink1_Width   (2)
#define mapAlienPink1_Height  (1)

const char mapAlienPink1[2 * 1 + 2] PROGMEM=
{mapAlienPink1_Width,mapAlienPink1_Height,
   99,100
};

#define mapAlienPink2_Width   (1)
#define mapAlienPink2_Height  (2)

const char mapAlienPink2[1 * 2 + 2] PROGMEM=
{mapAlienPink2_Width,mapAlienPink2_Height,
   98,
  103
};

#define mapAlienPink3_Width   (2)
#define mapAlienPink3_Height  (2)

const char mapAlienPink3[2 * 2 + 2] PROGMEM=
{mapAlienPink3_Width,mapAlienPink3_Height,
  101,102,
  104,105
};

#define mapAlienYellow0_Width   (1)
#define mapAlienYellow0_Height  (1)

const char mapAlienYellow0[1 * 1 + 2] PROGMEM=
{mapAlienYellow0_Width,mapAlienYellow0_Height,
  106
};

#define mapAlienYellow1_Width   (2)
#define mapAlienYellow1_Height  (1)

const char mapAlienYellow1[2 * 1 + 2] PROGMEM=
{mapAlienYellow1_Width,mapAlienYellow1_Height,
  108,109
};

#define mapAlienYellow2_Width   (1)
#define mapAlienYellow2_Height  (2)

const char mapAlienYellow2[1 * 2 + 2] PROGMEM=
{mapAlienYellow2_Width,mapAlienYellow2_Height,
  107,
  112
};

#define mapAlienYellow3_Width   (2)
#define mapAlienYellow3_Height  (2)

const char mapAlienYellow3[2 * 2 + 2] PROGMEM=
{mapAlienYellow3_Width,mapAlienYellow3_Height,
  110,111,
  113,114
};

#define mapAlienDead0_Width   (1)
#define mapAlienDead0_Height  (1)

const char mapAlienDead0[1 * 1 + 2] PROGMEM=
{mapAlienDead0_Width,mapAlienDead0_Height,
  118
};

#define mapAlienDead1_Width   (2)
#define mapAlienDead1_Height  (1)

const char mapAlienDead1[2 * 1 + 2] PROGMEM=
{mapAlienDead1_Width,mapAlienDead1_Height,
  120,121
};

#define mapAlienDead2_Width   (1)
#define mapAlienDead2_Height  (2)

const char mapAlienDead2[1 * 2 + 2] PROGMEM=
{mapAlienDead2_Width,mapAlienDead2_Height,
  119,
  126
};

#define mapAlienDead3_Width   (2)
#define mapAlienDead3_Height  (2)

const char mapAlienDead3[2 * 2 + 2] PROGMEM=
{mapAlienDead3_Width,mapAlienDead3_Height,
  122,123,
  127,128
};

#define mapShelter_Width   (3)
#define mapShelter_Height  (2)

const char mapShelter[3 * 2 + 2] PROGMEM=
{mapShelter_Width,mapShelter_Height,
  115,116,117,
  116,  0,116
};

#define mapShelterDmg0_Width   (1)
#define mapShelterDmg0_Height  (1)

const char mapShelterDmg0[1 * 1 + 2] PROGMEM=
{mapShelterDmg0_Width,mapShelterDmg0_Height,
  124
};

#define mapShelterDmg1_Width   (1)
#define mapShelterDmg1_Height  (1)

const char mapShelterDmg1[1 * 1 + 2] PROGMEM=
{mapShelterDmg1_Width,mapShelterDmg1_Height,
  125
};

#define mapShelterDmg2_Width   (1)
#define mapShelterDmg2_Height  (1)

const char mapShelterDmg2[1 * 1 + 2] PROGMEM=
{mapShelterDmg2_Width,mapShelterDmg2_Height,
    0
};

#define mapNumerals_Width   (10)
#define mapNumerals_Height  (1)

const char mapNumerals[10 * 1 + 2] PROGMEM=
{mapNumerals_Width,mapNumerals_Height,
   67, 68, 69, 70, 71, 72, 73, 74, 75, 76
};

#define mapGameOver_Width   (9)
#define mapGameOver_Height  (1)

const char mapGameOver[9 * 1 + 2] PROGMEM=
{mapGameOver_Width,mapGameOver_Height,
   79, 80, 81, 82,  0, 83, 84, 82, 85
};

#define mapPressStart_Width   (11)
#define mapPressStart_Height  (1)

const char mapPressStart[11 * 1 + 2] PROGMEM=
{mapPressStart_Width,mapPressStart_Height,
   66, 85, 82, 86, 86,  0, 86, 87, 80, 85, 87
};

#define map1Up_Width   (3)
#define map1Up_Height  (1)

const char map1Up[3 * 1 + 2] PROGMEM=
{map1Up_Width,map1Up_Height,
   68, 65, 66
};

#define mapHi_Width   (2)
#define mapHi_Height  (1)

const char mapHi[2 * 1 + 2] PROGMEM=
{mapHi_Width,mapHi_Height,
   77, 78
};

#define mapLives_Width   (2)
#define mapLives_Height  (1)

const char mapLives[2 * 1 + 2] PROGMEM=
{mapLives_Width,mapLives_Height,
  132,133
};

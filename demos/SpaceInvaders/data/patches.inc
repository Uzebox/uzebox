
const char playerShoot[] PROGMEM ={	
0,PC_WAVE,2,
0,PC_PITCH,70,
0,PC_TREMOLO_LEVEL,0x90, 
0,PC_TREMOLO_RATE,0x60, 
0,PC_ENV_SPEED,-12,
0,PC_NOTE_DOWN,2,
2,PC_NOTE_UP,8,
1,PC_NOTE_DOWN,2,
1,PC_NOTE_DOWN,2,
1,PC_NOTE_DOWN,2,
1,PC_NOTE_DOWN,2,
1,PC_NOTE_DOWN,2,
1,PC_NOTE_DOWN,2,
1,PC_NOTE_DOWN,2,
1,PC_NOTE_DOWN,2,
1,PC_NOTE_DOWN,2,
1,PC_NOTE_DOWN,2,
1,PC_NOTE_DOWN,2,
1,PC_NOTE_DOWN,2,
1,PC_NOTE_DOWN,2,
1,PC_NOTE_DOWN,2,
1,PC_NOTE_CUT,0,
0,PATCH_END
};

const char playerHit[] PROGMEM ={ 
0,PC_WAVE,3,
0,PC_ENV_SPEED,-4,
0,PC_PITCH,40,
1,PC_NOTE_DOWN,5, 
1,PC_NOTE_DOWN,4, 
1,PC_NOTE_DOWN,3, 
1,PC_NOTE_DOWN,2, 
1,PC_NOTE_DOWN,1,
0,PC_WAVE,4,
0,PC_TREMOLO_LEVEL,0x90, 
0,PC_TREMOLO_RATE,0x60, 
2,PC_NOTE_DOWN,1,
2,PC_NOTE_DOWN,1,
2,PC_NOTE_DOWN,1,
2,PC_NOTE_DOWN,1,
2,PC_NOTE_DOWN,1,
2,PC_NOTE_DOWN,1,
2,PC_NOTE_DOWN,1,
2,PC_NOTE_DOWN,1,
2,PC_NOTE_DOWN,1,
2,PC_NOTE_DOWN,1,
2,PC_NOTE_DOWN,1,
2,PC_NOTE_DOWN,1,
2,PC_NOTE_DOWN,1,
2,PC_NOTE_CUT,0,
0,PATCH_END
};

const char monsterMoveA[] PROGMEM ={	
0,PC_WAVE,1,
0,PC_PITCH,75,
0,PC_NOTE_DOWN,26, 
1,PC_NOTE_UP,3,
1,PC_NOTE_UP,3, 
1,PC_NOTE_UP,3, 
1,PC_NOTE_DOWN,16, 
1,PC_NOTE_CUT,0,
0,PATCH_END
};

const char monsterMoveB[] PROGMEM ={	
0,PC_WAVE,1,
0,PC_PITCH,75,
0,PC_NOTE_DOWN,29, 
1,PC_NOTE_UP,3,
1,PC_NOTE_UP,3, 
1,PC_NOTE_UP,3, 
1,PC_NOTE_DOWN,13, 
1,PC_NOTE_CUT,0,
0,PATCH_END
};

const char monsterHit[] PROGMEM ={ 
0,PC_WAVE,3,
0,PC_ENV_SPEED,-16,
0,PC_PITCH,50,
1,PC_NOTE_DOWN,5, 
1,PC_NOTE_DOWN,4, 
1,PC_NOTE_DOWN,3, 
1,PC_NOTE_DOWN,2, 
1,PC_NOTE_DOWN,1,
0,PC_WAVE,4,
0,PC_TREMOLO_LEVEL,0x90, 
0,PC_TREMOLO_RATE,0x60, 
1,PC_NOTE_DOWN,1,
1,PC_NOTE_DOWN,1,
1,PC_NOTE_DOWN,1,
1,PC_NOTE_DOWN,1,
1,PC_NOTE_DOWN,1,
1,PC_NOTE_DOWN,1,
1,PC_NOTE_DOWN,1,
1,PC_NOTE_DOWN,1,
1,PC_NOTE_DOWN,1,
1,PC_NOTE_DOWN,1,
1,PC_NOTE_DOWN,1,
1,PC_NOTE_DOWN,1,
1,PC_NOTE_DOWN,1,
1,PC_NOTE_CUT,0,
0,PATCH_END
};

const char ufoHovering[] PROGMEM ={	
0,PC_WAVE,0,
0,PC_PITCH,60,
0,PC_NOTE_UP,2,
2,PC_NOTE_DOWN,2,
2,PC_NOTE_UP,2,
2,PC_NOTE_UP,2,
2,PC_NOTE_UP,2,
2,PC_NOTE_DOWN,2,
2,PC_NOTE_DOWN,2,
2,PC_NOTE_DOWN,2,
2,PC_NOTE_UP,2,
2,PC_NOTE_UP,2,
2,PC_NOTE_UP,2,
2,PC_NOTE_DOWN,2,
2,PC_NOTE_DOWN,2,
2,PC_NOTE_DOWN,2,
2,PC_NOTE_UP,2,
2,PC_NOTE_UP,2,
2,PC_NOTE_UP,2,
2,PC_NOTE_DOWN,2,
2,PC_NOTE_DOWN,2,
2,PC_NOTE_DOWN,2,
2,PC_NOTE_UP,2,
2,PC_NOTE_UP,2,
2,PC_NOTE_UP,2,
2,PC_NOTE_DOWN,2,
2,PC_NOTE_DOWN,2,
2,PC_NOTE_DOWN,2,
2,PC_NOTE_UP,2,
2,PC_NOTE_UP,2,
2,PC_NOTE_UP,2,
2,PC_NOTE_DOWN,2,
2,PC_NOTE_DOWN,2,
2,PC_NOTE_DOWN,2,
2,PC_NOTE_UP,2,
2,PC_NOTE_UP,2,
2,PC_NOTE_UP,2,
2,PC_NOTE_DOWN,2,
2,PC_NOTE_DOWN,2,
2,PC_NOTE_DOWN,2,
2,PC_NOTE_UP,2,
2,PC_NOTE_UP,2,
2,PC_NOTE_UP,2,
2,PC_NOTE_DOWN,2,
2,PC_NOTE_DOWN,2,
2,PC_NOTE_DOWN,2,
2,PC_NOTE_UP,2,
2,PC_NOTE_UP,2,
2,PC_NOTE_UP,2,
2,PC_NOTE_DOWN,2,
2,PC_NOTE_DOWN,2,
2,PC_NOTE_DOWN,2,
2,PC_NOTE_UP,2,
2,PC_NOTE_UP,2,
2,PC_NOTE_UP,2,
2,PC_NOTE_DOWN,2,
2,PC_NOTE_DOWN,2,
2,PC_NOTE_DOWN,2,
2,PC_NOTE_UP,2,
2,PC_NOTE_UP,2,
2,PC_NOTE_UP,2,
2,PC_NOTE_DOWN,2,
2,PC_NOTE_DOWN,2,
2,PC_NOTE_DOWN,2,
2,PC_NOTE_UP,2,
2,PC_NOTE_UP,2,
2,PC_NOTE_UP,2,
2,PC_NOTE_DOWN,2,
2,PC_NOTE_DOWN,2,
2,PC_NOTE_DOWN,2,
2,PC_NOTE_UP,2,
2,PC_NOTE_UP,2,
2,PC_NOTE_UP,2,
2,PC_NOTE_DOWN,2,
2,PC_NOTE_DOWN,2,
2,PC_NOTE_DOWN,2,
0,PC_ENV_SPEED,-1,
2,PC_NOTE_UP,2,
2,PC_NOTE_UP,2,
2,PC_NOTE_UP,2,
2,PC_NOTE_DOWN,2,
2,PC_NOTE_DOWN,2,
2,PC_NOTE_DOWN,2,
2,PC_NOTE_UP,2,
2,PC_NOTE_UP,2,
2,PC_NOTE_UP,2,
2,PC_NOTE_DOWN,2,
2,PC_NOTE_DOWN,2,
2,PC_NOTE_DOWN,2,
2,PC_NOTE_UP,2,
2,PC_NOTE_UP,2,
2,PC_NOTE_UP,2,
2,PC_NOTE_DOWN,2,
2,PC_NOTE_DOWN,2,
2,PC_NOTE_DOWN,2,
2,PC_NOTE_UP,2,
2,PC_NOTE_UP,2,
2,PC_NOTE_UP,2,
2,PC_NOTE_DOWN,2,
2,PC_NOTE_DOWN,2,
2,PC_NOTE_DOWN,2,
2,PC_NOTE_UP,2,
2,PC_NOTE_UP,2,
2,PC_NOTE_UP,2,
2,PC_NOTE_DOWN,2,
2,PC_NOTE_DOWN,2,
2,PC_NOTE_DOWN,2,
2,PC_NOTE_UP,2,
2,PC_NOTE_UP,2,
2,PC_NOTE_UP,2,
2,PC_NOTE_DOWN,2,
2,PC_NOTE_DOWN,2,
2,PC_NOTE_DOWN,2,
2,PC_NOTE_UP,2,
2,PC_NOTE_UP,2,
2,PC_NOTE_UP,2,
2,PC_NOTE_DOWN,2,
2,PC_NOTE_DOWN,2,
2,PC_NOTE_DOWN,2,
2,PC_NOTE_UP,2,
2,PC_NOTE_UP,2,
2,PC_NOTE_UP,2,
2,PC_NOTE_DOWN,2,
2,PC_NOTE_DOWN,2,
2,PC_NOTE_DOWN,2,
2,PC_NOTE_UP,2,
2,PC_NOTE_UP,2,
2,PC_NOTE_UP,2,
2,PC_NOTE_DOWN,2,
2,PC_NOTE_DOWN,2,
2,PC_NOTE_DOWN,2,
2,PC_NOTE_UP,2,
2,PC_NOTE_UP,2,
2,PC_NOTE_UP,2,
2,PC_NOTE_DOWN,2,
2,PC_NOTE_DOWN,2,
2,PC_NOTE_DOWN,2,
2,PC_NOTE_UP,2,
2,PC_NOTE_UP,2,
2,PC_NOTE_UP,2,
2,PC_NOTE_DOWN,2,
2,PC_NOTE_DOWN,2,
2,PC_NOTE_DOWN,2,
2,PC_NOTE_UP,2,
2,PC_NOTE_UP,2,
2,PC_NOTE_UP,2,
2,PC_NOTE_DOWN,2,
2,PC_NOTE_DOWN,2,
2,PC_NOTE_DOWN,2,
0,PC_ENV_SPEED,-4,
2,PC_NOTE_UP,2,
2,PC_NOTE_UP,2,
2,PC_NOTE_DOWN,2,
2,PC_NOTE_DOWN,2,
2,PC_NOTE_UP,2,
2,PC_NOTE_UP,2,
2,PC_NOTE_DOWN,2,
2,PC_NOTE_DOWN,2,
2,PC_NOTE_UP,2,
2,PC_NOTE_UP,2,
2,PC_NOTE_DOWN,2,
2,PC_NOTE_DOWN,2,
2,PC_NOTE_UP,2,
2,PC_NOTE_UP,2,
2,PC_NOTE_DOWN,2,
2,PC_NOTE_DOWN,2,
2,PC_NOTE_UP,2,
2,PC_NOTE_UP,2,
2,PC_NOTE_DOWN,2,
2,PC_NOTE_DOWN,2,
2,PC_NOTE_UP,2,
2,PC_NOTE_UP,2,
2,PC_NOTE_DOWN,2,
2,PC_NOTE_DOWN,2,
3,PC_NOTE_CUT,0,
0,PATCH_END
};

const struct PatchStruct patches[] PROGMEM = {
{0,NULL,playerShoot,0,0},
{0,NULL,playerHit,0,0},
{0,NULL,monsterMoveA,0,0},
{0,NULL,monsterMoveB,0,0},
{0,NULL,monsterHit,0,0},
{0,NULL,ufoHovering,0,0}
};

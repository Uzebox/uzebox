const char BlockBoySong2[] PROGMEM ={
0x00,0xc0,0x08,0x00,0xc1,0x09,0x00,0xc2,0x0a,0x00,0xc3,0x0b,0x00,0xb0,0x07,0x76,0x00,0x90,0x2e,0x40,0x00,0x91,0x22,0x40,0x00,0xb2,0x07,0x7f,0x00,0x92,0x2e,0x40,
0x00,0x93,0x0c,0x40,0x00,0xff,0x06,0x01,0x53,0x0f,0x90,0x2e,0x40,0x00,0x92,0x2e,0x40,0x0f,0x90,0x2e,0x40,0x00,0x91,0x26,0x40,0x00,0x92,0x2e,0x40,0x00,0x93,0x0e,
0x40,0x0f,0x90,0x2c,0x40,0x00,0x91,0x26,0x40,0x00,0x92,0x2c,0x40,0x0f,0x90,0x2e,0x40,0x00,0x91,0x22,0x40,0x00,0x92,0x2e,0x40,0x00,0x93,0x0c,0x40,0x1a,0x90,0x34,
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0x34,0x40,0x00,0x93,0x0e,0x40,0x04,0x92,0x35,0x40,0x04,0xff,0x2f,0x00};

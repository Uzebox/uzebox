/*
 * Transformation file: ../data/tiles.gconvert.xml
 * Source image: ..\data\tiles.png
 * Tile width: 6px
 * Tile height: 8px
 * Output format: 8bpp
 */
#define TILES_SIZE 32
const char tiles[] PROGMEM={
  0x0, 0x0, 0x0, 0x0, 0x0, 0x0, 0x0, 0x0, 0x0, 0x0, 0x0, 0x0, 0x0, 0x0, 0x0, 0x0, 0x0, 0x0, 0x0, 0x0, 0x0, 0x0, 0x0, 0x0, 0x0, 0x0, 0x0, 0x0, 0x0, 0x0, 0x0, 0x0, 0x0, 0x0, 0x0, 0x0, 0x0, 0x0, 0x0, 0x0, 0x0, 0x0, 0x0, 0x0, 0x0, 0x0, 0x0, 0x0		 //tile:0
, 0x0, 0x0, 0x7F, 0x0, 0x0, 0x0, 0x0, 0x7F, 0x7F, 0x0, 0x0, 0x0, 0x0, 0x0, 0x7F, 0x0, 0x0, 0x0, 0x0, 0x0, 0x7F, 0x0, 0x0, 0x0, 0x0, 0x0, 0x7F, 0x0, 0x0, 0x0, 0x0, 0x0, 0x7F, 0x0, 0x0, 0x0, 0x0, 0x7F, 0x7F, 0x7F, 0x0, 0x0, 0x0, 0x0, 0x0, 0x0, 0x0, 0x0		 //tile:17
, 0x0, 0x7F, 0x7F, 0x7F, 0x0, 0x0, 0x7F, 0x0, 0x0, 0x0, 0x7F, 0x0, 0x0, 0x0, 0x0, 0x0, 0x7F, 0x0, 0x0, 0x0, 0x7F, 0x7F, 0x0, 0x0, 0x0, 0x7F, 0x0, 0x0, 0x0, 0x0, 0x7F, 0x0, 0x0, 0x0, 0x0, 0x0, 0x7F, 0x7F, 0x7F, 0x7F, 0x7F, 0x0, 0x0, 0x0, 0x0, 0x0, 0x0, 0x0		 //tile:18
, 0x0, 0x7F, 0x7F, 0x7F, 0x0, 0x0, 0x7F, 0x0, 0x0, 0x0, 0x7F, 0x0, 0x0, 0x0, 0x0, 0x0, 0x7F, 0x0, 0x0, 0x7F, 0x7F, 0x7F, 0x0, 0x0, 0x0, 0x0, 0x0, 0x0, 0x7F, 0x0, 0x7F, 0x0, 0x0, 0x0, 0x7F, 0x0, 0x0, 0x7F, 0x7F, 0x7F, 0x0, 0x0, 0x0, 0x0, 0x0, 0x0, 0x0, 0x0		 //tile:19
, 0x0, 0x0, 0x0, 0x7F, 0x0, 0x0, 0x0, 0x0, 0x7F, 0x7F, 0x0, 0x0, 0x0, 0x7F, 0x0, 0x7F, 0x0, 0x0, 0x7F, 0x0, 0x0, 0x7F, 0x0, 0x0, 0x7F, 0x7F, 0x7F, 0x7F, 0x7F, 0x0, 0x0, 0x0, 0x0, 0x7F, 0x0, 0x0, 0x0, 0x0, 0x0, 0x7F, 0x0, 0x0, 0x0, 0x0, 0x0, 0x0, 0x0, 0x0		 //tile:20
, 0x7F, 0x7F, 0x7F, 0x7F, 0x7F, 0x0, 0x7F, 0x0, 0x0, 0x0, 0x0, 0x0, 0x7F, 0x0, 0x0, 0x0, 0x0, 0x0, 0x7F, 0x7F, 0x7F, 0x7F, 0x0, 0x0, 0x0, 0x0, 0x0, 0x0, 0x7F, 0x0, 0x7F, 0x0, 0x0, 0x0, 0x7F, 0x0, 0x0, 0x7F, 0x7F, 0x7F, 0x0, 0x0, 0x0, 0x0, 0x0, 0x0, 0x0, 0x0		 //tile:21
, 0x0, 0x0, 0x7F, 0x7F, 0x0, 0x0, 0x0, 0x7F, 0x0, 0x0, 0x0, 0x0, 0x7F, 0x0, 0x0, 0x0, 0x0, 0x0, 0x7F, 0x7F, 0x7F, 0x7F, 0x0, 0x0, 0x7F, 0x0, 0x0, 0x0, 0x7F, 0x0, 0x7F, 0x0, 0x0, 0x0, 0x7F, 0x0, 0x0, 0x7F, 0x7F, 0x7F, 0x0, 0x0, 0x0, 0x0, 0x0, 0x0, 0x0, 0x0		 //tile:22
, 0x7F, 0x7F, 0x7F, 0x7F, 0x7F, 0x0, 0x0, 0x0, 0x0, 0x0, 0x7F, 0x0, 0x0, 0x0, 0x0, 0x7F, 0x0, 0x0, 0x0, 0x0, 0x7F, 0x0, 0x0, 0x0, 0x0, 0x7F, 0x0, 0x0, 0x0, 0x0, 0x0, 0x7F, 0x0, 0x0, 0x0, 0x0, 0x0, 0x7F, 0x0, 0x0, 0x0, 0x0, 0x0, 0x0, 0x0, 0x0, 0x0, 0x0		 //tile:23
, 0x0, 0x7F, 0x7F, 0x7F, 0x0, 0x0, 0x7F, 0x0, 0x0, 0x0, 0x7F, 0x0, 0x7F, 0x0, 0x0, 0x0, 0x7F, 0x0, 0x0, 0x7F, 0x7F, 0x7F, 0x0, 0x0, 0x7F, 0x0, 0x0, 0x0, 0x7F, 0x0, 0x7F, 0x0, 0x0, 0x0, 0x7F, 0x0, 0x0, 0x7F, 0x7F, 0x7F, 0x0, 0x0, 0x0, 0x0, 0x0, 0x0, 0x0, 0x0		 //tile:24
, 0x0, 0x7F, 0x7F, 0x7F, 0x0, 0x0, 0x7F, 0x0, 0x0, 0x0, 0x7F, 0x0, 0x7F, 0x0, 0x0, 0x0, 0x7F, 0x0, 0x0, 0x7F, 0x7F, 0x7F, 0x7F, 0x0, 0x0, 0x0, 0x0, 0x0, 0x7F, 0x0, 0x0, 0x0, 0x0, 0x7F, 0x0, 0x0, 0x0, 0x7F, 0x7F, 0x0, 0x0, 0x0, 0x0, 0x0, 0x0, 0x0, 0x0, 0x0		 //tile:25
, 0x0, 0x7F, 0x7F, 0x7F, 0x0, 0x0, 0x7F, 0x0, 0x0, 0x0, 0x7F, 0x0, 0x7F, 0x0, 0x0, 0x0, 0x7F, 0x0, 0x7F, 0x0, 0x0, 0x0, 0x7F, 0x0, 0x7F, 0x7F, 0x7F, 0x7F, 0x7F, 0x0, 0x7F, 0x0, 0x0, 0x0, 0x7F, 0x0, 0x7F, 0x0, 0x0, 0x0, 0x7F, 0x0, 0x0, 0x0, 0x0, 0x0, 0x0, 0x0		 //tile:33
, 0x7F, 0x7F, 0x7F, 0x7F, 0x0, 0x0, 0x7F, 0x0, 0x0, 0x0, 0x7F, 0x0, 0x7F, 0x0, 0x0, 0x0, 0x7F, 0x0, 0x7F, 0x7F, 0x7F, 0x7F, 0x0, 0x0, 0x7F, 0x0, 0x0, 0x0, 0x7F, 0x0, 0x7F, 0x0, 0x0, 0x0, 0x7F, 0x0, 0x7F, 0x7F, 0x7F, 0x7F, 0x0, 0x0, 0x0, 0x0, 0x0, 0x0, 0x0, 0x0		 //tile:34
, 0x0, 0x7F, 0x7F, 0x7F, 0x0, 0x0, 0x7F, 0x0, 0x0, 0x0, 0x7F, 0x0, 0x7F, 0x0, 0x0, 0x0, 0x0, 0x0, 0x7F, 0x0, 0x0, 0x0, 0x0, 0x0, 0x7F, 0x0, 0x0, 0x0, 0x0, 0x0, 0x7F, 0x0, 0x0, 0x0, 0x7F, 0x0, 0x0, 0x7F, 0x7F, 0x7F, 0x0, 0x0, 0x0, 0x0, 0x0, 0x0, 0x0, 0x0		 //tile:35
, 0x7F, 0x7F, 0x7F, 0x7F, 0x0, 0x0, 0x7F, 0x0, 0x0, 0x0, 0x7F, 0x0, 0x7F, 0x0, 0x0, 0x0, 0x7F, 0x0, 0x7F, 0x0, 0x0, 0x0, 0x7F, 0x0, 0x7F, 0x0, 0x0, 0x0, 0x7F, 0x0, 0x7F, 0x0, 0x0, 0x0, 0x7F, 0x0, 0x7F, 0x7F, 0x7F, 0x7F, 0x0, 0x0, 0x0, 0x0, 0x0, 0x0, 0x0, 0x0		 //tile:36
, 0x7F, 0x7F, 0x7F, 0x7F, 0x7F, 0x0, 0x7F, 0x0, 0x0, 0x0, 0x0, 0x0, 0x7F, 0x0, 0x0, 0x0, 0x0, 0x0, 0x7F, 0x7F, 0x7F, 0x7F, 0x0, 0x0, 0x7F, 0x0, 0x0, 0x0, 0x0, 0x0, 0x7F, 0x0, 0x0, 0x0, 0x0, 0x0, 0x7F, 0x7F, 0x7F, 0x7F, 0x7F, 0x0, 0x0, 0x0, 0x0, 0x0, 0x0, 0x0		 //tile:37
, 0x7F, 0x7F, 0x7F, 0x7F, 0x7F, 0x0, 0x7F, 0x0, 0x0, 0x0, 0x0, 0x0, 0x7F, 0x0, 0x0, 0x0, 0x0, 0x0, 0x7F, 0x7F, 0x7F, 0x7F, 0x0, 0x0, 0x7F, 0x0, 0x0, 0x0, 0x0, 0x0, 0x7F, 0x0, 0x0, 0x0, 0x0, 0x0, 0x7F, 0x0, 0x0, 0x0, 0x0, 0x0, 0x0, 0x0, 0x0, 0x0, 0x0, 0x0		 //tile:38
, 0x0, 0xF8, 0xF8, 0xF8, 0x0, 0x0, 0xF8, 0x0, 0x0, 0x0, 0xF8, 0x0, 0xF8, 0x0, 0x0, 0xF8, 0xF8, 0x0, 0xF8, 0x0, 0xF8, 0x0, 0xF8, 0x0, 0xF8, 0xF8, 0x0, 0x0, 0xF8, 0x0, 0xF8, 0x0, 0x0, 0x0, 0xF8, 0x0, 0x0, 0xF8, 0xF8, 0xF8, 0x0, 0x0, 0x0, 0x0, 0x0, 0x0, 0x0, 0x0		 //tile:16
, 0x0, 0x0, 0xF8, 0x0, 0x0, 0x0, 0x0, 0xF8, 0xF8, 0x0, 0x0, 0x0, 0x0, 0x0, 0xF8, 0x0, 0x0, 0x0, 0x0, 0x0, 0xF8, 0x0, 0x0, 0x0, 0x0, 0x0, 0xF8, 0x0, 0x0, 0x0, 0x0, 0x0, 0xF8, 0x0, 0x0, 0x0, 0x0, 0xF8, 0xF8, 0xF8, 0x0, 0x0, 0x0, 0x0, 0x0, 0x0, 0x0, 0x0		 //tile:17
, 0x0, 0xF8, 0xF8, 0xF8, 0x0, 0x0, 0xF8, 0x0, 0x0, 0x0, 0xF8, 0x0, 0x0, 0x0, 0x0, 0x0, 0xF8, 0x0, 0x0, 0x0, 0xF8, 0xF8, 0x0, 0x0, 0x0, 0xF8, 0x0, 0x0, 0x0, 0x0, 0xF8, 0x0, 0x0, 0x0, 0x0, 0x0, 0xF8, 0xF8, 0xF8, 0xF8, 0xF8, 0x0, 0x0, 0x0, 0x0, 0x0, 0x0, 0x0		 //tile:18
, 0x0, 0xF8, 0xF8, 0xF8, 0x0, 0x0, 0xF8, 0x0, 0x0, 0x0, 0xF8, 0x0, 0x0, 0x0, 0x0, 0x0, 0xF8, 0x0, 0x0, 0xF8, 0xF8, 0xF8, 0x0, 0x0, 0x0, 0x0, 0x0, 0x0, 0xF8, 0x0, 0xF8, 0x0, 0x0, 0x0, 0xF8, 0x0, 0x0, 0xF8, 0xF8, 0xF8, 0x0, 0x0, 0x0, 0x0, 0x0, 0x0, 0x0, 0x0		 //tile:19
, 0x0, 0x0, 0x0, 0xF8, 0x0, 0x0, 0x0, 0x0, 0xF8, 0xF8, 0x0, 0x0, 0x0, 0xF8, 0x0, 0xF8, 0x0, 0x0, 0xF8, 0x0, 0x0, 0xF8, 0x0, 0x0, 0xF8, 0xF8, 0xF8, 0xF8, 0xF8, 0x0, 0x0, 0x0, 0x0, 0xF8, 0x0, 0x0, 0x0, 0x0, 0x0, 0xF8, 0x0, 0x0, 0x0, 0x0, 0x0, 0x0, 0x0, 0x0		 //tile:20
, 0xF8, 0xF8, 0xF8, 0xF8, 0xF8, 0x0, 0xF8, 0x0, 0x0, 0x0, 0x0, 0x0, 0xF8, 0x0, 0x0, 0x0, 0x0, 0x0, 0xF8, 0xF8, 0xF8, 0xF8, 0x0, 0x0, 0x0, 0x0, 0x0, 0x0, 0xF8, 0x0, 0xF8, 0x0, 0x0, 0x0, 0xF8, 0x0, 0x0, 0xF8, 0xF8, 0xF8, 0x0, 0x0, 0x0, 0x0, 0x0, 0x0, 0x0, 0x0		 //tile:21
, 0x0, 0x0, 0xF8, 0xF8, 0x0, 0x0, 0x0, 0xF8, 0x0, 0x0, 0x0, 0x0, 0xF8, 0x0, 0x0, 0x0, 0x0, 0x0, 0xF8, 0xF8, 0xF8, 0xF8, 0x0, 0x0, 0xF8, 0x0, 0x0, 0x0, 0xF8, 0x0, 0xF8, 0x0, 0x0, 0x0, 0xF8, 0x0, 0x0, 0xF8, 0xF8, 0xF8, 0x0, 0x0, 0x0, 0x0, 0x0, 0x0, 0x0, 0x0		 //tile:22
, 0xF8, 0xF8, 0xF8, 0xF8, 0xF8, 0x0, 0x0, 0x0, 0x0, 0x0, 0xF8, 0x0, 0x0, 0x0, 0x0, 0xF8, 0x0, 0x0, 0x0, 0x0, 0xF8, 0x0, 0x0, 0x0, 0x0, 0xF8, 0x0, 0x0, 0x0, 0x0, 0x0, 0xF8, 0x0, 0x0, 0x0, 0x0, 0x0, 0xF8, 0x0, 0x0, 0x0, 0x0, 0x0, 0x0, 0x0, 0x0, 0x0, 0x0		 //tile:23
, 0x0, 0xF8, 0xF8, 0xF8, 0x0, 0x0, 0xF8, 0x0, 0x0, 0x0, 0xF8, 0x0, 0xF8, 0x0, 0x0, 0x0, 0xF8, 0x0, 0x0, 0xF8, 0xF8, 0xF8, 0x0, 0x0, 0xF8, 0x0, 0x0, 0x0, 0xF8, 0x0, 0xF8, 0x0, 0x0, 0x0, 0xF8, 0x0, 0x0, 0xF8, 0xF8, 0xF8, 0x0, 0x0, 0x0, 0x0, 0x0, 0x0, 0x0, 0x0		 //tile:24
, 0x0, 0xF8, 0xF8, 0xF8, 0x0, 0x0, 0xF8, 0x0, 0x0, 0x0, 0xF8, 0x0, 0xF8, 0x0, 0x0, 0x0, 0xF8, 0x0, 0x0, 0xF8, 0xF8, 0xF8, 0xF8, 0x0, 0x0, 0x0, 0x0, 0x0, 0xF8, 0x0, 0x0, 0x0, 0x0, 0xF8, 0x0, 0x0, 0x0, 0xF8, 0xF8, 0x0, 0x0, 0x0, 0x0, 0x0, 0x0, 0x0, 0x0, 0x0		 //tile:25
, 0x0, 0xF8, 0xF8, 0xF8, 0x0, 0x0, 0xF8, 0x0, 0x0, 0x0, 0xF8, 0x0, 0xF8, 0x0, 0x0, 0x0, 0xF8, 0x0, 0xF8, 0x0, 0x0, 0x0, 0xF8, 0x0, 0xF8, 0xF8, 0xF8, 0xF8, 0xF8, 0x0, 0xF8, 0x0, 0x0, 0x0, 0xF8, 0x0, 0xF8, 0x0, 0x0, 0x0, 0xF8, 0x0, 0x0, 0x0, 0x0, 0x0, 0x0, 0x0		 //tile:33
, 0xF8, 0xF8, 0xF8, 0xF8, 0x0, 0x0, 0xF8, 0x0, 0x0, 0x0, 0xF8, 0x0, 0xF8, 0x0, 0x0, 0x0, 0xF8, 0x0, 0xF8, 0xF8, 0xF8, 0xF8, 0x0, 0x0, 0xF8, 0x0, 0x0, 0x0, 0xF8, 0x0, 0xF8, 0x0, 0x0, 0x0, 0xF8, 0x0, 0xF8, 0xF8, 0xF8, 0xF8, 0x0, 0x0, 0x0, 0x0, 0x0, 0x0, 0x0, 0x0		 //tile:34
, 0x0, 0xF8, 0xF8, 0xF8, 0x0, 0x0, 0xF8, 0x0, 0x0, 0x0, 0xF8, 0x0, 0xF8, 0x0, 0x0, 0x0, 0x0, 0x0, 0xF8, 0x0, 0x0, 0x0, 0x0, 0x0, 0xF8, 0x0, 0x0, 0x0, 0x0, 0x0, 0xF8, 0x0, 0x0, 0x0, 0xF8, 0x0, 0x0, 0xF8, 0xF8, 0xF8, 0x0, 0x0, 0x0, 0x0, 0x0, 0x0, 0x0, 0x0		 //tile:35
, 0xF8, 0xF8, 0xF8, 0xF8, 0x0, 0x0, 0xF8, 0x0, 0x0, 0x0, 0xF8, 0x0, 0xF8, 0x0, 0x0, 0x0, 0xF8, 0x0, 0xF8, 0x0, 0x0, 0x0, 0xF8, 0x0, 0xF8, 0x0, 0x0, 0x0, 0xF8, 0x0, 0xF8, 0x0, 0x0, 0x0, 0xF8, 0x0, 0xF8, 0xF8, 0xF8, 0xF8, 0x0, 0x0, 0x0, 0x0, 0x0, 0x0, 0x0, 0x0		 //tile:36
, 0xF8, 0xF8, 0xF8, 0xF8, 0xF8, 0x0, 0xF8, 0x0, 0x0, 0x0, 0x0, 0x0, 0xF8, 0x0, 0x0, 0x0, 0x0, 0x0, 0xF8, 0xF8, 0xF8, 0xF8, 0x0, 0x0, 0xF8, 0x0, 0x0, 0x0, 0x0, 0x0, 0xF8, 0x0, 0x0, 0x0, 0x0, 0x0, 0xF8, 0xF8, 0xF8, 0xF8, 0xF8, 0x0, 0x0, 0x0, 0x0, 0x0, 0x0, 0x0		 //tile:37
, 0xF8, 0xF8, 0xF8, 0xF8, 0xF8, 0x0, 0xF8, 0x0, 0x0, 0x0, 0x0, 0x0, 0xF8, 0x0, 0x0, 0x0, 0x0, 0x0, 0xF8, 0xF8, 0xF8, 0xF8, 0x0, 0x0, 0xF8, 0x0, 0x0, 0x0, 0x0, 0x0, 0xF8, 0x0, 0x0, 0x0, 0x0, 0x0, 0xF8, 0x0, 0x0, 0x0, 0x0, 0x0, 0x0, 0x0, 0x0, 0x0, 0x0, 0x0		 //tile:38
};

const char BlockBoySong1[] PROGMEM ={
0x00,0xc0,0x00,0x00,0xc1,0x01,0x00,0xc2,0x02,0x00,0xc3,0x02,0x00,0x90,0x23,0x40,0x00,0xb2,0x07,0x7f,0x00,0x93,0x04,0x40,0x00,0xff,0x06,0x01,0x53,0x0f,0x90,0x23,
0x40,0x0f,0x27,0x40,0x00,0x93,0x06,0x40,0x07,0x90,0x23,0x40,0x0f,0x23,0x40,0x08,0x27,0x40,0x00,0x93,0x04,0x40,0x1e,0x92,0x2f,0x40,0x00,0x93,0x06,0x40,0x1e,0x90,
0x21,0x40,0x00,0x91,0x21,0x40,0x00,0x93,0x04,0x40,0x07,0x91,0x20,0x40,0x08,0x90,0x21,0x40,0x00,0x91,0x21,0x40,0x0f,0x90,0x26,0x40,0x00,0x93,0x06,0x40,0x07,0x90,
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0x40,0x0f,0xff,0x06,0x01,0x45,0x00,0xff,0x2f,0x00};


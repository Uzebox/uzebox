const char Level4Song[] PROGMEM ={
0x00,0xc0,0x28,0x00,0xc1,0x29,0x00,0xc2,0x02,0x00,0xc3,0x00,0x00,0xb0,0x07,0x60,0x00,0xb1,0x07,0x7f,0x00,0xb2,0x07,0x7f,0x00,0xb3,0x07,0x7f,0x00,0xff,0x06,0x01,
0x53,0x01,0x90,0x37,0x7f,0x00,0xb0,0x0b,0x7f,0x00,0xb1,0x0b,0x7f,0x00,0x91,0x3d,0x7f,0x00,0x93,0x2b,0x7f,0x01,0x91,0x39,0x7f,0x00,0x93,0x2b,0x7f,0x01,0x91,0x35,
0x7f,0x01,0x90,0x3c,0x7f,0x00,0x91,0x31,0x7f,0x01,0x2d,0x7f,0x02,0x90,0x40,0x7f,0x03,0x3c,0x7f,0x03,0x37,0x7f,0x03,0x3c,0x7f,0x00,0x91,0x3c,0x7f,0x03,0x90,0x40,
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0x7f,0x02,0x90,0x40,0x7f,0x03,0x3c,0x7f,0x03,0x37,0x7f,0x01,0xff,0x2f,0x00 };


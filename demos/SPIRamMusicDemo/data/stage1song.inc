const char Level1Song[] PROGMEM ={
0x00,0xc0,0x16,0x00,0xc1,0x17,0x00,0xc2,0x18,0x00,0xc3,0x00,0x00,0xb3,0x07,0x7f,0x00,0xb2,0x07,0x7f,0x00,0xff,0x06,0x01,0x53,0x01,0x90,0x40,0x7f,0x00,0x91,0x37,
0x7f,0x14,0x90,0x40,0x7f,0x00,0x91,0x37,0x7f,0x14,0x93,0x1a,0x7f,0x00,0x90,0x41,0x7f,0x00,0x91,0x39,0x7f,0x02,0x93,0x19,0x7f,0x08,0x90,0x42,0x7f,0x00,0x91,0x3a,
0x7f,0x14,0x90,0x43,0x7f,0x00,0x91,0x3b,0x7f,0x32,0x93,0x1a,0x7f,0x02,0x19,0x7f,0x26,0x90,0x41,0x7f,0x00,0x91,0x3c,0x7f,0x14,0x90,0x41,0x7f,0x00,0x91,0x3c,0x7f,
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0x90,0x38,0x7f,0x00,0x91,0x37,0x7f,0x0b,0xff,0x06,0x01,0x45,0x00,0xff,0x2f,0x00 };


/*
 * Transformation file: cursor.xml
 * Source image: /home/flavio/uzebox/ctester/data/cursor.png
 * Tile width: 8px
 * Tile height: 8px
 */
#define MAP_CURSOR_WIDTH 2
#define MAP_CURSOR_HEIGHT 2
const char map_cursor[] PROGMEM ={
2,2
,0x0,0x1,0x2,0x3};

#define CURSOR_SIZE 4
const char cursor[] PROGMEM={
 0x18, 0xfe, 0xfe, 0xfe, 0xfe, 0xfe, 0xfe, 0xfe, 0xfe, 0x18, 0xfe, 0xfe,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 0xfe, 0xfe		 //tile:0
, 0xfe, 0xfe, 0xfe, 0xfe, 0xfe, 0xfe, 0xfe, 0x18, 0xfe, 0xfe, 0xfe, 0xfe,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 0xfe, 0xfe		 //tile:1
, 0xfe, 0xfe, 0xfe, 0x7, 0xfe, 0xfe, 0xfe, 0xfe, 0xfe, 0xfe, 0xfe, 0xfe,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 0xfe, 0xfe		 //tile:2
, 0xfe, 0xfe, 0xfe, 0xfe, 0x7, 0xfe, 0xfe, 0xfe, 0xfe, 0xfe, 0xfe, 0x7,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 0xfe, 0x18		 //tile:3
};

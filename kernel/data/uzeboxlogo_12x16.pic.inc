const char uzeboxlogo[] PROGMEM = {
	/* tile 0 */

  0x00,0x00,0x00,0x00,0x00,0x00,0x00,0x00,0x00,0x00,0x00,0x00,
  0x00,0x00,0x00,0x00,0x00,0x00,0x00,0x00,0x00,0x00,0x00,0x00,
  0x00,0x00,0x00,0x00,0x00,0x00,0x00,0x00,0x00,0x00,0x00,0x00,
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  0x00,0x00,0x00,0x00,0x00,0x00,0x00,0x00,0x00,0x00,0x00,0x00,
/* tile 1 */

  0x00,0x00,0x00,0x00,0x00,0x00,0x00,0x00,0x00,0x00,0x00,0x00,
  0x00,0x00,0x00,0x00,0x00,0x00,0x00,0x00,0x00,0x00,0x00,0x00,
  0x00,0x00,0x00,0x00,0x00,0x00,0x00,0x00,0x00,0x00,0x00,0x00,
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  0x09,0x1B,0x1C,0x6D,0x7F,0x37,0x2E,0x2E,0x2E,0x37,0x37,0x1C,
/* tile 2 */

  0x00,0x00,0x00,0x00,0x00,0x00,0x00,0x00,0x00,0x00,0x00,0x00,
  0x00,0x00,0x00,0x00,0x00,0x00,0x00,0x00,0x00,0x40,0x49,0x49,
  0x00,0x00,0x00,0x00,0x00,0x00,0x49,0x49,0x52,0x52,0x5B,0x1B,
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  0x1C,0x1C,0x1C,0x1C,0x1C,0x13,0x0A,0x2F,0x25,0x25,0x01,0x00,
/* tile 3 */

  0x00,0x00,0x00,0x00,0x00,0x00,0x00,0x00,0x00,0x00,0x00,0x00,
  0x52,0x52,0x52,0x52,0x52,0x52,0x49,0x49,0x49,0x00,0x00,0x00,
  0x12,0x12,0x13,0x09,0x00,0x1C,0x1B,0x13,0x52,0x49,0x49,0x00,
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  0x01,0x6E,0x7F,0x6E,0x12,0x13,0x00,0x00,0x00,0x00,0x00,0x00,
/* tile 4 */

  0x13,0x1B,0x3F,0x7F,0x37,0x2E,0x37,0x2E,0x37,0x77,0x25,0x1C,
  0x13,0x25,0x7F,0x77,0x77,0x77,0x77,0x76,0x77,0x2D,0x1C,0x1C,
  0x13,0x6D,0x7F,0x77,0x77,0x77,0x76,0x77,0x2E,0x1C,0x1C,0x1C,
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  0x00,0x26,0x26,0x00,0x00,0x00,0x26,0x26,0x26,0x26,0x26,0x00,
/* tile 5 */

  0x1C,0x1C,0x1C,0x1C,0x1C,0x25,0x2E,0x1D,0x01,0x00,0x09,0x77,
  0x1C,0x1C,0x24,0x25,0x2D,0x24,0x01,0x00,0x09,0x77,0x7F,0x7F,
  0x1C,0x25,0x2D,0x1B,0x00,0x00,0x0A,0x7F,0x7F,0x7F,0x25,0x12,
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  0x26,0x26,0x26,0x26,0x26,0x00,0x26,0x26,0x26,0x26,0x00,0x00,
/* tile 6 */

  0x7F,0x7F,0x13,0x13,0x13,0x00,0x00,0x00,0x00,0x00,0x00,0x00,
  0x1C,0x0A,0x1B,0x00,0x00,0x00,0x00,0x00,0x00,0x00,0x00,0x00,
  0x1B,0x0A,0x00,0x00,0x00,0x00,0x00,0x00,0x00,0x00,0x00,0x00,
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  0x26,0x26,0x26,0x00,0x00,0x00,0x26,0x00,0x00,0x00,0x26,0x00,
/* tile 7 */

  0xC7,0xC7,0xC7,0xC7,0xC7,0xC7,0xC7,0xC7,0xC7,0xC7,0xC7,0xC7,
  0xC7,0xC7,0xC7,0xC7,0xC7,0xC7,0xC7,0xC7,0xC7,0xC7,0xC7,0xC7,
  0xC7,0xC7,0xC7,0xC7,0xC7,0xC7,0xC7,0xC7,0xC7,0xC7,0xC7,0xC7,
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  0xC7,0xC7,0xC7,0xC7,0xC7,0xC7,0xC7,0xC7,0xC7,0xC7,0xC7,0xC7,
};

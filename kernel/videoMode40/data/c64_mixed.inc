/*
** Commodore 64 PETSCII Mixed font (low: Alphanumeric, high: Graphics)
*/

const char m40_c64_mixed[2048] __attribute__ ((aligned(256))) PROGMEM = {
 0x3CU, 0x00U, 0x00U, 0x00U, 0x00U, 0x00U, 0x00U, 0x00U, 0x00U, 0x00U, 0x00U, 0x00U, 0x00U, 0x00U, 0x00U, 0x00U, 0x00U, 0x00U, 0x00U, 0x00U, 0x00U, 0x00U, 0x00U, 0x00U, 0x00U, 0x00U, 0x00U, 0x3CU, 0x30U, 0x3CU, 0x00U, 0x00U, 0x00U, 0x18U, 0x66U, 0x66U, 0x18U, 0x46U, 0x3CU, 0x60U, 0x30U, 0x0CU, 0x00U, 0x00U, 0x00U, 0x00U, 0x00U, 0x00U, 0x3CU, 0x18U, 0x3CU, 0x3CU, 0x60U, 0x7EU, 0x3CU, 0x7EU, 0x3CU, 0x3CU, 0x00U, 0x00U, 0x70U, 0x00U, 0x0EU, 0x3CU, 0x00U, 0x18U, 0x3EU, 0x3CU, 0x1EU, 0x7EU, 0x7EU, 0x3CU, 0x66U, 0x3CU, 0x78U, 0x66U, 0x06U, 0xC6U, 0x66U, 0x3CU, 0x3EU, 0x3CU, 0x3EU, 0x3CU, 0x7EU, 0x66U, 0x66U, 0xC6U, 0x66U, 0x66U, 0x7EU, 0x18U, 0x03U, 0x18U, 0xCCU, 0xCCU, 0x00U, 0x0FU, 0x00U, 0xFFU, 0x00U, 0x03U, 0x33U, 0xC0U, 0x00U, 0x33U, 0xC0U, 0x18U, 0x00U, 0x18U, 0x00U, 0x00U, 0x00U, 0x18U, 0x00U, 0x18U, 0x03U, 0x07U, 0xE0U, 0xFFU, 0xFFU, 0x00U, 0x80U, 0x00U, 0xF0U, 0x18U, 0x0FU, 0x0FU, 0x3CU, 0x18U, 0x3EU, 0x3CU, 0x1EU, 0x7EU, 0x7EU, 0x3CU, 0x66U, 0x3CU, 0x78U, 0x66U, 0x06U, 0xC6U, 0x66U, 0x3CU, 0x3EU, 0x3CU, 0x3EU, 0x3CU, 0x7EU, 0x66U, 0x66U, 0xC6U, 0x66U, 0x66U, 0x7EU, 0x3CU, 0x30U, 0x3CU, 0x00U, 0x00U, 0x00U, 0x18U, 0x66U, 0x66U, 0x18U, 0x46U, 0x3CU, 0x60U, 0x30U, 0x0CU, 0x00U, 0x00U, 0x00U, 0x00U, 0x00U, 0x00U, 0x3CU, 0x18U, 0x3CU, 0x3CU, 0x60U, 0x7EU, 0x3CU, 0x7EU, 0x3CU, 0x3CU, 0x00U, 0x00U, 0x70U, 0x00U, 0x0EU, 0x3CU, 0x00U, 0x10U, 0x18U, 0x00U, 0x00U, 0x00U, 0x00U, 0x0CU, 0x30U, 0x00U, 0x18U, 0x18U, 0x03U, 0x03U, 0xC0U, 0xFFU, 0xFFU, 0x00U, 0x00U, 0x6CU, 0x06U, 0x00U, 0xC3U, 0x00U, 0x18U, 0x60U, 0x10U, 0x18U, 0x03U, 0x18U, 0x00U, 0xFFU, 0x00U, 0x0FU, 0x00U, 0xFFU, 0x00U, 0x03U, 0x33U, 0xC0U, 0x00U, 0xFFU, 0xC0U, 0x18U, 0x00U, 0x18U, 0x00U, 0x00U, 0x00U, 0x18U, 0x00U, 0x18U, 0x03U, 0x07U, 0xE0U, 0xFFU, 0xFFU, 0x00U, 0xC0U, 0x00U, 0xF0U, 0x18U, 0x0FU, 0x0FU,
 0x66U, 0x00U, 0x06U, 0x00U, 0x60U, 0x00U, 0x70U, 0x00U, 0x06U, 0x18U, 0x60U, 0x06U, 0x1CU, 0x00U, 0x00U, 0x00U, 0x00U, 0x00U, 0x00U, 0x00U, 0x18U, 0x00U, 0x00U, 0x00U, 0x00U, 0x00U, 0x00U, 0x0CU, 0x48U, 0x30U, 0x18U, 0x08U, 0x00U, 0x18U, 0x66U, 0x66U, 0x7CU, 0x66U, 0x66U, 0x30U, 0x18U, 0x18U, 0x66U, 0x18U, 0x00U, 0x00U, 0x00U, 0xC0U, 0x66U, 0x18U, 0x66U, 0x66U, 0x70U, 0x06U, 0x66U, 0x66U, 0x66U, 0x66U, 0x00U, 0x00U, 0x18U, 0x00U, 0x18U, 0x66U, 0x00U, 0x3CU, 0x66U, 0x66U, 0x36U, 0x06U, 0x06U, 0x66U, 0x66U, 0x18U, 0x30U, 0x36U, 0x06U, 0xEEU, 0x6EU, 0x66U, 0x66U, 0x66U, 0x66U, 0x66U, 0x18U, 0x66U, 0x66U, 0xC6U, 0x66U, 0x66U, 0x60U, 0x18U, 0x03U, 0x18U, 0xCCU, 0x99U, 0x00U, 0x0FU, 0x00U, 0x00U, 0x00U, 0x03U, 0x33U, 0xC0U, 0x00U, 0x99U, 0xC0U, 0x18U, 0x00U, 0x18U, 0x00U, 0x00U, 0x00U, 0x18U, 0x00U, 0x18U, 0x03U, 0x07U, 0xE0U, 0xFFU, 0xFFU, 0x00U, 0xC0U, 0x00U, 0xF0U, 0x18U, 0x0FU, 0x0FU, 0x66U, 0x3CU, 0x66U, 0x66U, 0x36U, 0x06U, 0x06U, 0x66U, 0x66U, 0x18U, 0x30U, 0x36U, 0x06U, 0xEEU, 0x6EU, 0x66U, 0x66U, 0x66U, 0x66U, 0x66U, 0x18U, 0x66U, 0x66U, 0xC6U, 0x66U, 0x66U, 0x60U, 0x0CU, 0x48U, 0x30U, 0x18U, 0x08U, 0x00U, 0x18U, 0x66U, 0x66U, 0x7CU, 0x66U, 0x66U, 0x30U, 0x18U, 0x18U, 0x66U, 0x18U, 0x00U, 0x00U, 0x00U, 0xC0U, 0x66U, 0x18U, 0x66U, 0x66U, 0x70U, 0x06U, 0x66U, 0x66U, 0x66U, 0x66U, 0x00U, 0x00U, 0x18U, 0x00U, 0x18U, 0x66U, 0x00U, 0x38U, 0x18U, 0x00U, 0x00U, 0xFFU, 0x00U, 0x0CU, 0x30U, 0x00U, 0x18U, 0x18U, 0x03U, 0x07U, 0xE0U, 0xFFU, 0xFFU, 0x3CU, 0x00U, 0xFEU, 0x06U, 0x00U, 0xE7U, 0x3CU, 0x18U, 0x60U, 0x38U, 0x18U, 0x03U, 0x18U, 0x00U, 0xFEU, 0x00U, 0x0FU, 0x00U, 0x00U, 0x00U, 0x03U, 0x33U, 0xC0U, 0x00U, 0x7FU, 0xC0U, 0x18U, 0x00U, 0x18U, 0x00U, 0x00U, 0x00U, 0x18U, 0x00U, 0x18U, 0x03U, 0x07U, 0xE0U, 0xFFU, 0xFFU, 0x00U, 0xC0U, 0x00U, 0xF0U, 0x18U, 0x0FU, 0x0FU,
 0x76U, 0x3CU, 0x06U, 0x3CU, 0x60U, 0x3CU, 0x18U, 0x7CU, 0x06U, 0x00U, 0x00U, 0x06U, 0x18U, 0x66U, 0x3EU, 0x3CU, 0x3EU, 0x7CU, 0x3EU, 0x7CU, 0x7EU, 0x66U, 0x66U, 0xC6U, 0x66U, 0x66U, 0x7EU, 0x0CU, 0x0CU, 0x30U, 0x3CU, 0x0CU, 0x00U, 0x18U, 0x66U, 0xFFU, 0x06U, 0x30U, 0x3CU, 0x18U, 0x0CU, 0x30U, 0x3CU, 0x18U, 0x00U, 0x00U, 0x00U, 0x60U, 0x76U, 0x1CU, 0x60U, 0x60U, 0x78U, 0x3EU, 0x06U, 0x30U, 0x66U, 0x66U, 0x18U, 0x18U, 0x0CU, 0x7EU, 0x30U, 0x60U, 0x00U, 0x66U, 0x66U, 0x06U, 0x66U, 0x06U, 0x06U, 0x06U, 0x66U, 0x18U, 0x30U, 0x1EU, 0x06U, 0xFEU, 0x7EU, 0x66U, 0x66U, 0x66U, 0x66U, 0x06U, 0x18U, 0x66U, 0x66U, 0xC6U, 0x3CU, 0x66U, 0x30U, 0x18U, 0x0CU, 0x18U, 0x33U, 0x33U, 0x00U, 0x0FU, 0x00U, 0x00U, 0x00U, 0x03U, 0xCCU, 0xC0U, 0x00U, 0xCCU, 0xC0U, 0x18U, 0x00U, 0x18U, 0x00U, 0x00U, 0x00U, 0x18U, 0x00U, 0x18U, 0x03U, 0x07U, 0xE0U, 0x00U, 0xFFU, 0x00U, 0x60U, 0x00U, 0xF0U, 0x18U, 0x0FU, 0x0FU, 0x76U, 0x66U, 0x66U, 0x06U, 0x66U, 0x06U, 0x06U, 0x06U, 0x66U, 0x18U, 0x30U, 0x1EU, 0x06U, 0xFEU, 0x7EU, 0x66U, 0x66U, 0x66U, 0x66U, 0x06U, 0x18U, 0x66U, 0x66U, 0xC6U, 0x3CU, 0x66U, 0x30U, 0x0CU, 0x0CU, 0x30U, 0x3CU, 0x0CU, 0x00U, 0x18U, 0x66U, 0xFFU, 0x06U, 0x30U, 0x3CU, 0x18U, 0x0CU, 0x30U, 0x3CU, 0x18U, 0x00U, 0x00U, 0x00U, 0x60U, 0x76U, 0x1CU, 0x60U, 0x60U, 0x78U, 0x3EU, 0x06U, 0x30U, 0x66U, 0x66U, 0x18U, 0x18U, 0x0CU, 0x7EU, 0x30U, 0x60U, 0x00U, 0x7CU, 0x18U, 0x00U, 0xFFU, 0xFFU, 0x00U, 0x0CU, 0x30U, 0x00U, 0x38U, 0x1CU, 0x03U, 0x0EU, 0x70U, 0x03U, 0xC0U, 0x7EU, 0x00U, 0xFEU, 0x06U, 0x00U, 0x7EU, 0x7EU, 0x66U, 0x60U, 0x7CU, 0x18U, 0x0CU, 0x18U, 0xC0U, 0xFCU, 0x00U, 0x0FU, 0x00U, 0x00U, 0x00U, 0x03U, 0xCCU, 0xC0U, 0x00U, 0x3FU, 0xC0U, 0x18U, 0x00U, 0x18U, 0x00U, 0x00U, 0x00U, 0x18U, 0x00U, 0x18U, 0x03U, 0x07U, 0xE0U, 0x00U, 0xFFU, 0x00U, 0xC0U, 0x00U, 0xF0U, 0x18U, 0x0FU, 0x0FU,
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 0x00U, 0x00U, 0x00U, 0x00U, 0x00U, 0x00U, 0x00U, 0x3EU, 0x00U, 0x00U, 0x3CU, 0x00U, 0x00U, 0x00U, 0x00U, 0x00U, 0x06U, 0x60U, 0x00U, 0x00U, 0x00U, 0x00U, 0x00U, 0x00U, 0x00U, 0x1EU, 0x00U, 0x00U, 0x00U, 0x00U, 0x18U, 0x00U, 0x00U, 0x00U, 0x00U, 0x00U, 0x00U, 0x00U, 0x00U, 0x00U, 0x00U, 0x00U, 0x00U, 0x00U, 0x0CU, 0x00U, 0x00U, 0x00U, 0x00U, 0x00U, 0x00U, 0x00U, 0x00U, 0x00U, 0x00U, 0x00U, 0x00U, 0x00U, 0x00U, 0x0CU, 0x00U, 0x00U, 0x00U, 0x00U, 0x00U, 0x00U, 0x00U, 0x00U, 0x00U, 0x00U, 0x00U, 0x00U, 0x00U, 0x00U, 0x00U, 0x00U, 0x00U, 0x00U, 0x00U, 0x00U, 0x00U, 0x00U, 0x00U, 0x00U, 0x00U, 0x00U, 0x00U, 0x00U, 0x00U, 0x00U, 0x00U, 0x18U, 0x0CU, 0x18U, 0x33U, 0x66U, 0x00U, 0x0FU, 0xFFU, 0x00U, 0xFFU, 0x03U, 0xCCU, 0xC0U, 0xCCU, 0x66U, 0xC0U, 0x18U, 0xF0U, 0x00U, 0x18U, 0xFFU, 0x18U, 0x00U, 0x18U, 0x18U, 0x03U, 0x07U, 0xE0U, 0x00U, 0x00U, 0xFFU, 0x00U, 0x0FU, 0x00U, 0x00U, 0x00U, 0xF0U, 0x00U, 0x00U, 0x00U, 0x00U, 0x00U, 0x00U, 0x00U, 0x00U, 0x00U, 0x00U, 0x00U, 0x00U, 0x00U, 0x00U, 0x00U, 0x00U, 0x00U, 0x00U, 0x00U, 0x00U, 0x00U, 0x00U, 0x00U, 0x00U, 0x00U, 0x00U, 0x00U, 0x00U, 0x00U, 0x00U, 0x18U, 0x00U, 0x00U, 0x00U, 0x00U, 0x00U, 0x00U, 0x00U, 0x00U, 0x00U, 0x00U, 0x00U, 0x00U, 0x00U, 0x0CU, 0x00U, 0x00U, 0x00U, 0x00U, 0x00U, 0x00U, 0x00U, 0x00U, 0x00U, 0x00U, 0x00U, 0x00U, 0x00U, 0x00U, 0x0CU, 0x00U, 0x00U, 0x00U, 0x00U, 0x00U, 0x00U, 0x18U, 0x00U, 0x00U, 0x00U, 0x00U, 0x0CU, 0x30U, 0x18U, 0x00U, 0x00U, 0xFFU, 0xC0U, 0x03U, 0x03U, 0xC0U, 0x00U, 0x00U, 0x00U, 0x06U, 0x18U, 0xC3U, 0x00U, 0x00U, 0x60U, 0x00U, 0x18U, 0x0CU, 0x18U, 0x00U, 0x80U, 0x00U, 0x0FU, 0xFFU, 0x00U, 0xFFU, 0x03U, 0xCCU, 0xC0U, 0xCCU, 0x01U, 0xC0U, 0x18U, 0xF0U, 0x00U, 0x18U, 0xFFU, 0x18U, 0x00U, 0x18U, 0x18U, 0x03U, 0x07U, 0xE0U, 0x00U, 0x00U, 0xFFU, 0xFFU, 0x0FU, 0x00U, 0x00U, 0x00U, 0xF0U,
};

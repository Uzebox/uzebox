/*
** Mattel Aquarius character set
*/

const char m40_mattel[2048] __attribute__ ((aligned(256))) PROGMEM = {
 0x38U, 0x22U, 0x22U, 0x26U, 0x00U, 0x3CU, 0x00U, 0x00U, 0x18U, 0x18U, 0xF0U, 0x00U, 0x00U, 0x0FU, 0x00U, 0x3FU, 0xFFU, 0xFEU, 0x3CU, 0x00U, 0x7EU, 0x00U, 0x3EU, 0x00U, 0x3EU, 0x18U, 0x00U, 0xF0U, 0x00U, 0x0FU, 0x0FU, 0x00U, 0x00U, 0x08U, 0x14U, 0x14U, 0x08U, 0x06U, 0x04U, 0x10U, 0x08U, 0x08U, 0x08U, 0x00U, 0x00U, 0x00U, 0x00U, 0x00U, 0x1CU, 0x08U, 0x1CU, 0x3EU, 0x10U, 0x3EU, 0x38U, 0x3EU, 0x1CU, 0x1CU, 0x00U, 0x00U, 0x10U, 0x00U, 0x04U, 0x1CU, 0x1CU, 0x08U, 0x1EU, 0x1CU, 0x1EU, 0x3EU, 0x3EU, 0x3CU, 0x22U, 0x1CU, 0x20U, 0x22U, 0x02U, 0x22U, 0x22U, 0x1CU, 0x1EU, 0x1CU, 0x1EU, 0x1CU, 0x3EU, 0x22U, 0x22U, 0x22U, 0x22U, 0x22U, 0x3EU, 0x3EU, 0x00U, 0x3EU, 0x00U, 0x00U, 0x04U, 0x00U, 0x02U, 0x00U, 0x20U, 0x00U, 0x10U, 0x00U, 0x02U, 0x08U, 0x10U, 0x02U, 0x0CU, 0x00U, 0x00U, 0x00U, 0x00U, 0x00U, 0x00U, 0x00U, 0x08U, 0x00U, 0x00U, 0x00U, 0x00U, 0x00U, 0x00U, 0x30U, 0x08U, 0x06U, 0x00U, 0xFFU, 0x00U, 0x01U, 0x00U, 0x7CU, 0x00U, 0x05U, 0x55U, 0x00U, 0x00U, 0x00U, 0x18U, 0x3CU, 0x00U, 0x7CU, 0x03U, 0x18U, 0x00U, 0x7FU, 0x3CU, 0x3CU, 0x55U, 0x50U, 0x3CU, 0x03U, 0x07U, 0x0FU, 0x0CU, 0x30U, 0x00U, 0x00U, 0xC0U, 0xFFU, 0x00U, 0x0FU, 0xF0U, 0xFFU, 0x00U, 0x0FU, 0xF0U, 0xFFU, 0x00U, 0x0FU, 0xF0U, 0xFFU, 0x00U, 0x0FU, 0xF0U, 0xFFU, 0x00U, 0x0FU, 0xF0U, 0xFFU, 0x00U, 0x0FU, 0xF0U, 0xFFU, 0x00U, 0x0FU, 0xF0U, 0xFFU, 0x00U, 0x0FU, 0xF0U, 0xFFU, 0x80U, 0x01U, 0xFFU, 0x3FU, 0x00U, 0x18U, 0x00U, 0xF0U, 0x18U, 0x00U, 0x80U, 0xC0U, 0x18U, 0x18U, 0x00U, 0x18U, 0x90U, 0x4AU, 0x00U, 0x00U, 0x66U, 0x18U, 0x18U, 0x00U, 0x81U, 0x0FU, 0x01U, 0x03U, 0x00U, 0x18U, 0x00U, 0x18U, 0x00U, 0x0FU, 0xF0U, 0xFFU, 0x00U, 0x0FU, 0xF0U, 0xFFU, 0x00U, 0x0FU, 0xF0U, 0xFFU, 0x00U, 0x0FU, 0xF0U, 0xFFU, 0x00U, 0x0FU, 0xF0U, 0xFFU, 0x00U, 0x0FU, 0xF0U, 0xFFU, 0x00U, 0x0FU, 0xF0U, 0xFFU, 0x00U, 0x0FU, 0xF0U, 0xFFU,
 0x04U, 0x12U, 0x12U, 0x14U, 0x08U, 0x42U, 0x20U, 0x04U, 0x3CU, 0x18U, 0xE0U, 0x20U, 0x04U, 0x07U, 0x3CU, 0x3FU, 0x3CU, 0xFEU, 0x3CU, 0x3CU, 0x3CU, 0x1CU, 0x7CU, 0x1CU, 0xFCU, 0x3CU, 0x00U, 0xF0U, 0x00U, 0x0FU, 0x0FU, 0x00U, 0x00U, 0x08U, 0x14U, 0x14U, 0x3CU, 0x26U, 0x0AU, 0x10U, 0x04U, 0x10U, 0x2AU, 0x08U, 0x00U, 0x00U, 0x00U, 0x20U, 0x22U, 0x0CU, 0x22U, 0x20U, 0x18U, 0x02U, 0x04U, 0x20U, 0x22U, 0x22U, 0x00U, 0x00U, 0x08U, 0x00U, 0x08U, 0x22U, 0x22U, 0x14U, 0x22U, 0x22U, 0x22U, 0x02U, 0x02U, 0x02U, 0x22U, 0x08U, 0x20U, 0x12U, 0x02U, 0x36U, 0x22U, 0x22U, 0x22U, 0x22U, 0x22U, 0x22U, 0x08U, 0x22U, 0x22U, 0x22U, 0x22U, 0x22U, 0x20U, 0x06U, 0x02U, 0x30U, 0x00U, 0x00U, 0x04U, 0x00U, 0x02U, 0x00U, 0x20U, 0x00U, 0x08U, 0x00U, 0x02U, 0x00U, 0x00U, 0x02U, 0x08U, 0x00U, 0x00U, 0x00U, 0x00U, 0x00U, 0x00U, 0x00U, 0x08U, 0x00U, 0x00U, 0x00U, 0x00U, 0x00U, 0x00U, 0x08U, 0x08U, 0x08U, 0x00U, 0xFFU, 0xFFU, 0x01U, 0x38U, 0x3EU, 0x00U, 0x0AU, 0xAAU, 0x18U, 0x00U, 0x00U, 0x18U, 0x18U, 0x38U, 0x3FU, 0x0FU, 0x18U, 0x00U, 0x7FU, 0x4AU, 0x52U, 0xAAU, 0xA0U, 0x7EU, 0x03U, 0x07U, 0x0FU, 0x1CU, 0x38U, 0x66U, 0x18U, 0xF0U, 0xFFU, 0x00U, 0x0FU, 0xF0U, 0xFFU, 0x00U, 0x0FU, 0xF0U, 0xFFU, 0x00U, 0x0FU, 0xF0U, 0xFFU, 0x00U, 0x0FU, 0xF0U, 0xFFU, 0x00U, 0x0FU, 0xF0U, 0xFFU, 0x00U, 0x0FU, 0xF0U, 0xFFU, 0x00U, 0x0FU, 0xF0U, 0xFFU, 0x00U, 0x0FU, 0xF0U, 0xFFU, 0xC0U, 0x03U, 0xFFU, 0x3FU, 0x00U, 0x3CU, 0x00U, 0xF0U, 0x18U, 0x00U, 0x40U, 0xE0U, 0x18U, 0x18U, 0x00U, 0x18U, 0x04U, 0x22U, 0x00U, 0x08U, 0xFFU, 0x3CU, 0x18U, 0x00U, 0x42U, 0x0FU, 0x02U, 0x07U, 0x00U, 0x18U, 0x00U, 0x18U, 0x00U, 0x0FU, 0xF0U, 0xFFU, 0x00U, 0x0FU, 0xF0U, 0xFFU, 0x00U, 0x0FU, 0xF0U, 0xFFU, 0x00U, 0x0FU, 0xF0U, 0xFFU, 0x00U, 0x0FU, 0xF0U, 0xFFU, 0x00U, 0x0FU, 0xF0U, 0xFFU, 0x00U, 0x0FU, 0xF0U, 0xFFU, 0x00U, 0x0FU, 0xF0U, 0xFFU,
 0x04U, 0x0AU, 0x0AU, 0x0AU, 0x00U, 0x99U, 0x40U, 0x02U, 0x5AU, 0x18U, 0xF0U, 0x70U, 0x0EU, 0x0FU, 0x3CU, 0x3CU, 0x3CU, 0x1EU, 0x3CU, 0x3CU, 0x66U, 0x3CU, 0xD8U, 0x3CU, 0xF8U, 0x66U, 0x00U, 0xF0U, 0x00U, 0x0FU, 0x0FU, 0x00U, 0x00U, 0x08U, 0x14U, 0x3EU, 0x0AU, 0x10U, 0x0AU, 0x08U, 0x02U, 0x20U, 0x1CU, 0x08U, 0x00U, 0x00U, 0x00U, 0x10U, 0x32U, 0x08U, 0x20U, 0x10U, 0x14U, 0x1EU, 0x02U, 0x10U, 0x22U, 0x22U, 0x08U, 0x08U, 0x04U, 0x3EU, 0x10U, 0x10U, 0x2AU, 0x22U, 0x22U, 0x02U, 0x22U, 0x02U, 0x02U, 0x02U, 0x22U, 0x08U, 0x20U, 0x0AU, 0x02U, 0x2AU, 0x26U, 0x22U, 0x22U, 0x22U, 0x22U, 0x02U, 0x08U, 0x22U, 0x22U, 0x22U, 0x14U, 0x14U, 0x10U, 0x06U, 0x04U, 0x30U, 0x08U, 0x00U, 0x08U, 0x2CU, 0x1AU, 0x38U, 0x2CU, 0x1CU, 0x08U, 0x2CU, 0x1EU, 0x0CU, 0x10U, 0x12U, 0x08U, 0x36U, 0x1EU, 0x1CU, 0x1AU, 0x2CU, 0x1AU, 0x3CU, 0x3EU, 0x22U, 0x22U, 0x4AU, 0x22U, 0x24U, 0x3EU, 0x08U, 0x08U, 0x08U, 0x20U, 0xFFU, 0xFFU, 0x01U, 0x3CU, 0x1BU, 0x00U, 0x05U, 0x55U, 0x3CU, 0x00U, 0xFFU, 0x3CU, 0xDBU, 0x3CU, 0x1FU, 0x3FU, 0x3CU, 0x00U, 0x7FU, 0x3CU, 0x3CU, 0x55U, 0x50U, 0xFFU, 0x03U, 0x07U, 0x0FU, 0x39U, 0x9CU, 0x7EU, 0xFFU, 0xFCU, 0x7EU, 0x00U, 0x0FU, 0xF0U, 0xFFU, 0x00U, 0x0FU, 0xF0U, 0xFFU, 0x00U, 0x0FU, 0xF0U, 0xFFU, 0x00U, 0x0FU, 0xF0U, 0xFFU, 0x00U, 0x0FU, 0xF0U, 0xFFU, 0x00U, 0x0FU, 0xF0U, 0xFFU, 0x00U, 0x0FU, 0xF0U, 0xFFU, 0x00U, 0x0FU, 0xF0U, 0xFFU, 0xE0U, 0x07U, 0x7EU, 0x3FU, 0x3CU, 0x7EU, 0x00U, 0xE0U, 0x18U, 0x00U, 0x20U, 0xF0U, 0x18U, 0x18U, 0x00U, 0x18U, 0x20U, 0xB4U, 0x00U, 0x34U, 0xFFU, 0x18U, 0x18U, 0x00U, 0x24U, 0x07U, 0x04U, 0x0FU, 0x00U, 0x18U, 0x00U, 0x18U, 0x00U, 0x0FU, 0xF0U, 0xFFU, 0x00U, 0x0FU, 0xF0U, 0xFFU, 0x00U, 0x0FU, 0xF0U, 0xFFU, 0x00U, 0x0FU, 0xF0U, 0xFFU, 0x00U, 0x0FU, 0xF0U, 0xFFU, 0x00U, 0x0FU, 0xF0U, 0xFFU, 0x00U, 0x0FU, 0xF0U, 0xFFU, 0x00U, 0x0FU, 0xF0U, 0xFFU,
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 0x02U, 0x00U, 0x00U, 0x00U, 0x00U, 0x3CU, 0x00U, 0x00U, 0x18U, 0x18U, 0x00U, 0x0FU, 0xF0U, 0x00U, 0xFFU, 0x0CU, 0x00U, 0x18U, 0x3CU, 0xDBU, 0xC3U, 0xFEU, 0x1CU, 0x3BU, 0x00U, 0xDBU, 0xF0U, 0x00U, 0x0FU, 0x00U, 0xF0U, 0xFFU, 0x00U, 0x00U, 0x00U, 0x00U, 0x00U, 0x00U, 0x00U, 0x00U, 0x00U, 0x00U, 0x00U, 0x00U, 0x00U, 0x00U, 0x00U, 0x00U, 0x00U, 0x00U, 0x00U, 0x00U, 0x00U, 0x00U, 0x00U, 0x00U, 0x00U, 0x00U, 0x00U, 0x00U, 0x00U, 0x00U, 0x00U, 0x00U, 0x00U, 0x00U, 0x00U, 0x00U, 0x00U, 0x00U, 0x00U, 0x00U, 0x00U, 0x00U, 0x00U, 0x00U, 0x00U, 0x00U, 0x00U, 0x00U, 0x00U, 0x00U, 0x00U, 0x00U, 0x00U, 0x00U, 0x00U, 0x00U, 0x00U, 0x00U, 0x00U, 0x00U, 0x00U, 0x00U, 0x00U, 0x00U, 0x00U, 0x00U, 0x00U, 0x00U, 0x00U, 0x00U, 0x00U, 0x1CU, 0x00U, 0x00U, 0x0CU, 0x00U, 0x00U, 0x00U, 0x00U, 0x00U, 0x02U, 0x60U, 0x00U, 0x00U, 0x00U, 0x00U, 0x00U, 0x00U, 0x00U, 0x1CU, 0x00U, 0x00U, 0x00U, 0x00U, 0x00U, 0xFFU, 0xFFU, 0x01U, 0x7FU, 0x38U, 0xAAU, 0x0AU, 0xAAU, 0x00U, 0xFFU, 0xFFU, 0x3CU, 0x18U, 0xDCU, 0x00U, 0x03U, 0xFFU, 0xFFU, 0x7FU, 0xBCU, 0x3DU, 0x00U, 0xA0U, 0x3CU, 0x03U, 0x07U, 0x0FU, 0x0CU, 0x30U, 0x00U, 0x00U, 0xC0U, 0x18U, 0x00U, 0x00U, 0x00U, 0x00U, 0x00U, 0x00U, 0x00U, 0x00U, 0x00U, 0x00U, 0x00U, 0x00U, 0x00U, 0x00U, 0x00U, 0x00U, 0x0FU, 0x0FU, 0x0FU, 0x0FU, 0x0FU, 0x0FU, 0x0FU, 0x0FU, 0x0FU, 0x0FU, 0x0FU, 0x0FU, 0x0FU, 0x0FU, 0x0FU, 0x0FU, 0xFFU, 0xFFU, 0x00U, 0x3FU, 0x00U, 0x18U, 0x00U, 0x00U, 0x18U, 0x0FU, 0x01U, 0xC0U, 0x00U, 0x18U, 0x18U, 0x00U, 0x40U, 0x52U, 0xFFU, 0x00U, 0x18U, 0x3CU, 0x18U, 0xF8U, 0x81U, 0x00U, 0x80U, 0x03U, 0x18U, 0x18U, 0x18U, 0x00U, 0xF0U, 0xF0U, 0xF0U, 0xF0U, 0xF0U, 0xF0U, 0xF0U, 0xF0U, 0xF0U, 0xF0U, 0xF0U, 0xF0U, 0xF0U, 0xF0U, 0xF0U, 0xF0U, 0xFFU, 0xFFU, 0xFFU, 0xFFU, 0xFFU, 0xFFU, 0xFFU, 0xFFU, 0xFFU, 0xFFU, 0xFFU, 0xFFU, 0xFFU, 0xFFU, 0xFFU, 0xFFU,
};

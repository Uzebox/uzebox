/*
** Commodore 64 PETSCII Graphics font
*/

const char m40_c64_graphics[2048] __attribute__ ((aligned(256))) PROGMEM = {
 0x3CU, 0x18U, 0x3EU, 0x3CU, 0x1EU, 0x7EU, 0x7EU, 0x3CU, 0x66U, 0x3CU, 0x78U, 0x66U, 0x06U, 0xC6U, 0x66U, 0x3CU, 0x3EU, 0x3CU, 0x3EU, 0x3CU, 0x7EU, 0x66U, 0x66U, 0xC6U, 0x66U, 0x66U, 0x7EU, 0x3CU, 0x30U, 0x3CU, 0x00U, 0x00U, 0x00U, 0x18U, 0x66U, 0x66U, 0x18U, 0x46U, 0x3CU, 0x60U, 0x30U, 0x0CU, 0x00U, 0x00U, 0x00U, 0x00U, 0x00U, 0x00U, 0x3CU, 0x18U, 0x3CU, 0x3CU, 0x60U, 0x7EU, 0x3CU, 0x7EU, 0x3CU, 0x3CU, 0x00U, 0x00U, 0x70U, 0x00U, 0x0EU, 0x3CU, 0x00U, 0x10U, 0x18U, 0x00U, 0x00U, 0x00U, 0x00U, 0x0CU, 0x30U, 0x00U, 0x18U, 0x18U, 0x03U, 0x03U, 0xC0U, 0xFFU, 0xFFU, 0x00U, 0x00U, 0x6CU, 0x06U, 0x00U, 0xC3U, 0x00U, 0x18U, 0x60U, 0x10U, 0x18U, 0x03U, 0x18U, 0x00U, 0xFFU, 0x00U, 0x0FU, 0x00U, 0xFFU, 0x00U, 0x03U, 0x33U, 0xC0U, 0x00U, 0xFFU, 0xC0U, 0x18U, 0x00U, 0x18U, 0x00U, 0x00U, 0x00U, 0x18U, 0x00U, 0x18U, 0x03U, 0x07U, 0xE0U, 0xFFU, 0xFFU, 0x00U, 0xC0U, 0x00U, 0xF0U, 0x18U, 0x0FU, 0x0FU, 0xC3U, 0xE7U, 0xC1U, 0xC3U, 0xE1U, 0x81U, 0x81U, 0xC3U, 0x99U, 0xC3U, 0x87U, 0x99U, 0xF9U, 0x39U, 0x99U, 0xC3U, 0xC1U, 0xC3U, 0xC1U, 0xC3U, 0x81U, 0x99U, 0x99U, 0x39U, 0x99U, 0x99U, 0x81U, 0xC3U, 0xCFU, 0xC3U, 0xFFU, 0xFFU, 0xFFU, 0xE7U, 0x99U, 0x99U, 0xE7U, 0xB9U, 0xC3U, 0x9FU, 0xCFU, 0xF3U, 0xFFU, 0xFFU, 0xFFU, 0xFFU, 0xFFU, 0xFFU, 0xC3U, 0xE7U, 0xC3U, 0xC3U, 0x9FU, 0x81U, 0xC3U, 0x81U, 0xC3U, 0xC3U, 0xFFU, 0xFFU, 0x8FU, 0xFFU, 0xF1U, 0xC3U, 0xFFU, 0xEFU, 0xE7U, 0xFFU, 0xFFU, 0xFFU, 0xFFU, 0xF3U, 0xCFU, 0xFFU, 0xE7U, 0xE7U, 0xFCU, 0xFCU, 0x3FU, 0x00U, 0x00U, 0xFFU, 0xFFU, 0x93U, 0xF9U, 0xFFU, 0x3CU, 0xFFU, 0xE7U, 0x9FU, 0xEFU, 0xE7U, 0xFCU, 0xE7U, 0xFFU, 0x00U, 0xFFU, 0xF0U, 0xFFU, 0x00U, 0xFFU, 0xFCU, 0xCCU, 0x3FU, 0xFFU, 0x00U, 0x3FU, 0xE7U, 0xFFU, 0xE7U, 0xFFU, 0xFFU, 0xFFU, 0xE7U, 0xFFU, 0xE7U, 0xFCU, 0xF8U, 0x1FU, 0x00U, 0x00U, 0xFFU, 0x3FU, 0xFFU, 0x0FU, 0xE7U, 0xF0U, 0xF0U,
 0x66U, 0x3CU, 0x66U, 0x66U, 0x36U, 0x06U, 0x06U, 0x66U, 0x66U, 0x18U, 0x30U, 0x36U, 0x06U, 0xEEU, 0x6EU, 0x66U, 0x66U, 0x66U, 0x66U, 0x66U, 0x18U, 0x66U, 0x66U, 0xC6U, 0x66U, 0x66U, 0x60U, 0x0CU, 0x48U, 0x30U, 0x18U, 0x08U, 0x00U, 0x18U, 0x66U, 0x66U, 0x7CU, 0x66U, 0x66U, 0x30U, 0x18U, 0x18U, 0x66U, 0x18U, 0x00U, 0x00U, 0x00U, 0xC0U, 0x66U, 0x18U, 0x66U, 0x66U, 0x70U, 0x06U, 0x66U, 0x66U, 0x66U, 0x66U, 0x00U, 0x00U, 0x18U, 0x00U, 0x18U, 0x66U, 0x00U, 0x38U, 0x18U, 0x00U, 0x00U, 0xFFU, 0x00U, 0x0CU, 0x30U, 0x00U, 0x18U, 0x18U, 0x03U, 0x07U, 0xE0U, 0xFFU, 0xFFU, 0x3CU, 0x00U, 0xFEU, 0x06U, 0x00U, 0xE7U, 0x3CU, 0x18U, 0x60U, 0x38U, 0x18U, 0x03U, 0x18U, 0x00U, 0xFEU, 0x00U, 0x0FU, 0x00U, 0x00U, 0x00U, 0x03U, 0x33U, 0xC0U, 0x00U, 0x7FU, 0xC0U, 0x18U, 0x00U, 0x18U, 0x00U, 0x00U, 0x00U, 0x18U, 0x00U, 0x18U, 0x03U, 0x07U, 0xE0U, 0xFFU, 0xFFU, 0x00U, 0xC0U, 0x00U, 0xF0U, 0x18U, 0x0FU, 0x0FU, 0x99U, 0xC3U, 0x99U, 0x99U, 0xC9U, 0xF9U, 0xF9U, 0x99U, 0x99U, 0xE7U, 0xCFU, 0xC9U, 0xF9U, 0x11U, 0x91U, 0x99U, 0x99U, 0x99U, 0x99U, 0x99U, 0xE7U, 0x99U, 0x99U, 0x39U, 0x99U, 0x99U, 0x9FU, 0xF3U, 0xB7U, 0xCFU, 0xE7U, 0xF7U, 0xFFU, 0xE7U, 0x99U, 0x99U, 0x83U, 0x99U, 0x99U, 0xCFU, 0xE7U, 0xE7U, 0x99U, 0xE7U, 0xFFU, 0xFFU, 0xFFU, 0x3FU, 0x99U, 0xE7U, 0x99U, 0x99U, 0x8FU, 0xF9U, 0x99U, 0x99U, 0x99U, 0x99U, 0xFFU, 0xFFU, 0xE7U, 0xFFU, 0xE7U, 0x99U, 0xFFU, 0xC7U, 0xE7U, 0xFFU, 0xFFU, 0x00U, 0xFFU, 0xF3U, 0xCFU, 0xFFU, 0xE7U, 0xE7U, 0xFCU, 0xF8U, 0x1FU, 0x00U, 0x00U, 0xC3U, 0xFFU, 0x01U, 0xF9U, 0xFFU, 0x18U, 0xC3U, 0xE7U, 0x9FU, 0xC7U, 0xE7U, 0xFCU, 0xE7U, 0xFFU, 0x01U, 0xFFU, 0xF0U, 0xFFU, 0xFFU, 0xFFU, 0xFCU, 0xCCU, 0x3FU, 0xFFU, 0x80U, 0x3FU, 0xE7U, 0xFFU, 0xE7U, 0xFFU, 0xFFU, 0xFFU, 0xE7U, 0xFFU, 0xE7U, 0xFCU, 0xF8U, 0x1FU, 0x00U, 0x00U, 0xFFU, 0x3FU, 0xFFU, 0x0FU, 0xE7U, 0xF0U, 0xF0U,
 0x76U, 0x66U, 0x66U, 0x06U, 0x66U, 0x06U, 0x06U, 0x06U, 0x66U, 0x18U, 0x30U, 0x1EU, 0x06U, 0xFEU, 0x7EU, 0x66U, 0x66U, 0x66U, 0x66U, 0x06U, 0x18U, 0x66U, 0x66U, 0xC6U, 0x3CU, 0x66U, 0x30U, 0x0CU, 0x0CU, 0x30U, 0x3CU, 0x0CU, 0x00U, 0x18U, 0x66U, 0xFFU, 0x06U, 0x30U, 0x3CU, 0x18U, 0x0CU, 0x30U, 0x3CU, 0x18U, 0x00U, 0x00U, 0x00U, 0x60U, 0x76U, 0x1CU, 0x60U, 0x60U, 0x78U, 0x3EU, 0x06U, 0x30U, 0x66U, 0x66U, 0x18U, 0x18U, 0x0CU, 0x7EU, 0x30U, 0x60U, 0x00U, 0x7CU, 0x18U, 0x00U, 0xFFU, 0xFFU, 0x00U, 0x0CU, 0x30U, 0x00U, 0x38U, 0x1CU, 0x03U, 0x0EU, 0x70U, 0x03U, 0xC0U, 0x7EU, 0x00U, 0xFEU, 0x06U, 0x00U, 0x7EU, 0x7EU, 0x66U, 0x60U, 0x7CU, 0x18U, 0x0CU, 0x18U, 0xC0U, 0xFCU, 0x00U, 0x0FU, 0x00U, 0x00U, 0x00U, 0x03U, 0xCCU, 0xC0U, 0x00U, 0x3FU, 0xC0U, 0x18U, 0x00U, 0x18U, 0x00U, 0x00U, 0x00U, 0x18U, 0x00U, 0x18U, 0x03U, 0x07U, 0xE0U, 0x00U, 0xFFU, 0x00U, 0xC0U, 0x00U, 0xF0U, 0x18U, 0x0FU, 0x0FU, 0x89U, 0x99U, 0x99U, 0xF9U, 0x99U, 0xF9U, 0xF9U, 0xF9U, 0x99U, 0xE7U, 0xCFU, 0xE1U, 0xF9U, 0x01U, 0x81U, 0x99U, 0x99U, 0x99U, 0x99U, 0xF9U, 0xE7U, 0x99U, 0x99U, 0x39U, 0xC3U, 0x99U, 0xCFU, 0xF3U, 0xF3U, 0xCFU, 0xC3U, 0xF3U, 0xFFU, 0xE7U, 0x99U, 0x00U, 0xF9U, 0xCFU, 0xC3U, 0xE7U, 0xF3U, 0xCFU, 0xC3U, 0xE7U, 0xFFU, 0xFFU, 0xFFU, 0x9FU, 0x89U, 0xE3U, 0x9FU, 0x9FU, 0x87U, 0xC1U, 0xF9U, 0xCFU, 0x99U, 0x99U, 0xE7U, 0xE7U, 0xF3U, 0x81U, 0xCFU, 0x9FU, 0xFFU, 0x83U, 0xE7U, 0xFFU, 0x00U, 0x00U, 0xFFU, 0xF3U, 0xCFU, 0xFFU, 0xC7U, 0xE3U, 0xFCU, 0xF1U, 0x8FU, 0xFCU, 0x3FU, 0x81U, 0xFFU, 0x01U, 0xF9U, 0xFFU, 0x81U, 0x81U, 0x99U, 0x9FU, 0x83U, 0xE7U, 0xF3U, 0xE7U, 0x3FU, 0x03U, 0xFFU, 0xF0U, 0xFFU, 0xFFU, 0xFFU, 0xFCU, 0x33U, 0x3FU, 0xFFU, 0xC0U, 0x3FU, 0xE7U, 0xFFU, 0xE7U, 0xFFU, 0xFFU, 0xFFU, 0xE7U, 0xFFU, 0xE7U, 0xFCU, 0xF8U, 0x1FU, 0xFFU, 0x00U, 0xFFU, 0x3FU, 0xFFU, 0x0FU, 0xE7U, 0xF0U, 0xF0U,
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 0x00U, 0x00U, 0x00U, 0x00U, 0x00U, 0x00U, 0x00U, 0x00U, 0x00U, 0x00U, 0x00U, 0x00U, 0x00U, 0x00U, 0x00U, 0x00U, 0x00U, 0x00U, 0x00U, 0x00U, 0x00U, 0x00U, 0x00U, 0x00U, 0x00U, 0x00U, 0x00U, 0x00U, 0x00U, 0x00U, 0x18U, 0x00U, 0x00U, 0x00U, 0x00U, 0x00U, 0x00U, 0x00U, 0x00U, 0x00U, 0x00U, 0x00U, 0x00U, 0x00U, 0x0CU, 0x00U, 0x00U, 0x00U, 0x00U, 0x00U, 0x00U, 0x00U, 0x00U, 0x00U, 0x00U, 0x00U, 0x00U, 0x00U, 0x00U, 0x0CU, 0x00U, 0x00U, 0x00U, 0x00U, 0x00U, 0x00U, 0x18U, 0x00U, 0x00U, 0x00U, 0x00U, 0x0CU, 0x30U, 0x18U, 0x00U, 0x00U, 0xFFU, 0xC0U, 0x03U, 0x03U, 0xC0U, 0x00U, 0x00U, 0x00U, 0x06U, 0x18U, 0xC3U, 0x00U, 0x00U, 0x60U, 0x00U, 0x18U, 0x0CU, 0x18U, 0x00U, 0x80U, 0x00U, 0x0FU, 0xFFU, 0x00U, 0xFFU, 0x03U, 0xCCU, 0xC0U, 0xCCU, 0x01U, 0xC0U, 0x18U, 0xF0U, 0x00U, 0x18U, 0xFFU, 0x18U, 0x00U, 0x18U, 0x18U, 0x03U, 0x07U, 0xE0U, 0x00U, 0x00U, 0xFFU, 0xFFU, 0x0FU, 0x00U, 0x00U, 0x00U, 0xF0U, 0xFFU, 0xFFU, 0xFFU, 0xFFU, 0xFFU, 0xFFU, 0xFFU, 0xFFU, 0xFFU, 0xFFU, 0xFFU, 0xFFU, 0xFFU, 0xFFU, 0xFFU, 0xFFU, 0xFFU, 0xFFU, 0xFFU, 0xFFU, 0xFFU, 0xFFU, 0xFFU, 0xFFU, 0xFFU, 0xFFU, 0xFFU, 0xFFU, 0xFFU, 0xFFU, 0xE7U, 0xFFU, 0xFFU, 0xFFU, 0xFFU, 0xFFU, 0xFFU, 0xFFU, 0xFFU, 0xFFU, 0xFFU, 0xFFU, 0xFFU, 0xFFU, 0xF3U, 0xFFU, 0xFFU, 0xFFU, 0xFFU, 0xFFU, 0xFFU, 0xFFU, 0xFFU, 0xFFU, 0xFFU, 0xFFU, 0xFFU, 0xFFU, 0xFFU, 0xF3U, 0xFFU, 0xFFU, 0xFFU, 0xFFU, 0xFFU, 0xFFU, 0xE7U, 0xFFU, 0xFFU, 0xFFU, 0xFFU, 0xF3U, 0xCFU, 0xE7U, 0xFFU, 0xFFU, 0x00U, 0x3FU, 0xFCU, 0xFCU, 0x3FU, 0xFFU, 0xFFU, 0xFFU, 0xF9U, 0xE7U, 0x3CU, 0xFFU, 0xFFU, 0x9FU, 0xFFU, 0xE7U, 0xF3U, 0xE7U, 0xFFU, 0x7FU, 0xFFU, 0xF0U, 0x00U, 0xFFU, 0x00U, 0xFCU, 0x33U, 0x3FU, 0x33U, 0xFEU, 0x3FU, 0xE7U, 0x0FU, 0xFFU, 0xE7U, 0x00U, 0xE7U, 0xFFU, 0xE7U, 0xE7U, 0xFCU, 0xF8U, 0x1FU, 0xFFU, 0xFFU, 0x00U, 0x00U, 0xF0U, 0xFFU, 0xFFU, 0xFFU, 0x0FU,
};

/*
** IBM ASCII font
*/

const char m40_ibm_ascii[2048] __attribute__ ((aligned(256))) PROGMEM = {
 0x00U, 0x7EU, 0x7EU, 0x36U, 0x08U, 0x1CU, 0x08U, 0x00U, 0xFFU, 0x00U, 0xFFU, 0xF0U, 0x3CU, 0xFCU, 0xFEU, 0x18U, 0x01U, 0x40U, 0x18U, 0x66U, 0xFEU, 0x7CU, 0x00U, 0x18U, 0x18U, 0x18U, 0x00U, 0x00U, 0x00U, 0x00U, 0x00U, 0x00U, 0x00U, 0x0CU, 0x36U, 0x36U, 0x0CU, 0x00U, 0x1CU, 0x06U, 0x18U, 0x06U, 0x00U, 0x00U, 0x00U, 0x00U, 0x00U, 0x60U, 0x3EU, 0x0CU, 0x1EU, 0x1EU, 0x38U, 0x3FU, 0x1CU, 0x3FU, 0x1EU, 0x1EU, 0x00U, 0x00U, 0x18U, 0x00U, 0x06U, 0x1EU, 0x3EU, 0x0CU, 0x3FU, 0x3CU, 0x1FU, 0x7FU, 0x7FU, 0x3CU, 0x33U, 0x1EU, 0x78U, 0x67U, 0x0FU, 0x63U, 0x63U, 0x1CU, 0x3FU, 0x1EU, 0x3FU, 0x1EU, 0x3FU, 0x33U, 0x33U, 0x63U, 0x63U, 0x33U, 0x7FU, 0x1EU, 0x03U, 0x1EU, 0x08U, 0x00U, 0x0CU, 0x00U, 0x07U, 0x00U, 0x38U, 0x00U, 0x1CU, 0x00U, 0x07U, 0x0CU, 0x30U, 0x07U, 0x0EU, 0x00U, 0x00U, 0x00U, 0x00U, 0x00U, 0x00U, 0x00U, 0x08U, 0x00U, 0x00U, 0x00U, 0x00U, 0x00U, 0x00U, 0x38U, 0x18U, 0x07U, 0x6EU, 0x00U, 0x1EU, 0x00U, 0x38U, 0x7EU, 0x33U, 0x07U, 0x0CU, 0x00U, 0x7EU, 0x33U, 0x07U, 0x33U, 0x3EU, 0x07U, 0x63U, 0x0CU, 0x38U, 0x00U, 0x7CU, 0x1EU, 0x00U, 0x00U, 0x1EU, 0x00U, 0x00U, 0xC3U, 0x33U, 0x18U, 0x1CU, 0x33U, 0x1FU, 0x70U, 0x38U, 0x1CU, 0x00U, 0x00U, 0x00U, 0x3FU, 0x3CU, 0x1CU, 0x0CU, 0x00U, 0x00U, 0xC3U, 0xC3U, 0x18U, 0x00U, 0x00U, 0x44U, 0xAAU, 0xDBU, 0x18U, 0x18U, 0x18U, 0x6CU, 0x00U, 0x00U, 0x6CU, 0x6CU, 0x00U, 0x6CU, 0x6CU, 0x18U, 0x00U, 0x18U, 0x18U, 0x00U, 0x18U, 0x00U, 0x18U, 0x18U, 0x6CU, 0x6CU, 0x00U, 0x6CU, 0x00U, 0x6CU, 0x00U, 0x6CU, 0x18U, 0x6CU, 0x00U, 0x00U, 0x6CU, 0x18U, 0x00U, 0x00U, 0x6CU, 0x18U, 0x18U, 0x00U, 0xFFU, 0x00U, 0x0FU, 0xF0U, 0xFFU, 0x00U, 0x00U, 0x00U, 0x00U, 0x3FU, 0x00U, 0x00U, 0x00U, 0x3FU, 0x1CU, 0x1CU, 0x38U, 0x00U, 0x60U, 0x1CU, 0x1EU, 0x00U, 0x0CU, 0x06U, 0x18U, 0x70U, 0x18U, 0x0CU, 0x00U, 0x1CU, 0x00U, 0x00U, 0xF0U, 0x1EU, 0x0EU, 0x00U, 0x00U,
 0x00U, 0x81U, 0xFFU, 0x7FU, 0x1CU, 0x3EU, 0x08U, 0x00U, 0xFFU, 0x3CU, 0xC3U, 0xE0U, 0x66U, 0xCCU, 0xC6U, 0xDBU, 0x07U, 0x70U, 0x3CU, 0x66U, 0xDBU, 0xC6U, 0x00U, 0x3CU, 0x3CU, 0x18U, 0x18U, 0x0CU, 0x00U, 0x24U, 0x18U, 0xFFU, 0x00U, 0x1EU, 0x36U, 0x36U, 0x3EU, 0x63U, 0x36U, 0x06U, 0x0CU, 0x0CU, 0x66U, 0x0CU, 0x00U, 0x00U, 0x00U, 0x30U, 0x63U, 0x0EU, 0x33U, 0x33U, 0x3CU, 0x03U, 0x06U, 0x33U, 0x33U, 0x33U, 0x0CU, 0x0CU, 0x0CU, 0x00U, 0x0CU, 0x33U, 0x63U, 0x1EU, 0x66U, 0x66U, 0x36U, 0x46U, 0x46U, 0x66U, 0x33U, 0x0CU, 0x30U, 0x66U, 0x06U, 0x77U, 0x67U, 0x36U, 0x66U, 0x33U, 0x66U, 0x33U, 0x2DU, 0x33U, 0x33U, 0x63U, 0x63U, 0x33U, 0x63U, 0x06U, 0x06U, 0x18U, 0x1CU, 0x00U, 0x0CU, 0x00U, 0x06U, 0x00U, 0x30U, 0x00U, 0x36U, 0x00U, 0x06U, 0x00U, 0x00U, 0x06U, 0x0CU, 0x00U, 0x00U, 0x00U, 0x00U, 0x00U, 0x00U, 0x00U, 0x0CU, 0x00U, 0x00U, 0x00U, 0x00U, 0x00U, 0x00U, 0x0CU, 0x18U, 0x0CU, 0x3BU, 0x08U, 0x33U, 0x33U, 0x00U, 0xC3U, 0x00U, 0x00U, 0x0CU, 0x00U, 0xC3U, 0x00U, 0x00U, 0x00U, 0x63U, 0x00U, 0x1CU, 0x0CU, 0x00U, 0x00U, 0x36U, 0x33U, 0x33U, 0x07U, 0x33U, 0x07U, 0x33U, 0x18U, 0x00U, 0x18U, 0x36U, 0x33U, 0x33U, 0xD8U, 0x00U, 0x00U, 0x38U, 0x38U, 0x1FU, 0x00U, 0x36U, 0x36U, 0x00U, 0x00U, 0x00U, 0x63U, 0x63U, 0x18U, 0xCCU, 0x33U, 0x11U, 0x55U, 0xEEU, 0x18U, 0x18U, 0x18U, 0x6CU, 0x00U, 0x00U, 0x6CU, 0x6CU, 0x00U, 0x6CU, 0x6CU, 0x18U, 0x00U, 0x18U, 0x18U, 0x00U, 0x18U, 0x00U, 0x18U, 0x18U, 0x6CU, 0x6CU, 0x00U, 0x6CU, 0x00U, 0x6CU, 0x00U, 0x6CU, 0x18U, 0x6CU, 0x00U, 0x00U, 0x6CU, 0x18U, 0x00U, 0x00U, 0x6CU, 0x18U, 0x18U, 0x00U, 0xFFU, 0x00U, 0x0FU, 0xF0U, 0xFFU, 0x00U, 0x1EU, 0x3FU, 0x7FU, 0x33U, 0x00U, 0x66U, 0x6EU, 0x0CU, 0x36U, 0x36U, 0x0CU, 0x00U, 0x30U, 0x06U, 0x33U, 0x3FU, 0x0CU, 0x0CU, 0x0CU, 0xD8U, 0x18U, 0x0CU, 0x6EU, 0x36U, 0x00U, 0x00U, 0x30U, 0x36U, 0x18U, 0x00U, 0x00U,
 0x00U, 0xA5U, 0xDBU, 0x7FU, 0x3EU, 0x1CU, 0x1CU, 0x18U, 0xE7U, 0x66U, 0x99U, 0xF0U, 0x66U, 0xFCU, 0xFEU, 0x3CU, 0x1FU, 0x7CU, 0x7EU, 0x66U, 0xDBU, 0x1CU, 0x00U, 0x7EU, 0x7EU, 0x18U, 0x30U, 0x06U, 0x03U, 0x66U, 0x3CU, 0xFFU, 0x00U, 0x1EU, 0x36U, 0x7FU, 0x03U, 0x33U, 0x1CU, 0x03U, 0x06U, 0x18U, 0x3CU, 0x0CU, 0x00U, 0x00U, 0x00U, 0x18U, 0x73U, 0x0CU, 0x30U, 0x30U, 0x36U, 0x1FU, 0x03U, 0x30U, 0x33U, 0x33U, 0x0CU, 0x0CU, 0x06U, 0x3FU, 0x18U, 0x30U, 0x7BU, 0x33U, 0x66U, 0x03U, 0x66U, 0x16U, 0x16U, 0x03U, 0x33U, 0x0CU, 0x30U, 0x36U, 0x06U, 0x7FU, 0x6FU, 0x63U, 0x66U, 0x33U, 0x66U, 0x06U, 0x0CU, 0x33U, 0x33U, 0x63U, 0x36U, 0x33U, 0x31U, 0x06U, 0x0CU, 0x18U, 0x36U, 0x00U, 0x18U, 0x1EU, 0x06U, 0x1EU, 0x30U, 0x1EU, 0x06U, 0x6EU, 0x36U, 0x0EU, 0x30U, 0x66U, 0x0CU, 0x33U, 0x1FU, 0x1EU, 0x3BU, 0x6EU, 0x3BU, 0x3EU, 0x3EU, 0x33U, 0x33U, 0x63U, 0x63U, 0x33U, 0x3FU, 0x0CU, 0x18U, 0x0CU, 0x00U, 0x1CU, 0x03U, 0x00U, 0x1EU, 0x3CU, 0x1EU, 0x1EU, 0x1EU, 0x1EU, 0x3CU, 0x1EU, 0x1EU, 0x0EU, 0x1CU, 0x0EU, 0x36U, 0x00U, 0x3FU, 0xFEU, 0x33U, 0x00U, 0x00U, 0x00U, 0x00U, 0x00U, 0x00U, 0x3CU, 0x33U, 0x7EU, 0x26U, 0x1EU, 0x33U, 0x18U, 0x1EU, 0x0EU, 0x00U, 0x00U, 0x00U, 0x33U, 0x36U, 0x36U, 0x0CU, 0x00U, 0x00U, 0x33U, 0x33U, 0x00U, 0x66U, 0x66U, 0x44U, 0xAAU, 0xDBU, 0x18U, 0x18U, 0x1FU, 0x6CU, 0x00U, 0x1FU, 0x6FU, 0x6CU, 0x7FU, 0x6FU, 0x6CU, 0x1FU, 0x00U, 0x18U, 0x18U, 0x00U, 0x18U, 0x00U, 0x18U, 0xF8U, 0x6CU, 0xECU, 0xFCU, 0xEFU, 0xFFU, 0xECU, 0xFFU, 0xEFU, 0xFFU, 0x6CU, 0xFFU, 0x00U, 0x6CU, 0xF8U, 0xF8U, 0x00U, 0x6CU, 0xFFU, 0x18U, 0x00U, 0xFFU, 0x00U, 0x0FU, 0xF0U, 0xFFU, 0x6EU, 0x33U, 0x33U, 0x36U, 0x06U, 0x7EU, 0x66U, 0x3BU, 0x1EU, 0x63U, 0x63U, 0x18U, 0x7EU, 0x7EU, 0x03U, 0x33U, 0x00U, 0x3FU, 0x18U, 0x06U, 0xD8U, 0x18U, 0x00U, 0x3BU, 0x36U, 0x00U, 0x00U, 0x30U, 0x36U, 0x0CU, 0x3CU, 0x00U,
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 0x00U, 0x7EU, 0x7EU, 0x00U, 0x00U, 0x1CU, 0x1CU, 0x00U, 0xFFU, 0x00U, 0xFFU, 0x1EU, 0x18U, 0x07U, 0x03U, 0x18U, 0x00U, 0x00U, 0x18U, 0x00U, 0x00U, 0x1EU, 0x00U, 0xFFU, 0x00U, 0x00U, 0x00U, 0x00U, 0x00U, 0x00U, 0x00U, 0x00U, 0x00U, 0x00U, 0x00U, 0x00U, 0x00U, 0x00U, 0x00U, 0x00U, 0x00U, 0x00U, 0x00U, 0x00U, 0x06U, 0x00U, 0x00U, 0x00U, 0x00U, 0x00U, 0x00U, 0x00U, 0x00U, 0x00U, 0x00U, 0x00U, 0x00U, 0x00U, 0x00U, 0x06U, 0x00U, 0x00U, 0x00U, 0x00U, 0x00U, 0x00U, 0x00U, 0x00U, 0x00U, 0x00U, 0x00U, 0x00U, 0x00U, 0x00U, 0x00U, 0x00U, 0x00U, 0x00U, 0x00U, 0x00U, 0x00U, 0x00U, 0x00U, 0x00U, 0x00U, 0x00U, 0x00U, 0x00U, 0x00U, 0x00U, 0x00U, 0x00U, 0x00U, 0x00U, 0x00U, 0xFFU, 0x00U, 0x00U, 0x00U, 0x00U, 0x00U, 0x00U, 0x00U, 0x1FU, 0x00U, 0x00U, 0x1EU, 0x00U, 0x00U, 0x00U, 0x00U, 0x00U, 0x0FU, 0x78U, 0x00U, 0x00U, 0x00U, 0x00U, 0x00U, 0x00U, 0x00U, 0x1FU, 0x00U, 0x00U, 0x00U, 0x00U, 0x00U, 0x00U, 0x1EU, 0x00U, 0x00U, 0x00U, 0x00U, 0x00U, 0x00U, 0x1CU, 0x00U, 0x00U, 0x00U, 0x00U, 0x00U, 0x00U, 0x00U, 0x00U, 0x00U, 0x00U, 0x00U, 0x00U, 0x00U, 0x00U, 0x00U, 0x00U, 0x1FU, 0x00U, 0x00U, 0x18U, 0x00U, 0x0CU, 0xE3U, 0x0EU, 0x00U, 0x00U, 0x00U, 0x00U, 0x00U, 0x00U, 0x00U, 0x00U, 0x00U, 0x00U, 0x00U, 0xF0U, 0xC0U, 0x00U, 0x00U, 0x00U, 0x11U, 0x55U, 0x77U, 0x18U, 0x18U, 0x18U, 0x6CU, 0x6CU, 0x18U, 0x6CU, 0x6CU, 0x6CU, 0x00U, 0x00U, 0x00U, 0x18U, 0x00U, 0x00U, 0x18U, 0x18U, 0x00U, 0x18U, 0x18U, 0x6CU, 0x00U, 0x6CU, 0x00U, 0x6CU, 0x6CU, 0x00U, 0x6CU, 0x00U, 0x00U, 0x18U, 0x6CU, 0x00U, 0x00U, 0x18U, 0x6CU, 0x6CU, 0x18U, 0x00U, 0x18U, 0xFFU, 0xFFU, 0x0FU, 0xF0U, 0x00U, 0x00U, 0x03U, 0x00U, 0x00U, 0x00U, 0x00U, 0x03U, 0x00U, 0x3FU, 0x00U, 0x00U, 0x00U, 0x00U, 0x03U, 0x00U, 0x00U, 0x00U, 0x00U, 0x00U, 0x00U, 0x18U, 0x0EU, 0x00U, 0x00U, 0x00U, 0x00U, 0x00U, 0x38U, 0x00U, 0x00U, 0x00U, 0x00U,
};

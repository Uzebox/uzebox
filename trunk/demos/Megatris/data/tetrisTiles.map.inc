#define MAP_MAIN_WIDTH 40
#define MAP_MAIN_HEIGHT 28
const u16 map_main[] PROGMEM ={
40,28
,0x001d,0x00ad,0x00ae,0x00ae,0x00ae,0x00ae,0x00af,0x001c,0x001d,0x001d,0x0018,0x001d,0x001d,0x001a,0x001d,0x001d,0x001c,0x001d,0x001d,0x001d
,0x00b0,0x001a,0x001d,0x001c,0x001d,0x001d,0x001d,0x001d,0x001d,0x001d,0x001d,0x001d,0x001a,0x00ad,0x00ae,0x00ae,0x00ae,0x00ae,0x00af,0x001a
,0x001d,0x00b1,0x0000,0x0000,0x0000,0x0022,0x00b2,0x001d,0x0016,0x001d,0x001d,0x001d,0x001d,0x001d,0x001d,0x00b3,0x00b4,0x001d,0x0018,0x00b5
,0x00b6,0x001d,0x001d,0x001d,0x0016,0x001d,0x001d,0x001c,0x001d,0x001d,0x0016,0x001d,0x001d,0x00b1,0x0000,0x0000,0x0000,0x001e,0x00b2,0x001d
,0x0016,0x00b1,0x0000,0x001e,0x0000,0x0000,0x00b2,0x001d,0x001d,0x001d,0x001d,0x001a,0x001d,0x001d,0x0018,0x00b7,0x00b8,0x00b9,0x001d,0x001d
,0x00ba,0x001d,0x001d,0x001c,0x001d,0x001d,0x0018,0x001d,0x001a,0x001d,0x001d,0x001d,0x001c,0x00b1,0x001e,0x0000,0x0020,0x0000,0x00b2,0x001d
,0x001d,0x00b1,0x0000,0x0000,0x0024,0x0000,0x00b2,0x001d,0x001d,0x0018,0x001d,0x001d,0x001d,0x0016,0x001d,0x001d,0x001a,0x001d,0x00bb,0x00bc
,0x00bd,0x00be,0x0018,0x001d,0x001d,0x001d,0x001d,0x001d,0x001d,0x001d,0x0018,0x001d,0x001d,0x00b1,0x0000,0x0000,0x0022,0x0024,0x00b2,0x001d
,0x001c,0x00bf,0x00c0,0x00c1,0x00c2,0x00c3,0x00c4,0x001d,0x001d,0x001d,0x001d,0x0018,0x001d,0x001d,0x001d,0x001d,0x00c5,0x001d,0x00c6,0x00c7
,0x00c8,0x00c9,0x001c,0x00ca,0x001d,0x001d,0x001d,0x0016,0x001d,0x001d,0x001d,0x001d,0x0016,0x00bf,0x00cb,0x00c1,0x00c2,0x00c3,0x00cc,0x001d
,0x001d,0x00ad,0x00cd,0x00ce,0x00cf,0x00d0,0x00d1,0x00d2,0x00d3,0x00d4,0x00cd,0x00cd,0x00d5,0x001d,0x001a,0x001d,0x00d6,0x00d7,0x00d8,0x00d9
,0x00da,0x00db,0x001d,0x00dc,0x001d,0x001a,0x001d,0x00ad,0x00cd,0x00ce,0x00cf,0x00d0,0x00d1,0x00d2,0x00d3,0x00dd,0x00cd,0x00cd,0x00d5,0x001c
,0x001d,0x00de,0x00df,0x00e0,0x00df,0x00df,0x00df,0x00df,0x00df,0x00df,0x00e1,0x00e2,0x00e3,0x001c,0x001d,0x00e4,0x00e5,0x00e6,0x00e7,0x00e8
,0x00e9,0x00ea,0x00eb,0x00ec,0x00ed,0x001d,0x001d,0x00de,0x00df,0x00df,0x00ee,0x00df,0x00df,0x00e1,0x00df,0x00df,0x00df,0x00e2,0x00e3,0x001d
,0x0018,0x00ef,0x0000,0x0000,0x0000,0x0024,0x0000,0x0020,0x0000,0x0000,0x0000,0x0000,0x00e3,0x001d,0x001d,0x00f0,0x00f1,0x00f2,0x00f3,0x00f4
,0x00f5,0x00f6,0x00f7,0x00f8,0x00f9,0x001d,0x001c,0x00ef,0x0020,0x0000,0x0000,0x0000,0x0022,0x0000,0x0000,0x001e,0x0000,0x0024,0x00e3,0x001d
,0x001d,0x00ef,0x0000,0x0000,0x001e,0x0000,0x0022,0x0000,0x0000,0x0000,0x0022,0x0000,0x00e3,0x0018,0x001d,0x00fa,0x00fb,0x00fc,0x00fd,0x00fe
,0x00ff,0x0100,0x0101,0x0102,0x0103,0x001d,0x001d,0x00ef,0x0000,0x0000,0x0020,0x0000,0x0000,0x0000,0x0000,0x0000,0x0000,0x0000,0x00e3,0x001d
,0x001a,0x00ef,0x0020,0x0000,0x0000,0x0000,0x0000,0x0000,0x0000,0x0000,0x0000,0x0000,0x00e3,0x001d,0x0104,0x0105,0x0106,0x0107,0x0108,0x0109
,0x010a,0x010b,0x010c,0x010d,0x010e,0x001d,0x0018,0x00ef,0x0000,0x0000,0x0000,0x001e,0x0000,0x0000,0x0000,0x0000,0x0020,0x0000,0x00e3,0x001c
,0x001d,0x00ef,0x0000,0x0000,0x0024,0x0000,0x0020,0x0000,0x0000,0x001e,0x0000,0x0000,0x00e3,0x001d,0x010f,0x0110,0x0111,0x0112,0x0113,0x0114
,0x0115,0x0116,0x0117,0x0118,0x0119,0x001c,0x001d,0x00ef,0x0000,0x001e,0x0000,0x0000,0x0000,0x001e,0x0000,0x0024,0x0000,0x0000,0x00e3,0x001d
,0x011a,0x011b,0x011c,0x011d,0x011d,0x011d,0x011d,0x011d,0x011d,0x011d,0x011d,0x011d,0x011e,0x011f,0x0120,0x0121,0x0122,0x0123,0x0124,0x0125
,0x0126,0x0127,0x0128,0x0129,0x012a,0x012b,0x012c,0x011b,0x011c,0x011d,0x011d,0x011d,0x011d,0x011d,0x011d,0x011d,0x011d,0x011d,0x011e,0x011a
,0x0015,0x012d,0x012e,0x001d,0x001d,0x001d,0x001d,0x001d,0x001d,0x001d,0x001d,0x001d,0x012f,0x0130,0x0000,0x0000,0x0000,0x0000,0x0131,0x0015
,0x0015,0x0130,0x0000,0x0000,0x0000,0x0000,0x0131,0x012d,0x012e,0x001d,0x001d,0x001d,0x001d,0x001d,0x001d,0x001d,0x001d,0x001d,0x012f,0x0015
,0x0015,0x012d,0x012e,0x001d,0x001d,0x001d,0x001d,0x001d,0x001d,0x001d,0x001d,0x001d,0x012f,0x0130,0x0000,0x0000,0x0000,0x0000,0x0131,0x0015
,0x0015,0x0130,0x0000,0x0000,0x0000,0x0000,0x0131,0x012d,0x012e,0x001d,0x001d,0x001d,0x001d,0x001d,0x001d,0x001d,0x001d,0x001d,0x012f,0x0015
,0x0015,0x012d,0x012e,0x001d,0x001d,0x001d,0x001d,0x001d,0x001d,0x001d,0x001d,0x001d,0x012f,0x0130,0x0000,0x0000,0x0000,0x0000,0x0131,0x0015
,0x0015,0x0130,0x0000,0x0000,0x0000,0x0000,0x0131,0x012d,0x012e,0x001d,0x001d,0x001d,0x001d,0x001d,0x001d,0x001d,0x001d,0x001d,0x012f,0x0015
,0x0015,0x012d,0x012e,0x001d,0x001d,0x001d,0x001d,0x001d,0x001d,0x001d,0x001d,0x001d,0x012f,0x0132,0x0133,0x0134,0x0135,0x0136,0x0137,0x0015
,0x0015,0x0132,0x0133,0x0134,0x0135,0x0136,0x0137,0x012d,0x012e,0x001d,0x001d,0x001d,0x001d,0x001d,0x001d,0x001d,0x001d,0x001d,0x012f,0x0015
,0x0015,0x012d,0x012e,0x001d,0x001d,0x001d,0x001d,0x001d,0x001d,0x001d,0x001d,0x001d,0x012f,0x0015,0x0015,0x0015,0x0015,0x0015,0x0015,0x0015
,0x0015,0x0015,0x0015,0x0015,0x0015,0x0015,0x0015,0x012d,0x012e,0x001d,0x001d,0x001d,0x001d,0x001d,0x001d,0x001d,0x001d,0x001d,0x012f,0x0015
,0x0015,0x012d,0x012e,0x001d,0x001d,0x001d,0x001d,0x001d,0x001d,0x001d,0x001d,0x001d,0x012f,0x0015,0x0015,0x0015,0x0015,0x0015,0x0015,0x0015
,0x0015,0x0015,0x0015,0x0015,0x0015,0x0015,0x0015,0x012d,0x012e,0x001d,0x001d,0x001d,0x001d,0x001d,0x001d,0x001d,0x001d,0x001d,0x012f,0x0015
,0x0015,0x012d,0x012e,0x001d,0x001d,0x001d,0x001d,0x001d,0x001d,0x001d,0x001d,0x001d,0x012f,0x0015,0x0015,0x0015,0x0015,0x0015,0x0015,0x0015
,0x0015,0x0015,0x0015,0x0015,0x0015,0x0015,0x0015,0x012d,0x012e,0x001d,0x001d,0x001d,0x001d,0x001d,0x001d,0x001d,0x001d,0x001d,0x012f,0x0015
,0x0015,0x012d,0x012e,0x001d,0x001d,0x001d,0x001d,0x001d,0x001d,0x001d,0x001d,0x001d,0x012f,0x0015,0x0015,0x0015,0x0015,0x0015,0x0015,0x0015
,0x0015,0x0015,0x0015,0x0015,0x0015,0x0015,0x0015,0x012d,0x012e,0x001d,0x001d,0x001d,0x001d,0x001d,0x001d,0x001d,0x001d,0x001d,0x012f,0x0015
,0x0015,0x012d,0x012e,0x001d,0x001d,0x001d,0x001d,0x001d,0x001d,0x001d,0x001d,0x001d,0x012f,0x0015,0x0015,0x0015,0x0015,0x0015,0x0015,0x0015
,0x0015,0x0015,0x0015,0x0015,0x0015,0x0015,0x0015,0x012d,0x012e,0x001d,0x001d,0x001d,0x001d,0x001d,0x001d,0x001d,0x001d,0x001d,0x012f,0x0015
,0x0015,0x012d,0x012e,0x001d,0x001d,0x001d,0x001d,0x001d,0x001d,0x001d,0x001d,0x001d,0x012f,0x0015,0x0015,0x0015,0x0015,0x0015,0x0015,0x0015
,0x0015,0x0015,0x0015,0x0015,0x0015,0x0015,0x0015,0x012d,0x012e,0x001d,0x001d,0x001d,0x001d,0x001d,0x001d,0x001d,0x001d,0x001d,0x012f,0x0015
,0x0015,0x012d,0x012e,0x001d,0x001d,0x001d,0x001d,0x001d,0x001d,0x001d,0x001d,0x001d,0x012f,0x0015,0x0015,0x0015,0x0015,0x0015,0x0015,0x0015
,0x0015,0x0015,0x0015,0x0015,0x0015,0x0015,0x0015,0x012d,0x012e,0x001d,0x001d,0x001d,0x001d,0x001d,0x001d,0x001d,0x001d,0x001d,0x012f,0x0015
,0x0015,0x012d,0x012e,0x001d,0x001d,0x001d,0x001d,0x001d,0x001d,0x001d,0x001d,0x001d,0x012f,0x0015,0x0015,0x0015,0x0015,0x0015,0x0015,0x0015
,0x0015,0x0015,0x0015,0x0015,0x0015,0x0015,0x0015,0x012d,0x012e,0x001d,0x001d,0x001d,0x001d,0x001d,0x001d,0x001d,0x001d,0x001d,0x012f,0x0015
,0x0015,0x012d,0x012e,0x001d,0x001d,0x001d,0x001d,0x001d,0x001d,0x001d,0x001d,0x001d,0x0138,0x0139,0x013a,0x013b,0x013c,0x013d,0x013e,0x013f
,0x0140,0x0139,0x013a,0x013b,0x013c,0x013d,0x013e,0x0141,0x012e,0x001d,0x001d,0x001d,0x001d,0x001d,0x001d,0x001d,0x001d,0x001d,0x012f,0x0015
,0x0015,0x012d,0x012e,0x001d,0x001d,0x001d,0x001d,0x001d,0x001d,0x001d,0x001d,0x001d,0x0142,0x0000,0x0000,0x0000,0x0000,0x0000,0x0000,0x0131
,0x0130,0x0000,0x0000,0x0000,0x0000,0x0000,0x0000,0x0143,0x012e,0x001d,0x001d,0x001d,0x001d,0x001d,0x001d,0x001d,0x001d,0x001d,0x012f,0x0015
,0x0015,0x0144,0x0145,0x0146,0x0146,0x0146,0x0146,0x0146,0x0146,0x0146,0x0146,0x0146,0x0147,0x0148,0x0148,0x0148,0x0148,0x0148,0x0148,0x0149
,0x014a,0x0148,0x0148,0x0148,0x0148,0x0148,0x0148,0x014b,0x0145,0x0146,0x0146,0x0146,0x0146,0x0146,0x0146,0x0146,0x0146,0x0146,0x014c,0x0015
,0x0015,0x0015,0x0015,0x0015,0x0015,0x0015,0x0015,0x0015,0x0015,0x0015,0x0015,0x0015,0x0015,0x0015,0x0015,0x0015,0x0015,0x0015,0x0015,0x0015
,0x0015,0x0015,0x0015,0x0015,0x0015,0x0015,0x0015,0x0015,0x0015,0x0015,0x0015,0x0015,0x0015,0x0015,0x0015,0x0015,0x0015,0x0015,0x0015,0x0015};

#define MAP_TITLE_WIDTH 33
#define MAP_TITLE_HEIGHT 9
const u16 map_title[] PROGMEM ={
33,9
,0x0000,0x0000,0x0000,0x0000,0x0000,0x0000,0x0020,0x0000,0x0000,0x0000,0x0000,0x0000,0x0000,0x0000,0x0000,0x0020,0x0000,0x0000,0x0000,0x0000
,0x0000,0x0000,0x0000,0x0022,0x0000,0x0000,0x0000,0x0000,0x0000,0x0000,0x0000,0x0000,0x0000,0x0000,0x0020,0x0000,0x014d,0x014e,0x014f,0x0150
,0x0151,0x0152,0x0024,0x0000,0x0000,0x001e,0x0000,0x0000,0x0000,0x0022,0x0000,0x0000,0x0024,0x0000,0x0000,0x001e,0x0000,0x0000,0x0020,0x0000
,0x0000,0x0000,0x0000,0x0020,0x0000,0x0000,0x0000,0x0000,0x0153,0x0154,0x0155,0x0156,0x0157,0x0158,0x0159,0x0022,0x0000,0x0000,0x0000,0x0020
,0x0000,0x0000,0x0000,0x0000,0x001e,0x0000,0x0000,0x0000,0x0000,0x0000,0x0000,0x0022,0x0000,0x0000,0x001e,0x0000,0x0000,0x0022,0x0000,0x0022
,0x0000,0x015a,0x015b,0x015c,0x015d,0x015e,0x015f,0x0160,0x0161,0x0162,0x0163,0x0164,0x0165,0x0166,0x0167,0x0168,0x0169,0x016a,0x016b,0x016c
,0x016d,0x016e,0x016f,0x0170,0x0171,0x0172,0x0173,0x0174,0x0175,0x0176,0x0000,0x001e,0x0000,0x0000,0x0020,0x0177,0x0178,0x0179,0x017a,0x017b
,0x017c,0x017d,0x017e,0x017f,0x0180,0x0181,0x0182,0x0183,0x0184,0x0185,0x0186,0x0187,0x0188,0x0189,0x018a,0x018b,0x018c,0x018d,0x018e,0x018f
,0x0190,0x0191,0x0192,0x0024,0x0000,0x0000,0x001e,0x0000,0x0193,0x0194,0x0195,0x0193,0x0194,0x0196,0x0197,0x0198,0x0199,0x019a,0x019b,0x019c
,0x019d,0x019e,0x019f,0x01a0,0x01a1,0x0195,0x01a2,0x01a3,0x01a4,0x01a5,0x01a6,0x01a7,0x01a8,0x01a9,0x01aa,0x019c,0x0000,0x0000,0x0000,0x0000
,0x0000,0x01ab,0x01ac,0x01ad,0x01ab,0x01ae,0x01af,0x01b0,0x01b1,0x01b2,0x01b3,0x01b4,0x01b5,0x01b6,0x01b7,0x01ab,0x01b8,0x01b9,0x01ad,0x01ba
,0x01bb,0x01bc,0x01bd,0x01be,0x01b6,0x01bf,0x01b0,0x01c0,0x01c1,0x001e,0x0000,0x0024,0x0000,0x0022,0x0000,0x0000,0x0020,0x0000,0x0000,0x001e
,0x0000,0x0024,0x0000,0x0000,0x0000,0x001e,0x0000,0x0022,0x0000,0x0024,0x0000,0x0000,0x0000,0x0000,0x0000,0x0020,0x0000,0x0000,0x0020,0x0000
,0x0000,0x0022,0x0000,0x0024,0x0000,0x0000,0x0000,0x0000,0x0000,0x0000,0x001e,0x0000,0x0000,0x0000,0x0000,0x0020,0x0000,0x0000,0x0000,0x0022
,0x0000,0x0000,0x0000,0x0000,0x001e,0x0000,0x0000,0x0000,0x0000,0x0000,0x0020,0x0000,0x0000,0x0022,0x0000,0x0000,0x0000};

#define MAP_ANIM_SPARK4_WIDTH 7
#define MAP_ANIM_SPARK4_HEIGHT 4
const u16 map_anim_spark4[] PROGMEM ={
7,4
,0x0015,0x0025,0x0026,0x0027,0x0028,0x0029,0x0015,0x0035,0x0036,0x0037,0x0038,0x0039,0x003a,0x003b,0x0051,0x0052,0x0053,0x0054,0x0055,0x0056
,0x0057,0x0015,0x0063,0x0064,0x0065,0x0066,0x0067,0x0015};

#define MAP_ANIM_SPARK3_WIDTH 7
#define MAP_ANIM_SPARK3_HEIGHT 4
const u16 map_anim_spark3[] PROGMEM ={
7,4
,0x0015,0x0015,0x0015,0x002a,0x0015,0x0015,0x0015,0x0015,0x003c,0x003d,0x003e,0x003f,0x0040,0x0015,0x0015,0x0058,0x0059,0x005a,0x005b,0x005c
,0x0015,0x0015,0x0068,0x0069,0x006a,0x006b,0x006c,0x0015};

#define MAP_ANIM_SPARK2_WIDTH 7
#define MAP_ANIM_SPARK2_HEIGHT 4
const u16 map_anim_spark2[] PROGMEM ={
7,4
,0x0015,0x0015,0x0015,0x0015,0x0015,0x0015,0x0015,0x0015,0x0015,0x0041,0x0042,0x0043,0x0015,0x0015,0x0015,0x0015,0x005d,0x005e,0x005f,0x0015
,0x0015,0x0015,0x0015,0x0015,0x0015,0x0015,0x0015,0x0015};

#define MAP_ANIM_SPARK1_WIDTH 7
#define MAP_ANIM_SPARK1_HEIGHT 4
const u16 map_anim_spark1[] PROGMEM ={
7,4
,0x0015,0x0015,0x0015,0x0015,0x0015,0x0015,0x0015,0x0015,0x0015,0x0044,0x0045,0x0046,0x0015,0x0015,0x0015,0x0015,0x0060,0x0061,0x0062,0x0015
,0x0015,0x0015,0x0015,0x0015,0x0015,0x0015,0x0015,0x0015};

#define MAP_ANIM_TETRIS1_WIDTH 5
#define MAP_ANIM_TETRIS1_HEIGHT 2
const u16 map_anim_tetris1[] PROGMEM ={
5,2
,0x0075,0x0076,0x0077,0x0078,0x0079,0x0094,0x0095,0x0096,0x0097,0x0098};

#define MAP_ANIM_TETRIS2_WIDTH 5
#define MAP_ANIM_TETRIS2_HEIGHT 2
const u16 map_anim_tetris2[] PROGMEM ={
5,2
,0x007a,0x007b,0x007c,0x007d,0x007e,0x0099,0x009a,0x009b,0x009c,0x009d};

#define MAP_ANIM_TETRIS3_WIDTH 5
#define MAP_ANIM_TETRIS3_HEIGHT 2
const u16 map_anim_tetris3[] PROGMEM ={
5,2
,0x007f,0x0080,0x0081,0x0082,0x0083,0x009e,0x009f,0x00a0,0x00a1,0x00a2};

#define MAP_ANIM_TSPIN_WIDTH 5
#define MAP_ANIM_TSPIN_HEIGHT 1
const u16 map_anim_tspin[] PROGMEM ={
5,1
,0x002b,0x002c,0x002d,0x002e,0x002f};

#define MAP_ANIM_SINGLE_WIDTH 5
#define MAP_ANIM_SINGLE_HEIGHT 1
const u16 map_anim_single[] PROGMEM ={
5,1
,0x0030,0x0031,0x0032,0x0033,0x0034};

#define MAP_ANIM_DOUBLE_WIDTH 5
#define MAP_ANIM_DOUBLE_HEIGHT 1
const u16 map_anim_double[] PROGMEM ={
5,1
,0x0047,0x0048,0x0049,0x004a,0x004b};

#define MAP_ANIM_TRIPLE_WIDTH 5
#define MAP_ANIM_TRIPLE_HEIGHT 1
const u16 map_anim_triple[] PROGMEM ={
5,1
,0x004c,0x004d,0x004e,0x004f,0x0050};

#define MAP_ANIM_BACKTOBACK3_WIDTH 5
#define MAP_ANIM_BACKTOBACK3_HEIGHT 3
const u16 map_anim_backtoback3[] PROGMEM ={
5,3
,0x0015,0x006d,0x006e,0x006f,0x0070,0x0084,0x0085,0x0086,0x0087,0x0088,0x00a3,0x00a4,0x00a5,0x00a6,0x00a7};

#define MAP_ANIM_BACKTOBACK2_WIDTH 5
#define MAP_ANIM_BACKTOBACK2_HEIGHT 3
const u16 map_anim_backtoback2[] PROGMEM ={
5,3
,0x0015,0x0015,0x0073,0x0074,0x0015,0x0015,0x008e,0x008f,0x0090,0x0015,0x0015,0x0068,0x00ac,0x0015,0x0015};

#define MAP_ANIM_BACKTOBACK1_WIDTH 5
#define MAP_ANIM_BACKTOBACK1_HEIGHT 3
const u16 map_anim_backtoback1[] PROGMEM ={
5,3
,0x0015,0x0015,0x0015,0x0015,0x0015,0x0015,0x0091,0x0092,0x0093,0x0015,0x0015,0x0015,0x0015,0x0015,0x0015};


//first byte of maps is background tile

#define TILE_BLACK			0
#define TILE_BG				1
#define TILE_BREAKABLE		2
#define TILE_UNBREAKABLE	3
#define TILE_LADDER			4
#define TILE_ROPE			5
#define TILE_BREAKABLE_FAKE	6
#define TILE_GOLD1			7
#define TILE_GOLD2			8
#define TILE_GOLD3			9
#define TILE_GOLD4			10
#define TILE_SHADOW			11
#define TILE_SHADOW2		12
#define TILE_SHADOW3		13
#define TILE_DESTROY1		14
#define TILE_DESTROY2		15
#define TILE_DESTROY3		16
#define TILE_DESTROY4		17
#define TILE_DESTROY5		18
#define TILE_BG_HOLE		19
#define TILE_BG_STEP_ON		20	//step on head
#define TILE_CURSOR			21	
#define TILE_GOLD_STATS		22	

#define MAX_PLAYERS  6
#define LEVEL_SIZE 224
const char levels[] PROGMEM=
{

//1
0x00,0x00,0x00,0x00,0x00,0x00,0x00,0x00,0x00,0x60,0x00,0x00,0x00,0x00,
0x00,0x00,0x70,0x00,0x00,0x00,0x00,0x00,0x00,0x60,0x00,0x00,0x00,0x00,
0x11,0x11,0x11,0x13,0x11,0x11,0x11,0x10,0x00,0x60,0x00,0x00,0x00,0x00,
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0x11,0x11,0x11,0x11,0x11,0x11,0x11,0x11,0x11,0x11,0x11,0x11,0x11,0x11,

//2
0x00,0x07,0x00,0x00,0x00,0x00,0x00,0x00,0x00,0x00,0x00,0x00,0x00,0x03,
0x32,0x21,0x22,0x30,0x00,0x00,0x00,0x00,0x00,0x70,0x00,0x00,0x00,0x03,
0x30,0x00,0x00,0x30,0x00,0x03,0x11,0x11,0x11,0x11,0x13,0x07,0x00,0x03,
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0x11,0x11,0x11,0x11,0x11,0x11,0x11,0x11,0x11,0x11,0x11,0x11,0x11,0x11,

//3
0x00,0x00,0x00,0x00,0x00,0x00,0x00,0x00,0x00,0x00,0x00,0x00,0x00,0x06,
0x44,0x44,0x44,0x44,0x44,0x00,0x00,0x70,0x00,0x00,0x00,0x00,0x00,0x06,
0x30,0x70,0x00,0x00,0x03,0x11,0x11,0x11,0x11,0x11,0x30,0x00,0x00,0x06,
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0x11,0x11,0x11,0x11,0x11,0x11,0x11,0x11,0x11,0x11,0x11,0x11,0x11,0x11,

//4
0x60,0x00,0x00,0x00,0x00,0x00,0x00,0x00,0x00,0x00,0x00,0x00,0x00,0x00,
0x64,0x44,0x44,0x44,0x44,0x44,0x00,0x00,0x00,0x00,0x00,0x00,0x00,0x00,
0x30,0x00,0x00,0x30,0x00,0x00,0x10,0x70,0x10,0x00,0x00,0x30,0x00,0x00,
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0x11,0x11,0x11,0x11,0x11,0x11,0x11,0x11,0x11,0x11,0x11,0x11,0x11,0x11,


//5
0x00,0x00,0x00,0x00,0x06,0x00,0x00,0x00,0x00,0x00,0x00,0x00,0x00,0x00,
0x00,0x00,0x00,0x00,0x06,0x00,0x00,0x00,0x07,0x00,0x00,0x00,0x80,0x00,
0x11,0x10,0x00,0x00,0x06,0x00,0x00,0x00,0x11,0x11,0x31,0x11,0x11,0x11,
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0x11,0x11,0x11,0x11,0x11,0x11,0x11,0x11,0x11,0x11,0x11,0x11,0x11,0x11,

//6
0x11,0x11,0x11,0x11,0x11,0x11,0x11,0x11,0x11,0x61,0x11,0x11,0x11,0x11,
0x10,0x70,0x00,0x00,0x00,0x00,0x00,0x00,0x00,0x61,0x08,0x07,0x00,0x01,
0x15,0x11,0x13,0x11,0x11,0x30,0x00,0x70,0x00,0x61,0x11,0x11,0x11,0x31,
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0x11,0x11,0x11,0x11,0x11,0x11,0x11,0x11,0x11,0x11,0x11,0x11,0x11,0x11,

//7
0x00,0x60,0x00,0x00,0x00,0x00,0x00,0x00,0x00,0x00,0x00,0x00,0x00,0x00,
0x00,0x60,0x00,0x00,0x00,0x00,0x00,0x00,0x00,0x00,0x44,0x44,0x44,0x44,
0x00,0x60,0x00,0x00,0x00,0x00,0x08,0x00,0x00,0x00,0x30,0x00,0x00,0x03,
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0x11,0x11,0x11,0x11,0x11,0x11,0x11,0x11,0x11,0x11,0x11,0x11,0x11,0x11,

//8
0x00,0x00,0x00,0x00,0x00,0x06,0x00,0x00,0x60,0x00,0x00,0x00,0x00,0x00,
0x00,0x00,0x00,0x00,0x00,0x06,0x00,0x00,0x60,0x00,0x00,0x00,0x00,0x00,
0x00,0x07,0x08,0x00,0x03,0x16,0x00,0x00,0x61,0x30,0x00,0x80,0x70,0x00,
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0x11,0x11,0x11,0x11,0x11,0x11,0x11,0x11,0x11,0x11,0x11,0x11,0x11,0x11,

//9
0x60,0x00,0x00,0x00,0x00,0x00,0x00,0x00,0x00,0x00,0x00,0x00,0x00,0x00,
0x64,0x44,0x44,0x44,0x44,0x44,0x44,0x44,0x44,0x44,0x44,0x44,0x44,0x44,
0x31,0x08,0x00,0x01,0x00,0x00,0x00,0x00,0x00,0x00,0x01,0x00,0x00,0x01,
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0x30,0x00,0x00,0x09,0x00,0x22,0x22,0x00,0x00,0x00,0x80,0x00,0x00,0x00,

//10
0x00,0x00,0x00,0x00,0x00,0x70,0x00,0x00,0x00,0x00,0x00,0x00,0x06,0x00,
0x00,0x00,0x00,0x00,0x31,0x11,0x11,0x11,0x00,0x70,0x00,0x00,0x06,0x00,
0x00,0x00,0x70,0x00,0x30,0x00,0x00,0x01,0x11,0x11,0x10,0x00,0x06,0x00,
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0x11,0x11,0x11,0x11,0x11,0x11,0x11,0x11,0x11,0x11,0x11,0x11,0x11,0x11,

//11
0x00,0x00,0x00,0x03,0x00,0x00,0x00,0x00,0x00,0x00,0x00,0x00,0x00,0x00,
0x08,0x70,0x00,0x03,0x00,0x00,0x00,0x00,0x00,0x00,0x00,0x00,0x07,0x80,
0x31,0x18,0x70,0x03,0x00,0x00,0x00,0x00,0x00,0x00,0x00,0x07,0x81,0x13,
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0x30,0x00,0x03,0x11,0x11,0x11,0x11,0x11,0x11,0x11,0x11,0x30,0x00,0x03,

//12
0x00,0x00,0x00,0x70,0x00,0x00,0x70,0x00,0x00,0x00,0x00,0x00,0x30,0x00,
0x31,0x11,0x11,0x11,0x11,0x11,0x11,0x11,0x11,0x30,0x00,0x00,0x30,0x00,
0x30,0x00,0x00,0x00,0x00,0x00,0x00,0x70,0x00,0x34,0x44,0x44,0x30,0x07,
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0x11,0x11,0x11,0x11,0x11,0x11,0x11,0x11,0x11,0x11,0x11,0x11,0x11,0x11,

//13
0x00,0x00,0x00,0x00,0x00,0x00,0x80,0x00,0x00,0x00,0x00,0x08,0x00,0x06,
0x53,0x53,0x53,0x53,0x53,0x53,0x53,0x53,0x53,0x53,0x53,0x53,0x53,0x56,
0x53,0x53,0x53,0x53,0x53,0x53,0x53,0x53,0x53,0x53,0x53,0x53,0x53,0x56,
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0x11,0x11,0x11,0x11,0x11,0x11,0x11,0x11,0x11,0x11,0x11,0x11,0x11,0x11,

//14
0x00,0x30,0x00,0x80,0x00,0x04,0x00,0x08,0x43,0x00,0x00,0x34,0x00,0x07,
0x04,0x30,0x00,0x43,0x40,0x00,0x40,0x04,0x03,0x40,0x00,0x30,0x40,0x03,
0x40,0x30,0x04,0x03,0x04,0x00,0x00,0x40,0x03,0x04,0x00,0x30,0x04,0x03,
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0x00,0x03,0x00,0x00,0x07,0x00,0x00,0x07,0x90,0x00,0x00,0x00,0x30,0x00,

//15
0x60,0x00,0x00,0x00,0x00,0x00,0x00,0x00,0x00,0x00,0x00,0x00,0x00,0x06,
0x60,0x00,0x00,0x70,0x80,0x07,0x00,0x00,0x07,0x00,0x80,0x70,0x00,0x06,
0x66,0x66,0x11,0x11,0x11,0x11,0x30,0x00,0x31,0x11,0x11,0x11,0x16,0x66,
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0x12,0x12,0x12,0x12,0x12,0x12,0x12,0x12,0x12,0x12,0x12,0x12,0x12,0x12,

//16
0x00,0x00,0x00,0x00,0x00,0x00,0x00,0x00,0x00,0x00,0x00,0x00,0x06,0x00,
0x00,0x00,0x00,0x00,0x00,0x00,0x00,0x00,0x00,0x00,0x90,0x00,0x00,0x60,
0x00,0x05,0x11,0x11,0x33,0x11,0x11,0x11,0x33,0x33,0x30,0x00,0x00,0x06,
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0x11,0x11,0x11,0x11,0x11,0x11,0x11,0x11,0x00,0x07,0x77,0x77,0x73,0x11,

//17
0x60,0x00,0x00,0x00,0x00,0x00,0x00,0x00,0x00,0x00,0x00,0x00,0x00,0x06,
0x60,0x00,0x00,0x00,0x00,0x00,0x00,0x00,0x00,0x00,0x00,0x00,0x00,0x06,
0x60,0x00,0x00,0x00,0x00,0x80,0x00,0x00,0x00,0x00,0x00,0x00,0x00,0x06,
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0x11,0x11,0x11,0x10,0x07,0x31,0x11,0x11,0x10,0x70,0x31,0x11,0x11,0x11,

//18
0x00,0x06,0x00,0x00,0x00,0x00,0x00,0x00,0x00,0x00,0x00,0x00,0x00,0x00,
0x00,0x06,0x00,0x00,0x00,0x70,0x00,0x00,0x00,0x00,0x70,0x00,0x00,0x07,
0x35,0x13,0x00,0x00,0x31,0x11,0x30,0x00,0x00,0x31,0x11,0x31,0x00,0x13,
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0x11,0x11,0x11,0x11,0x11,0x11,0x11,0x11,0x11,0x11,0x11,0x11,0x11,0x11,

//19
0x00,0x00,0x00,0x00,0x00,0x00,0x31,0x13,0x00,0x00,0x00,0x00,0x00,0x00,
0x00,0x00,0x00,0x00,0x00,0x87,0x31,0x13,0x78,0x00,0x00,0x00,0x00,0x00,
0x00,0x00,0x00,0x00,0x00,0x31,0x11,0x11,0x13,0x00,0x00,0x00,0x00,0x00,
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0x11,0x11,0x11,0x11,0x11,0x11,0x11,0x11,0x11,0x11,0x11,0x11,0x11,0x11,

//20
0x00,0x00,0x00,0x00,0x00,0x00,0x08,0x70,0x00,0x06,0x00,0x00,0x00,0x00,
0x00,0x00,0x00,0x00,0x00,0x01,0x11,0x11,0x11,0x13,0x00,0x08,0x07,0x00,
0x00,0x00,0x00,0x08,0x07,0x00,0x00,0x00,0x00,0x03,0x13,0x11,0x11,0x13,
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0x11,0x11,0x11,0x11,0x11,0x11,0x11,0x11,0x11,0x11,0x11,0x11,0x11,0x11,

//21
0x22,0x22,0x22,0x22,0x22,0x22,0x22,0x22,0x22,0x22,0x22,0x22,0x22,0x61,
0x34,0x44,0x44,0x44,0x44,0x44,0x44,0x44,0x44,0x44,0x44,0x43,0x66,0x61,
0x30,0x03,0x00,0x00,0x01,0x10,0x08,0x00,0x07,0x00,0x00,0x03,0x67,0x01,
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0x11,0x11,0x11,0x11,0x11,0x11,0x11,0x11,0x11,0x30,0x77,0x31,0x11,0x11,

//22
0x00,0x00,0x00,0x07,0x00,0x00,0x70,0x00,0x00,0x60,0x00,0x00,0x00,0x00,
0x77,0x11,0x11,0x11,0x11,0x11,0x11,0x11,0x11,0x30,0x00,0x00,0x00,0x00,
0x11,0x00,0x00,0x00,0x00,0x00,0x70,0x07,0x00,0x30,0x00,0x00,0x00,0x00,
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0x00,0x00,0x00,0x03,0x00,0x70,0x09,0x03,0x00,0x00,0x00,0x70,0x00,0x00,

//23
0x00,0x02,0x22,0x22,0x22,0x22,0x00,0x00,0x00,0x00,0x00,0x06,0x00,0x00,
0x00,0x20,0x00,0x00,0x00,0x00,0x20,0x00,0x00,0x00,0x00,0x06,0x02,0x20,
0x02,0x00,0x07,0x70,0x80,0x00,0x01,0x30,0x00,0x00,0x00,0x06,0x02,0x20,
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0x21,0x11,0x11,0x12,0x37,0x07,0x30,0x01,0x11,0x11,0x11,0x11,0x11,0x11,

//24
0x00,0x00,0x00,0x00,0x00,0x00,0x00,0x00,0x60,0x00,0x00,0x00,0x00,0x00,
0x00,0x00,0x00,0x00,0x00,0x00,0x00,0x06,0x60,0x00,0x00,0x00,0x00,0x00,
0x00,0x00,0x00,0x00,0x00,0x00,0x00,0x66,0x00,0x00,0x00,0x00,0x00,0x00,
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0x22,0x22,0x22,0x22,0x22,0x22,0x22,0x22,0x22,0x22,0x22,0x22,0x22,0x22,

//25
0x00,0x00,0x20,0x00,0x00,0x20,0x00,0x00,0x20,0x00,0x00,0x00,0x00,0x62,
0x00,0x00,0x20,0x00,0x00,0x20,0x00,0x00,0x20,0x00,0x70,0x00,0x00,0x62,
0x00,0x00,0x25,0x11,0x11,0x20,0x00,0x00,0x21,0x11,0x10,0x01,0x11,0x62,
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0x13,0x11,0x10,0x00,0x03,0x00,0x00,0x08,0x00,0x00,0x00,0x00,0x03,0x02,

//26
0x00,0x00,0x00,0x00,0x00,0x00,0x00,0x00,0x00,0x00,0x00,0x00,0x00,0x60,
0x00,0x00,0x08,0x00,0x00,0x00,0x00,0x00,0x00,0x00,0x00,0x00,0x00,0x60,
0x31,0x11,0x11,0x11,0x11,0x13,0x00,0x80,0x07,0x00,0x00,0x07,0x00,0x60,
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0x11,0x11,0x11,0x11,0x11,0x11,0x11,0x11,0x11,0x11,0x11,0x11,0x11,0x11,

//27
0x60,0x00,0x00,0x00,0x00,0x00,0x00,0x00,0x00,0x00,0x00,0x00,0x00,0x06,
0x60,0x00,0x00,0x09,0x00,0x00,0x00,0x00,0x00,0x00,0x80,0x00,0x00,0x06,
0x60,0x00,0x21,0x31,0x24,0x44,0x44,0x44,0x44,0x42,0x13,0x12,0x00,0x06,
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0x11,0x11,0x11,0x11,0x11,0x11,0x11,0x11,0x11,0x11,0x11,0x11,0x11,0x11,

//28
0x00,0x00,0x00,0x00,0x00,0x00,0x06,0x00,0x00,0x00,0x00,0x00,0x00,0x00,
0x44,0x44,0x44,0x44,0x44,0x40,0x06,0x00,0x00,0x00,0x00,0x00,0x00,0x00,
0x00,0x70,0x00,0x07,0x02,0x30,0x06,0x07,0x00,0x00,0x00,0x00,0x00,0x00,
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0x11,0x11,0x11,0x11,0x11,0x11,0x11,0x11,0x11,0x11,0x11,0x11,0x11,0x11,

//29
0x00,0x80,0x44,0x64,0x00,0x00,0x00,0x00,0x00,0x00,0x08,0x60,0x00,0x00,
0x11,0x11,0x00,0x30,0x00,0x40,0x00,0x00,0x00,0x00,0x11,0x30,0x00,0x00,
0x11,0x11,0x00,0x30,0x11,0x04,0x00,0x08,0x00,0x04,0x11,0x30,0x00,0x00,
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0x00,0x00,0x00,0x00,0x00,0x30,0x00,0x00,0x00,0x30,0x00,0x00,0x00,0x00,

//30
0x20,0x00,0x00,0x00,0x00,0x00,0x00,0x00,0x00,0x00,0x00,0x00,0x00,0x06,
0x20,0x00,0x00,0x77,0x77,0x80,0x80,0x80,0x00,0x00,0x09,0x00,0x00,0x06,
0x21,0x11,0x11,0x11,0x11,0x15,0x11,0x11,0x11,0x11,0x11,0x11,0x11,0x13,
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0x11,0x11,0x11,0x11,0x11,0x22,0x22,0x22,0x11,0x11,0x11,0x12,0x22,0x03,

//31
0x00,0x00,0x00,0x00,0x00,0x00,0x06,0x00,0x00,0x00,0x00,0x00,0x00,0x00,
0x00,0x00,0x00,0x00,0x00,0x00,0x06,0x00,0x00,0x00,0x00,0x00,0x00,0x00,
0x70,0x00,0x00,0x00,0x00,0x00,0x06,0x60,0x00,0x00,0x00,0x00,0x00,0x07,
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0x11,0x11,0x80,0x00,0x00,0x00,0x31,0x13,0x00,0x00,0x00,0x00,0x11,0x11,

//32
0x00,0x06,0x00,0x00,0x00,0x00,0x00,0x00,0x00,0x00,0x00,0x00,0x00,0x00,
0x11,0x16,0x11,0x11,0x00,0x00,0x00,0x00,0x04,0x44,0x44,0x40,0x80,0x00,
0x00,0x06,0x04,0x40,0x08,0x00,0x00,0x00,0x00,0x00,0x00,0x22,0x22,0x23,
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0x11,0x11,0x11,0x11,0x11,0x11,0x11,0x11,0x11,0x11,0x11,0x11,0x11,0x11,

//33
0x11,0x11,0x16,0x11,0x11,0x11,0x11,0x11,0x11,0x11,0x11,0x10,0x11,0x11,
0x00,0x00,0x16,0x10,0x44,0x44,0x44,0x40,0x00,0x00,0x00,0x00,0x00,0x01,
0x61,0x16,0x06,0x10,0x17,0x00,0x01,0x31,0x00,0x00,0x00,0x00,0x08,0x01,
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0x39,0x00,0x00,0x00,0x03,0x07,0x01,0x11,0x11,0x10,0x08,0x00,0x00,0x03,

//34
0x64,0x44,0x44,0x44,0x47,0x71,0x11,0x11,0x17,0x74,0x44,0x44,0x44,0x46,
0x30,0x00,0x00,0x00,0x71,0x11,0x33,0x33,0x11,0x17,0x00,0x00,0x00,0x03,
0x30,0x00,0x00,0x07,0x11,0x33,0x38,0x83,0x33,0x11,0x70,0x00,0x00,0x03,
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0x11,0x11,0x11,0x11,0x13,0x00,0x00,0x00,0x00,0x31,0x11,0x11,0x11,0x11,

//35
0x60,0x00,0x00,0x00,0x00,0x00,0x01,0x10,0x00,0x00,0x00,0x00,0x00,0x06,
0x60,0x00,0x00,0x00,0x00,0x00,0x02,0x20,0x00,0x00,0x00,0x00,0x00,0x06,
0x60,0x70,0x00,0x00,0x00,0x70,0x01,0x10,0x07,0x00,0x00,0x00,0x07,0x06,
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0x12,0x12,0x12,0x12,0x12,0x12,0x12,0x12,0x12,0x12,0x12,0x12,0x12,0x12,

//36
0x60,0x00,0x70,0x00,0x07,0x00,0x00,0x07,0x00,0x00,0x00,0x08,0x70,0x06,
0x31,0x11,0x11,0x13,0x11,0x10,0x11,0x11,0x13,0x11,0x10,0x11,0x11,0x13,
0x30,0x00,0x00,0x03,0x00,0x00,0x00,0x00,0x03,0x00,0x00,0x00,0x00,0x03,
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0x11,0x11,0x11,0x11,0x11,0x11,0x11,0x11,0x11,0x11,0x11,0x11,0x11,0x11,

//37
0x60,0x00,0x00,0x00,0x00,0x00,0x00,0x00,0x00,0x00,0x00,0x00,0x00,0x00,
0x60,0x00,0x00,0x08,0x00,0x00,0x00,0x00,0x00,0x00,0x00,0x00,0x00,0x00,
0x61,0x11,0x11,0x11,0x11,0x12,0x22,0x22,0x21,0x22,0x22,0x12,0x22,0x23,
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0x11,0x11,0x11,0x11,0x11,0x11,0x11,0x11,0x11,0x22,0x11,0x11,0x22,0x22,

//38
0x60,0x00,0x00,0x00,0x00,0x00,0x00,0x00,0x00,0x00,0x00,0x00,0x00,0x06,
0x60,0x00,0x00,0x00,0x00,0x00,0x00,0x00,0x00,0x00,0x00,0x00,0x00,0x06,
0x11,0x11,0x11,0x31,0x11,0x13,0x80,0x83,0x11,0x11,0x31,0x11,0x11,0x11,
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0x70,0x00,0x00,0x32,0x22,0x22,0x22,0x22,0x22,0x22,0x30,0x09,0x00,0x07,

//39
0x11,0x10,0x06,0x01,0x10,0x00,0x01,0x10,0x00,0x01,0x10,0x60,0x01,0x11,
0x11,0x11,0x06,0x11,0x11,0x08,0x11,0x11,0x08,0x11,0x11,0x60,0x11,0x11,
0x30,0x01,0x13,0x10,0x01,0x13,0x10,0x01,0x31,0x10,0x01,0x31,0x10,0x03,
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0x31,0x11,0x11,0x11,0x11,0x11,0x11,0x11,0x11,0x11,0x11,0x11,0x11,0x13,

//40
0x60,0x00,0x00,0x00,0x00,0x01,0x11,0x11,0x11,0x11,0x11,0x11,0x11,0x11,
0x60,0x00,0x00,0x00,0x00,0x01,0x11,0x11,0x11,0x12,0x04,0x44,0x44,0x41,
0x60,0x00,0x07,0x00,0x03,0x10,0x00,0x07,0x00,0x02,0x30,0x10,0x70,0x01,
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0x11,0x11,0x11,0x11,0x11,0x11,0x11,0x11,0x11,0x11,0x11,0x11,0x11,0x11,

//41
0x00,0x06,0x44,0x70,0x44,0x44,0x44,0x44,0x84,0x44,0x44,0x64,0x44,0x44,
0x00,0x03,0x07,0x17,0x00,0x00,0x00,0x00,0x34,0x01,0x04,0x30,0x07,0x77,
0x79,0x30,0x71,0x01,0x70,0x00,0x00,0x03,0x40,0x11,0x10,0x43,0x00,0x77,
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0x11,0x11,0x11,0x11,0x22,0x22,0x21,0x11,0x11,0x11,0x13,0x00,0x00,0x03,

//42
0x00,0x70,0x00,0x00,0x60,0x70,0x00,0x00,0x00,0x00,0x07,0x00,0x00,0x70,
0x31,0x11,0x00,0x00,0x31,0x11,0x00,0x00,0x31,0x11,0x11,0x11,0x11,0x13,
0x30,0x70,0x00,0x70,0x30,0x00,0x00,0x70,0x30,0x70,0x00,0x07,0x00,0x03,
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0x11,0x11,0x71,0x30,0x00,0x00,0x00,0x00,0x00,0x31,0x11,0x11,0x11,0x11,

//43
0x00,0x60,0x00,0x00,0x00,0x00,0x00,0x00,0x00,0x00,0x00,0x00,0x00,0x60,
0x00,0x60,0x00,0x00,0x00,0x00,0x00,0x00,0x00,0x00,0x00,0x00,0x00,0x60,
0x00,0x31,0x11,0x11,0x11,0x11,0x11,0x11,0x11,0x11,0x11,0x11,0x11,0x30,
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0x11,0x11,0x11,0x11,0x11,0x11,0x31,0x71,0x31,0x11,0x11,0x11,0x11,0x11,

//44
0x11,0x11,0x11,0x11,0x11,0x11,0x11,0x11,0x11,0x11,0x11,0x11,0x11,0x16,
0x10,0x00,0x33,0x33,0x33,0x33,0x33,0x33,0x33,0x33,0x33,0x30,0x00,0x16,
0x10,0x90,0x30,0x33,0x30,0x00,0x03,0x00,0x03,0x30,0x00,0x30,0x80,0x16,
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0x33,0x33,0x33,0x33,0x33,0x33,0x33,0x33,0x33,0x33,0x33,0x33,0x33,0x36,

//45
0x22,0x22,0x22,0x22,0x22,0x22,0x22,0x20,0x06,0x02,0x22,0x22,0x22,0x22,
0x00,0x83,0x00,0x00,0x00,0x34,0x44,0x00,0x06,0x03,0x00,0x00,0x00,0x70,
0x22,0x26,0x11,0x22,0x22,0x21,0x51,0x22,0x26,0x03,0x22,0x22,0x03,0x21,
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0x21,0x11,0x11,0x22,0x22,0x11,0x11,0x11,0x11,0x11,0x11,0x11,0x21,0x11,

//46
0x07,0x00,0x00,0x00,0x00,0x00,0x00,0x00,0x00,0x00,0x06,0x00,0x00,0x00,
0x11,0x11,0x30,0x00,0x00,0x00,0x00,0x00,0x08,0x00,0x06,0x00,0x00,0x00,
0x00,0x70,0x30,0x00,0x00,0x00,0x00,0x03,0x11,0x11,0x11,0x30,0x00,0x70,
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0x11,0x11,0x11,0x11,0x11,0x11,0x11,0x11,0x11,0x11,0x11,0x16,0x11,0x11,

//47
0x20,0x00,0x00,0x00,0x00,0x00,0x00,0x00,0x22,0x22,0x22,0x22,0x22,0x26,
0x28,0x00,0x00,0x00,0x00,0x80,0x00,0x00,0x20,0x07,0x02,0x00,0x00,0x06,
0x22,0x44,0x44,0x44,0x11,0x11,0x13,0x09,0x20,0x32,0x02,0x32,0x11,0x16,
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0x17,0x31,0x21,0x11,0x12,0x11,0x11,0x12,0x11,0x22,0x11,0x21,0x11,0x11,

//48
0x60,0x00,0x00,0x00,0x00,0x00,0x70,0x00,0x00,0x00,0x00,0x00,0x00,0x00,
0x64,0x44,0x44,0x44,0x01,0x11,0x13,0x90,0x00,0x00,0x00,0x00,0x00,0x00,
0x30,0x00,0x00,0x00,0x00,0x07,0x03,0x00,0x00,0x70,0x00,0x00,0x07,0x00,
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0x11,0x11,0x11,0x11,0x11,0x11,0x11,0x11,0x11,0x11,0x11,0x11,0x11,0x11,

//49
0x00,0x00,0x04,0x00,0x00,0x04,0x64,0x00,0x00,0x00,0x46,0x07,0x00,0x70,
0x40,0x00,0x40,0x40,0x00,0x40,0x30,0x40,0x00,0x04,0x03,0x11,0x11,0x11,
0x04,0x04,0x00,0x04,0x04,0x00,0x30,0x04,0x00,0x40,0x03,0x00,0x00,0x00,
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0x11,0x11,0x11,0x11,0x11,0x11,0x11,0x11,0x11,0x11,0x11,0x11,0x11,0x11,

//50
0x30,0x00,0x40,0x00,0x00,0x00,0x00,0x00,0x00,0x00,0x00,0x03,0x44,0x44,
0x30,0x00,0x03,0x00,0x00,0x00,0x00,0x00,0x00,0x00,0x00,0x03,0x02,0x00,
0x30,0x00,0x03,0x00,0x00,0x00,0x00,0x00,0x00,0x08,0x00,0x03,0x02,0x77,
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0x11,0x11,0x11,0x11,0x11,0x11,0x13,0x00,0x03,0x11,0x11,0x11,0x11,0x11

};
#define LEVELS_COUNT 50


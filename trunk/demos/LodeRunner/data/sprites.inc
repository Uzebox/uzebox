/*
 * Transformation file: ../data/sprites.gconvert.xml
 * Source image: ..\data\sprites.png
 * Tile width: 8px
 * Tile height: 12px
 * Output format: (null)
 */
#define LODE_SPRITES_SIZE 28
const char lode_sprites[] PROGMEM={
 0xfe, 0xfe, 0xfe, 0xfe, 0xfe, 0xfe, 0xfe, 0xfe, 0xfe, 0xfe, 0xfe, 0xfe, 0x3f, 0x3f, 0xfe, 0xfe, 0xfe, 0xfe, 0xfe, 0x3f, 0x6f, 0x6f, 0xfe, 0xfe, 0xfe, 0xfe, 0xfe, 0x3f, 0x6f, 0x6f, 0xfe, 0xfe, 0xfe, 0xfe, 0xd1, 0xd1, 0xd1, 0xfe, 0xfe, 0xfe, 0xfe, 0xd1, 0xd1, 0xd1, 0xd1, 0xfe, 0xfe, 0xfe, 0x6f, 0xfe, 0xd1, 0xd1, 0xfe, 0xd1, 0x6f, 0xfe, 0xfe, 0xfe, 0xff, 0xff, 0xfe, 0xfe, 0xfe, 0xfe, 0xfe, 0xfe, 0xff, 0xff, 0xff, 0xfe, 0xfe, 0xfe, 0xb6, 0xff, 0xff, 0xfe, 0xff, 0xfe, 0xfe, 0xfe, 0xb6, 0xfe, 0xfe, 0xfe, 0xff, 0xfe, 0xfe, 0xfe, 0xfe, 0xfe, 0xfe, 0xfe, 0xb6, 0xb6, 0xfe, 0xfe		 //tile:0
, 0xfe, 0xfe, 0xfe, 0xfe, 0xfe, 0xfe, 0xfe, 0xfe, 0xfe, 0xfe, 0xfe, 0xfe, 0x3f, 0x3f, 0xfe, 0xfe, 0xfe, 0xfe, 0xfe, 0x3f, 0x6f, 0x6f, 0xfe, 0xfe, 0xfe, 0xfe, 0xfe, 0x3f, 0x6f, 0x6f, 0xfe, 0xfe, 0xfe, 0xfe, 0xfe, 0xd1, 0xd1, 0xfe, 0xfe, 0xfe, 0xfe, 0xd1, 0xd1, 0xd1, 0xd1, 0xfe, 0x6f, 0xfe, 0x6f, 0xd1, 0xfe, 0xd1, 0xd1, 0xd1, 0xd1, 0xfe, 0xfe, 0xfe, 0xfe, 0xff, 0xff, 0xfe, 0xfe, 0xfe, 0xfe, 0xfe, 0xff, 0xff, 0xff, 0xff, 0xfe, 0xfe, 0xfe, 0xff, 0xff, 0xfe, 0xfe, 0xff, 0xfe, 0xfe, 0xff, 0xfe, 0xfe, 0xfe, 0xfe, 0xb6, 0xb6, 0xfe, 0xb6, 0xb6, 0xfe, 0xfe, 0xfe, 0xfe, 0xfe, 0xfe		 //tile:1
, 0xfe, 0xfe, 0xfe, 0xfe, 0xfe, 0xfe, 0xfe, 0xfe, 0xfe, 0xfe, 0xfe, 0xfe, 0x3f, 0x3f, 0xfe, 0xfe, 0xfe, 0xfe, 0xfe, 0x3f, 0x6f, 0x6f, 0xfe, 0xfe, 0xfe, 0xfe, 0xfe, 0x3f, 0x6f, 0x6f, 0xfe, 0xfe, 0xfe, 0xfe, 0xfe, 0xd1, 0xd1, 0xfe, 0xfe, 0xfe, 0xfe, 0xfe, 0xd1, 0xd1, 0xd1, 0xfe, 0xfe, 0xfe, 0xfe, 0xd1, 0xd1, 0xd1, 0xd1, 0xd1, 0xfe, 0xfe, 0xfe, 0xd1, 0xd1, 0x6f, 0xd1, 0xd1, 0xd1, 0x6f, 0xfe, 0xfe, 0xfe, 0xff, 0xff, 0xff, 0xfe, 0xfe, 0xfe, 0xfe, 0xff, 0xff, 0xff, 0xff, 0xfe, 0xfe, 0xfe, 0xb6, 0xff, 0xff, 0xfe, 0xfe, 0xfe, 0xfe, 0xfe, 0xfe, 0xb6, 0xb6, 0xfe, 0xfe, 0xfe, 0xfe		 //tile:2
, 0xfe, 0xfe, 0xfe, 0xfe, 0xfe, 0xfe, 0xfe, 0xfe, 0xfe, 0xfe, 0xfe, 0xfe, 0x3f, 0x3f, 0xfe, 0xfe, 0xfe, 0xfe, 0xfe, 0x3f, 0x6f, 0x6f, 0xfe, 0xfe, 0xfe, 0xfe, 0xfe, 0x3f, 0x6f, 0x6f, 0xfe, 0xfe, 0xfe, 0xfe, 0xd1, 0xd1, 0xd1, 0xfe, 0xfe, 0xfe, 0xfe, 0xd1, 0xd1, 0xd1, 0xd1, 0xd1, 0xfe, 0xfe, 0x6f, 0xfe, 0xd1, 0xd1, 0xfe, 0xfe, 0xd1, 0x6f, 0xfe, 0xfe, 0xff, 0xff, 0xfe, 0xfe, 0xfe, 0xfe, 0xfe, 0xfe, 0xff, 0xff, 0xff, 0xfe, 0xfe, 0xfe, 0xb6, 0xff, 0xff, 0xfe, 0xff, 0xfe, 0xfe, 0xfe, 0xb6, 0xfe, 0xfe, 0xfe, 0xff, 0xfe, 0xfe, 0xfe, 0xfe, 0xfe, 0xfe, 0xfe, 0xb6, 0xb6, 0xfe, 0xfe		 //tile:3
, 0xfe, 0xfe, 0xfe, 0xfe, 0xfe, 0xfe, 0xfe, 0xfe, 0x6f, 0xfe, 0xfe, 0x3f, 0x3f, 0xfe, 0xfe, 0x6f, 0xd1, 0xfe, 0x3f, 0x6f, 0x6f, 0xfe, 0xfe, 0xd1, 0xd1, 0xfe, 0x3f, 0x6f, 0x6f, 0xfe, 0xd1, 0xfe, 0xfe, 0xd1, 0xd1, 0xd1, 0xd1, 0xd1, 0xfe, 0xfe, 0xfe, 0xfe, 0xd1, 0xd1, 0xfe, 0xfe, 0xfe, 0xfe, 0xfe, 0xfe, 0xd1, 0xd1, 0xfe, 0xfe, 0xfe, 0xfe, 0xfe, 0xfe, 0xff, 0xff, 0xff, 0xfe, 0xfe, 0xfe, 0xfe, 0xfe, 0xff, 0xfe, 0xfe, 0xff, 0xfe, 0xfe, 0xfe, 0xfe, 0xff, 0xfe, 0xfe, 0xff, 0xfe, 0xfe, 0xfe, 0xfe, 0xff, 0xfe, 0xfe, 0xb6, 0xb6, 0xfe, 0xfe, 0xb6, 0xb6, 0xfe, 0xfe, 0xfe, 0xfe, 0xfe		 //tile:4
, 0xfe, 0xfe, 0xfe, 0xfe, 0xfe, 0xfe, 0xfe, 0xfe, 0xfe, 0xfe, 0xfe, 0xfe, 0x3f, 0xfe, 0xfe, 0xfe, 0x6f, 0xfe, 0xfe, 0x3f, 0x3f, 0x3f, 0xfe, 0x6f, 0xd1, 0xfe, 0xfe, 0x3f, 0x3f, 0x3f, 0xfe, 0xd1, 0xd1, 0xfe, 0xfe, 0xd1, 0xd1, 0xfe, 0xfe, 0xd1, 0xfe, 0xd1, 0xd1, 0xd1, 0xd1, 0xd1, 0xd1, 0xfe, 0xfe, 0xfe, 0xfe, 0xd1, 0xd1, 0xfe, 0xfe, 0xfe, 0xfe, 0xfe, 0xfe, 0xd1, 0xd1, 0xfe, 0xfe, 0xfe, 0xfe, 0xfe, 0xfe, 0xff, 0xff, 0xfe, 0xfe, 0xfe, 0xfe, 0xfe, 0xfe, 0xff, 0xfe, 0xff, 0xfe, 0xfe, 0xfe, 0xfe, 0xfe, 0xff, 0xfe, 0xff, 0xfe, 0xfe, 0xfe, 0xfe, 0xb6, 0xb6, 0xfe, 0xb6, 0xb6, 0xfe		 //tile:5
, 0xfe, 0xfe, 0xfe, 0xfe, 0x3f, 0xfe, 0xfe, 0x6f, 0xfe, 0xfe, 0xfe, 0x3f, 0x3f, 0x3f, 0xfe, 0xd1, 0xfe, 0xfe, 0xfe, 0x3f, 0x3f, 0x3f, 0xfe, 0xd1, 0x6f, 0xfe, 0xfe, 0xd1, 0xd1, 0xd1, 0xd1, 0xfe, 0xd1, 0xd1, 0xd1, 0xd1, 0xd1, 0xfe, 0xfe, 0xfe, 0xfe, 0xfe, 0xfe, 0xd1, 0xd1, 0xfe, 0xfe, 0xfe, 0xfe, 0xfe, 0xfe, 0xff, 0xff, 0xff, 0xfe, 0xfe, 0xfe, 0xfe, 0xfe, 0xff, 0xfe, 0xff, 0xff, 0xfe, 0xfe, 0xfe, 0xfe, 0xff, 0xfe, 0xfe, 0xff, 0xfe, 0xfe, 0xfe, 0xfe, 0xff, 0xfe, 0xfe, 0xb6, 0xb6, 0xfe, 0xfe, 0xfe, 0xff, 0xfe, 0xfe, 0xfe, 0xfe, 0xfe, 0xfe, 0xb6, 0xb6, 0xfe, 0xfe, 0xfe, 0xfe		 //tile:6
, 0xfe, 0xfe, 0xfe, 0xfe, 0xfe, 0xfe, 0xfe, 0xfe, 0xfe, 0x6f, 0xfe, 0xfe, 0x3f, 0x3f, 0xfe, 0x6f, 0xfe, 0xd1, 0xfe, 0x3f, 0x6f, 0x6f, 0xfe, 0xd1, 0xfe, 0xd1, 0xfe, 0x3f, 0x6f, 0x6f, 0xfe, 0xd1, 0xfe, 0xd1, 0xd1, 0xd1, 0xd1, 0xd1, 0xd1, 0xd1, 0xfe, 0xfe, 0xd1, 0xd1, 0xd1, 0xd1, 0xfe, 0xfe, 0xfe, 0xfe, 0xfe, 0xd1, 0xd1, 0xfe, 0xfe, 0xfe, 0xfe, 0xfe, 0xfe, 0xff, 0xff, 0xfe, 0xfe, 0xfe, 0xfe, 0xff, 0xff, 0xff, 0xff, 0xfe, 0xfe, 0xfe, 0xff, 0xff, 0xfe, 0xfe, 0xff, 0xfe, 0xfe, 0xfe, 0xff, 0xfe, 0xfe, 0xff, 0xff, 0xfe, 0xfe, 0xfe, 0xb6, 0xfe, 0xb6, 0xff, 0xfe, 0xfe, 0xfe, 0xfe		 //tile:7
, 0xfe, 0xfe, 0xfe, 0xfe, 0xfe, 0xfe, 0xfe, 0xfe, 0xfe, 0xfe, 0xfe, 0xfe, 0x3f, 0x3f, 0x6f, 0xfe, 0xfe, 0xfe, 0xfe, 0x3f, 0x6f, 0x6f, 0xd1, 0xfe, 0xfe, 0xfe, 0xfe, 0x3f, 0x6f, 0x6f, 0xd1, 0xfe, 0xfe, 0xfe, 0xfe, 0xd1, 0xd1, 0xd1, 0xfe, 0xfe, 0xfe, 0xd1, 0xd1, 0xd1, 0xd1, 0xfe, 0xfe, 0xfe, 0x6f, 0xfe, 0xfe, 0xd1, 0xd1, 0xfe, 0xfe, 0xfe, 0xfe, 0xfe, 0xfe, 0xff, 0xff, 0xfe, 0xfe, 0xfe, 0xfe, 0xfe, 0xff, 0xff, 0xff, 0xfe, 0xfe, 0xfe, 0xfe, 0xfe, 0xff, 0xfe, 0xff, 0xfe, 0xfe, 0xfe, 0xfe, 0xfe, 0xff, 0xfe, 0xff, 0xfe, 0xfe, 0xfe, 0xfe, 0xb6, 0xb6, 0xfe, 0xb6, 0xb6, 0xfe, 0xfe		 //tile:8
, 0xfe, 0xfe, 0xfe, 0xfe, 0xfe, 0xfe, 0xfe, 0xfe, 0xfe, 0x6f, 0xfe, 0xfe, 0x3f, 0x3f, 0xfe, 0xfe, 0xfe, 0xd1, 0xfe, 0x3f, 0x3f, 0x3f, 0xfe, 0xfe, 0xfe, 0xd1, 0xfe, 0x3f, 0x3f, 0x6f, 0xfe, 0xfe, 0xfe, 0xfe, 0xd1, 0xd1, 0xd1, 0xfe, 0xfe, 0x6f, 0xfe, 0xfe, 0xfe, 0xd1, 0xd1, 0xd1, 0xd1, 0xfe, 0xfe, 0xfe, 0xfe, 0xd1, 0xd1, 0xfe, 0xfe, 0xfe, 0xfe, 0xfe, 0xfe, 0xff, 0xff, 0xfe, 0xfe, 0xfe, 0xfe, 0xfe, 0xff, 0xff, 0xff, 0xfe, 0xfe, 0xfe, 0xfe, 0xfe, 0xff, 0xfe, 0xff, 0xfe, 0xfe, 0xfe, 0xfe, 0xfe, 0xff, 0xfe, 0xff, 0xfe, 0xfe, 0xfe, 0xfe, 0xb6, 0xb6, 0xfe, 0xb6, 0xb6, 0xfe, 0xfe		 //tile:9
, 0xfe, 0xfe, 0xfe, 0xfe, 0xfe, 0xfe, 0xfe, 0xfe, 0xfe, 0xfe, 0xfe, 0xfe, 0xfe, 0x3f, 0x3f, 0xfe, 0xfe, 0xfe, 0xfe, 0xfe, 0x3f, 0x6f, 0x6f, 0xfe, 0xfe, 0xfe, 0xfe, 0xfe, 0x3f, 0x6f, 0x6f, 0xfe, 0xfe, 0xd1, 0xd1, 0xd1, 0xd1, 0xd1, 0xfe, 0xfe, 0x6f, 0xfe, 0xfe, 0xd1, 0xd1, 0xd1, 0xfe, 0xfe, 0xfe, 0xfe, 0xfe, 0xd1, 0xd1, 0xfe, 0xd1, 0xfe, 0xfe, 0xfe, 0xfe, 0xff, 0xff, 0xfe, 0xfe, 0x6f, 0xfe, 0xfe, 0xfe, 0xff, 0xff, 0xfe, 0xfe, 0xfe, 0xfe, 0xfe, 0xff, 0xfe, 0xff, 0xff, 0xfe, 0xfe, 0xb6, 0xff, 0xff, 0xfe, 0xfe, 0xff, 0xfe, 0xfe, 0xb6, 0xfe, 0xfe, 0xfe, 0xfe, 0xb6, 0xb6, 0xfe		 //tile:10
, 0xfe, 0xfe, 0xfe, 0xfe, 0xfe, 0xfe, 0xfe, 0xfe, 0xfe, 0xfe, 0xfe, 0xfe, 0xfe, 0xfe, 0xfe, 0xfe, 0xfe, 0xfe, 0xfe, 0xfe, 0xfe, 0xfe, 0xfe, 0xfe, 0xfe, 0xfe, 0xfe, 0xfe, 0xfe, 0xfe, 0xfe, 0xfe, 0xfe, 0xfe, 0xfe, 0xfe, 0xfe, 0xfe, 0xfe, 0xfe, 0xfe, 0xfe, 0xfe, 0xfe, 0xfe, 0xfe, 0xfe, 0xfe, 0xfe, 0xfe, 0xfe, 0xfe, 0xfe, 0xfe, 0xfe, 0xfe, 0x36, 0x7f, 0xfe, 0xfe, 0xfe, 0xfe, 0xfe, 0xfe, 0xfe, 0xfe, 0xfe, 0xfe, 0xfe, 0xfe, 0xfe, 0xfe, 0xfe, 0xfe, 0xfe, 0xfe, 0xfe, 0xfe, 0xfe, 0xfe, 0xfe, 0xfe, 0xfe, 0xfe, 0xfe, 0xfe, 0xfe, 0xfe, 0xfe, 0xfe, 0xfe, 0xfe, 0xfe, 0xfe, 0xfe, 0xfe		 //tile:11
, 0xfe, 0xfe, 0xfe, 0xfe, 0xfe, 0xfe, 0xfe, 0xfe, 0xfe, 0xfe, 0xfe, 0xfe, 0xfe, 0xfe, 0xfe, 0xfe, 0xfe, 0xfe, 0xfe, 0xfe, 0xfe, 0xfe, 0xfe, 0xfe, 0xfe, 0xfe, 0xfe, 0xfe, 0xfe, 0xfe, 0xfe, 0xfe, 0xfe, 0xfe, 0xfe, 0xfe, 0xfe, 0xfe, 0xfe, 0xfe, 0xfe, 0xfe, 0xfe, 0xfe, 0xfe, 0xfe, 0xfe, 0xfe, 0xfe, 0xfe, 0xfe, 0xfe, 0xfe, 0xfe, 0xfe, 0xfe, 0x36, 0x7f, 0xfe, 0xfe, 0xfe, 0xfe, 0xfe, 0xfe, 0xfe, 0x36, 0x7f, 0x7f, 0xfe, 0xfe, 0xfe, 0xfe, 0xfe, 0xfe, 0x7f, 0x7f, 0xfe, 0xfe, 0xfe, 0xfe, 0xfe, 0xfe, 0xfe, 0xfe, 0xfe, 0xfe, 0xfe, 0xfe, 0xfe, 0xfe, 0xfe, 0xfe, 0xfe, 0xfe, 0xfe, 0xfe		 //tile:12
, 0xfe, 0xfe, 0xfe, 0xfe, 0xfe, 0xfe, 0xfe, 0xfe, 0xfe, 0xfe, 0xfe, 0xfe, 0xfe, 0xfe, 0xfe, 0xfe, 0xfe, 0xfe, 0xfe, 0xfe, 0xfe, 0xfe, 0xfe, 0xfe, 0xfe, 0xfe, 0xfe, 0xfe, 0xfe, 0xfe, 0xfe, 0xfe, 0xfe, 0xfe, 0xfe, 0xfe, 0xfe, 0xfe, 0xfe, 0xfe, 0xfe, 0xfe, 0xfe, 0xfe, 0xfe, 0xfe, 0xfe, 0xfe, 0xfe, 0xfe, 0xfe, 0xfe, 0xfe, 0xfe, 0xfe, 0xfe, 0x36, 0x7f, 0xfe, 0xfe, 0xfe, 0xfe, 0xfe, 0xfe, 0xfe, 0x36, 0x7f, 0x7f, 0xfe, 0xfe, 0xfe, 0xfe, 0xfe, 0xfe, 0x36, 0x7f, 0x7f, 0x7f, 0xfe, 0xfe, 0xfe, 0xfe, 0xfe, 0xfe, 0x36, 0xfe, 0xfe, 0xfe, 0xfe, 0xfe, 0xfe, 0xfe, 0xfe, 0xfe, 0xfe, 0xfe		 //tile:13
, 0xfe, 0xfe, 0xfe, 0xfe, 0xfe, 0xfe, 0xfe, 0xfe, 0xfe, 0xfe, 0xfe, 0xfe, 0xfe, 0xfe, 0xfe, 0xfe, 0xfe, 0xfe, 0xfe, 0xfe, 0xfe, 0xfe, 0xfe, 0xfe, 0xfe, 0xfe, 0xfe, 0xfe, 0xfe, 0xfe, 0xfe, 0xfe, 0xfe, 0xfe, 0xfe, 0xfe, 0xfe, 0xfe, 0xfe, 0xfe, 0xfe, 0xfe, 0xfe, 0xfe, 0xfe, 0xfe, 0xfe, 0xfe, 0xfe, 0xfe, 0xfe, 0xfe, 0xfe, 0xfe, 0xfe, 0xfe, 0xfe, 0xfe, 0xfe, 0xfe, 0xfe, 0xfe, 0xfe, 0xfe, 0xfe, 0xfe, 0x7f, 0xfe, 0xfe, 0x1d, 0xfe, 0xfe, 0xfe, 0xfe, 0x36, 0x7f, 0x7f, 0x1d, 0xfe, 0x1d, 0xfe, 0x1d, 0xfe, 0x36, 0x36, 0x7f, 0x1d, 0xfe, 0xfe, 0xfe, 0x1d, 0x1d, 0x36, 0x7f, 0x7f, 0x1d		 //tile:14
, 0xfe, 0xfe, 0xfe, 0xfe, 0xfe, 0xfe, 0xfe, 0xfe, 0xfe, 0xfe, 0xfe, 0xfe, 0xfe, 0xfe, 0xfe, 0xfe, 0xfe, 0xfe, 0xfe, 0xfe, 0xfe, 0xfe, 0xfe, 0xfe, 0xfe, 0xfe, 0xfe, 0xfe, 0xfe, 0xfe, 0xfe, 0xfe, 0xfe, 0xfe, 0xfe, 0xfe, 0xfe, 0xfe, 0xfe, 0xfe, 0xfe, 0xfe, 0xfe, 0xfe, 0xfe, 0xfe, 0xfe, 0xfe, 0xfe, 0xfe, 0xfe, 0xfe, 0xfe, 0xfe, 0xfe, 0xfe, 0xfe, 0xfe, 0xfe, 0x1d, 0xfe, 0xfe, 0x1d, 0xfe, 0xfe, 0xfe, 0xfe, 0xfe, 0xfe, 0x1d, 0xfe, 0x1d, 0xfe, 0x1d, 0xfe, 0xfe, 0xfe, 0xfe, 0xfe, 0xfe, 0xfe, 0xfe, 0x1d, 0x36, 0x7f, 0x7f, 0xfe, 0x1d, 0xfe, 0xfe, 0xfe, 0xfe, 0x36, 0x7f, 0x7f, 0xfe		 //tile:15
, 0xfe, 0xfe, 0xfe, 0xfe, 0xfe, 0xfe, 0xfe, 0xfe, 0xfe, 0xfe, 0xfe, 0xfe, 0xfe, 0xfe, 0xfe, 0xfe, 0xfe, 0xfe, 0xfe, 0xfe, 0xfe, 0xfe, 0xfe, 0xfe, 0xfe, 0xfe, 0xfe, 0xfe, 0xfe, 0xfe, 0xfe, 0xfe, 0xfe, 0xfe, 0xfe, 0xfe, 0xfe, 0xfe, 0xfe, 0xfe, 0xfe, 0xfe, 0xfe, 0xfe, 0xfe, 0xfe, 0xfe, 0xfe, 0xfe, 0xfe, 0x1d, 0xfe, 0xfe, 0xfe, 0xfe, 0x1d, 0xfe, 0xfe, 0xfe, 0xfe, 0xfe, 0xfe, 0x1d, 0xfe, 0x1d, 0xfe, 0xfe, 0xfe, 0xfe, 0xfe, 0xfe, 0xfe, 0xfe, 0x1d, 0xfe, 0xfe, 0x1d, 0xfe, 0xfe, 0xfe, 0xfe, 0xfe, 0xfe, 0xfe, 0xfe, 0xfe, 0xfe, 0xfe, 0xfe, 0xfe, 0xfe, 0xfe, 0x7f, 0x7f, 0xfe, 0xfe		 //tile:16
, 0xfe, 0xfe, 0xfe, 0xfe, 0xfe, 0xfe, 0xfe, 0xfe, 0xfe, 0xfe, 0xfe, 0xfe, 0x1d, 0x1d, 0xfe, 0xfe, 0xfe, 0xfe, 0xfe, 0x1d, 0x6f, 0x65, 0xfe, 0xfe, 0xfe, 0xfe, 0xfe, 0x1d, 0x6f, 0x6f, 0xfe, 0xfe, 0xfe, 0xfe, 0x7, 0x5, 0x5, 0xfe, 0xfe, 0xfe, 0xfe, 0x7, 0x7, 0x7, 0x5, 0x7, 0xfe, 0xfe, 0x6f, 0xfe, 0x7, 0x7, 0xfe, 0xfe, 0x7, 0x6f, 0xfe, 0xfe, 0xb6, 0xb6, 0xfe, 0xfe, 0xfe, 0xfe, 0xfe, 0xfe, 0xff, 0xff, 0xff, 0xfe, 0xfe, 0xfe, 0x5, 0xff, 0xff, 0xfe, 0xff, 0xff, 0xfe, 0xfe, 0x5, 0xff, 0xff, 0xfe, 0xff, 0xff, 0xfe, 0xfe, 0xfe, 0xfe, 0xfe, 0xfe, 0x5, 0x5, 0xfe, 0xfe		 //tile:17
, 0xfe, 0xfe, 0xfe, 0xfe, 0xfe, 0xfe, 0xfe, 0xfe, 0xfe, 0xfe, 0xfe, 0xfe, 0x1d, 0x1d, 0xfe, 0xfe, 0xfe, 0xfe, 0xfe, 0x1d, 0x6f, 0x65, 0xfe, 0xfe, 0xfe, 0xfe, 0xfe, 0x1d, 0x6f, 0x6f, 0xfe, 0xfe, 0xfe, 0xfe, 0xfe, 0x5, 0x5, 0xfe, 0xfe, 0xfe, 0xfe, 0x7, 0x5, 0x7, 0x7, 0xfe, 0x6f, 0xfe, 0x6f, 0xfe, 0xfe, 0x7, 0x7, 0x7, 0xfe, 0xfe, 0xfe, 0xfe, 0xfe, 0xb6, 0xb6, 0xfe, 0xfe, 0xfe, 0xfe, 0xfe, 0xff, 0xff, 0xff, 0xff, 0xfe, 0xfe, 0xfe, 0xff, 0xff, 0xfe, 0xfe, 0xff, 0xff, 0xfe, 0xff, 0xff, 0xfe, 0xfe, 0xfe, 0x5, 0x5, 0xfe, 0x5, 0x5, 0xfe, 0xfe, 0xfe, 0xfe, 0xfe, 0xfe		 //tile:18
, 0xfe, 0xfe, 0xfe, 0xfe, 0xfe, 0xfe, 0xfe, 0xfe, 0xfe, 0xfe, 0xfe, 0xfe, 0x1d, 0x1d, 0xfe, 0xfe, 0xfe, 0xfe, 0xfe, 0x1d, 0x6f, 0x65, 0xfe, 0xfe, 0xfe, 0xfe, 0xfe, 0x1d, 0x6f, 0x6f, 0xfe, 0xfe, 0xfe, 0xfe, 0xfe, 0x5, 0x5, 0xfe, 0xfe, 0xfe, 0xfe, 0xfe, 0x7, 0x7, 0x7, 0xfe, 0xfe, 0xfe, 0xfe, 0x7, 0xfe, 0x7, 0x7, 0x5, 0xfe, 0xfe, 0xfe, 0xfe, 0x7, 0x6f, 0x7, 0xfe, 0x7, 0x6f, 0xfe, 0xfe, 0xfe, 0xff, 0xff, 0xff, 0xfe, 0xfe, 0xfe, 0xfe, 0xff, 0xff, 0xff, 0xff, 0xfe, 0xfe, 0xfe, 0x5, 0xff, 0xff, 0xfe, 0xfe, 0xfe, 0xfe, 0xfe, 0xfe, 0x5, 0xff, 0xfe, 0xfe, 0xfe, 0xfe		 //tile:19
, 0xfe, 0xfe, 0xfe, 0xfe, 0xfe, 0xfe, 0xfe, 0xfe, 0xfe, 0xfe, 0xfe, 0xfe, 0x1d, 0x1d, 0xfe, 0xfe, 0xfe, 0xfe, 0xfe, 0x1d, 0x6f, 0x65, 0xfe, 0xfe, 0xfe, 0xfe, 0xfe, 0x1d, 0x6f, 0x6f, 0xfe, 0xfe, 0xfe, 0xfe, 0x7, 0x5, 0x5, 0xfe, 0xfe, 0xfe, 0xfe, 0x5, 0x7, 0x7, 0x7, 0x7, 0xfe, 0xfe, 0x6f, 0xfe, 0x7, 0x7, 0xfe, 0xfe, 0x7, 0x6f, 0xfe, 0xfe, 0xb6, 0xb6, 0xfe, 0xfe, 0xfe, 0xfe, 0xfe, 0xfe, 0xff, 0xff, 0xff, 0xfe, 0xfe, 0xfe, 0x5, 0xff, 0xff, 0xfe, 0xff, 0xff, 0xfe, 0xfe, 0x5, 0xff, 0xfe, 0xfe, 0xff, 0xff, 0xfe, 0xfe, 0xfe, 0xfe, 0xfe, 0xfe, 0x5, 0x5, 0xfe, 0xfe		 //tile:20
, 0xfe, 0xfe, 0xfe, 0xfe, 0xfe, 0xfe, 0xfe, 0xfe, 0x6f, 0xfe, 0xfe, 0x1d, 0x1d, 0xfe, 0xfe, 0x6f, 0x7, 0xfe, 0x1d, 0x6f, 0x65, 0xfe, 0xfe, 0x7, 0x7, 0xfe, 0x1d, 0x6f, 0x6f, 0xfe, 0x7, 0xfe, 0xfe, 0x7, 0x5, 0x5, 0x5, 0x7, 0xfe, 0xfe, 0xfe, 0xfe, 0x7, 0x7, 0xfe, 0xfe, 0xfe, 0xfe, 0xfe, 0xfe, 0x7, 0x7, 0xfe, 0xfe, 0xfe, 0xfe, 0xfe, 0xfe, 0xb6, 0xb6, 0xff, 0xff, 0xfe, 0xfe, 0xfe, 0xff, 0xff, 0xfe, 0xfe, 0xff, 0xff, 0xfe, 0xfe, 0xff, 0xff, 0xfe, 0xfe, 0xff, 0xff, 0xfe, 0xfe, 0xff, 0xff, 0xfe, 0xfe, 0x5, 0x5, 0xfe, 0xfe, 0x5, 0x5, 0xfe, 0xfe, 0xfe, 0xfe, 0xfe		 //tile:21
, 0xfe, 0xfe, 0xfe, 0xfe, 0xfe, 0xfe, 0xfe, 0xfe, 0xfe, 0xfe, 0xfe, 0xfe, 0x1d, 0xfe, 0xfe, 0xfe, 0x6f, 0xfe, 0xfe, 0x1d, 0x1d, 0x1d, 0xfe, 0x6f, 0x7, 0xfe, 0xfe, 0x1d, 0x1d, 0x1d, 0xfe, 0x7, 0x7, 0xfe, 0xfe, 0x5, 0x5, 0xfe, 0xfe, 0x7, 0xfe, 0x7, 0x7, 0x7, 0x7, 0x7, 0x7, 0xfe, 0xfe, 0xfe, 0xfe, 0x7, 0x7, 0xfe, 0xfe, 0xfe, 0xfe, 0xfe, 0xfe, 0xb6, 0xb6, 0xfe, 0xfe, 0xfe, 0xfe, 0xfe, 0xfe, 0xff, 0xff, 0xff, 0xfe, 0xfe, 0xfe, 0xfe, 0xff, 0xff, 0xfe, 0xff, 0xff, 0xfe, 0xfe, 0xfe, 0xff, 0xff, 0xfe, 0xff, 0xff, 0xfe, 0xfe, 0xfe, 0x5, 0x5, 0xfe, 0x5, 0x5, 0xfe		 //tile:22
, 0xfe, 0xfe, 0xfe, 0xfe, 0x1d, 0xfe, 0xfe, 0x6f, 0xfe, 0xfe, 0xfe, 0x1d, 0x1d, 0x1d, 0xfe, 0x7, 0xfe, 0xfe, 0xfe, 0x1d, 0x1d, 0x1d, 0xfe, 0x7, 0x6f, 0xfe, 0xfe, 0x5, 0x5, 0x5, 0x7, 0xfe, 0x7, 0x7, 0x7, 0x7, 0x7, 0xfe, 0xfe, 0xfe, 0xfe, 0xfe, 0xfe, 0x7, 0x7, 0xb6, 0xfe, 0xfe, 0xfe, 0xfe, 0xfe, 0xb6, 0xb6, 0xff, 0xff, 0xfe, 0xfe, 0xfe, 0xff, 0xff, 0xfe, 0xff, 0xff, 0xff, 0xfe, 0xfe, 0xff, 0xff, 0xfe, 0xfe, 0xff, 0xff, 0xfe, 0xfe, 0xff, 0xff, 0xfe, 0xfe, 0x5, 0x5, 0xfe, 0xfe, 0xff, 0xff, 0xfe, 0xfe, 0xfe, 0xfe, 0xfe, 0xfe, 0x5, 0x5, 0xfe, 0xfe, 0xfe, 0xfe		 //tile:23
, 0xfe, 0xfe, 0xfe, 0xfe, 0xfe, 0xfe, 0xfe, 0xfe, 0xfe, 0x6f, 0xfe, 0xfe, 0x1d, 0x1d, 0xfe, 0x6f, 0xfe, 0x7, 0xfe, 0x1d, 0x6f, 0x65, 0xfe, 0x7, 0xfe, 0x7, 0xfe, 0x1d, 0x6f, 0x6f, 0xfe, 0x7, 0xfe, 0x7, 0x7, 0x5, 0x5, 0x5, 0x7, 0x7, 0xfe, 0xfe, 0x7, 0x7, 0x7, 0x7, 0xfe, 0xfe, 0xfe, 0xfe, 0xfe, 0x7, 0x7, 0xfe, 0xfe, 0xfe, 0xfe, 0xfe, 0xfe, 0xb6, 0xb6, 0xfe, 0xfe, 0xfe, 0xfe, 0xff, 0xff, 0xff, 0xff, 0xfe, 0xfe, 0xfe, 0xff, 0xff, 0xfe, 0xfe, 0xff, 0xfe, 0xfe, 0xfe, 0xff, 0xfe, 0xfe, 0xff, 0xff, 0xfe, 0xfe, 0xfe, 0x5, 0xfe, 0x5, 0xff, 0xfe, 0xfe, 0xfe, 0xfe		 //tile:24
, 0xfe, 0xfe, 0xfe, 0xfe, 0xfe, 0xfe, 0xfe, 0xfe, 0xfe, 0xfe, 0xfe, 0xfe, 0x1d, 0x1d, 0x6f, 0xfe, 0xfe, 0xfe, 0xfe, 0x1d, 0x6f, 0x65, 0x7, 0xfe, 0xfe, 0xfe, 0xfe, 0x1d, 0x6f, 0x6f, 0x7, 0xfe, 0xfe, 0xfe, 0xfe, 0x5, 0x5, 0x7, 0xfe, 0xfe, 0xfe, 0x7, 0x7, 0x7, 0x7, 0xfe, 0xfe, 0xfe, 0x6f, 0xfe, 0xfe, 0x7, 0x7, 0xfe, 0xfe, 0xfe, 0xfe, 0xfe, 0xfe, 0xb6, 0xb6, 0xfe, 0xfe, 0xfe, 0xfe, 0xfe, 0xff, 0xff, 0xff, 0xfe, 0xfe, 0xfe, 0xfe, 0xff, 0xff, 0xfe, 0xff, 0xff, 0xfe, 0xfe, 0xfe, 0xff, 0xff, 0xfe, 0xff, 0xff, 0xfe, 0xfe, 0xfe, 0x5, 0x5, 0xfe, 0x5, 0x5, 0xfe, 0xfe		 //tile:25
, 0xfe, 0xfe, 0xfe, 0xfe, 0xfe, 0xfe, 0xfe, 0xfe, 0xfe, 0x6f, 0xfe, 0xfe, 0x1d, 0xfe, 0xfe, 0xfe, 0xfe, 0x7, 0xfe, 0x1d, 0x1d, 0x1d, 0xfe, 0xfe, 0xfe, 0x7, 0xfe, 0x1d, 0x1d, 0x1d, 0xfe, 0xfe, 0xfe, 0xfe, 0x7, 0x5, 0x5, 0xfe, 0xfe, 0x6f, 0xfe, 0xfe, 0xfe, 0x7, 0x7, 0x7, 0x7, 0xfe, 0xfe, 0xfe, 0xfe, 0x7, 0x7, 0xfe, 0xfe, 0xfe, 0xfe, 0xfe, 0xfe, 0xb6, 0xb6, 0xfe, 0xfe, 0xfe, 0xfe, 0xfe, 0xff, 0xff, 0xff, 0xfe, 0xfe, 0xfe, 0xfe, 0xff, 0xff, 0xfe, 0xff, 0xff, 0xfe, 0xfe, 0xfe, 0xff, 0xff, 0xfe, 0xff, 0xff, 0xfe, 0xfe, 0xfe, 0x5, 0x5, 0xfe, 0x5, 0x5, 0xfe, 0xfe		 //tile:26
, 0xfe, 0xfe, 0xfe, 0xfe, 0xfe, 0xfe, 0xfe, 0xfe, 0xfe, 0xfe, 0xfe, 0xfe, 0xfe, 0xfe, 0xfe, 0xfe, 0xfe, 0xfe, 0xfe, 0xfe, 0xfe, 0x1d, 0x1d, 0xfe, 0xfe, 0xfe, 0xfe, 0xfe, 0x1d, 0x6f, 0x6f, 0xfe, 0xfe, 0xfe, 0xfe, 0x7, 0x5, 0x6f, 0x65, 0xfe, 0xfe, 0xfe, 0x7, 0x7, 0x7, 0x7, 0xfe, 0xfe, 0xfe, 0xfe, 0xff, 0x7, 0x6f, 0xfe, 0x7, 0x6f, 0xfe, 0xfe, 0xb6, 0xff, 0xff, 0xff, 0xfe, 0xfe, 0xfe, 0xff, 0xb6, 0xb6, 0xfe, 0xff, 0xff, 0xfe, 0x5, 0xff, 0xff, 0xfe, 0xff, 0xff, 0xfe, 0xfe, 0x5, 0xfe, 0xfe, 0xfe, 0x5, 0x5, 0xfe, 0xfe, 0xfe, 0xfe, 0xfe, 0xfe, 0xfe, 0xfe, 0xfe, 0xfe		 //tile:27
};

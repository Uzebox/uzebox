/*
 * Transformation file: ../data/sprites-title.gconvert.xml
 * Source image: ../data/sprites-title.png
 * Tile width: 8px
 * Tile height: 12px
 * Output format: (null)
 */
#define SPRITES_TITLE_SIZE 37
const char sprites_title[] PROGMEM={
 0xfe, 0xfe, 0xfe, 0xfe, 0xfe, 0xfe, 0xfe, 0xfe, 0xfe, 0xfe, 0xfe, 0xfe, 0xfe, 0xfe, 0xfe, 0xfe, 0xfe, 0xfe, 0xfe, 0xfe, 0xfe, 0xfe, 0xfe, 0xfe, 0xfe, 0xfe, 0xfe, 0xfe, 0xfe, 0xfe, 0xfe, 0xfe, 0xfe, 0xfe, 0xfe, 0xfe, 0xfe, 0xfe, 0xfe, 0xfe, 0xfe, 0xfe, 0xfe, 0xfe, 0xfe, 0xfe, 0xfe, 0xfe, 0xfe, 0xfe, 0xfe, 0xfe, 0xfe, 0xfe, 0xfe, 0xfe, 0xfe, 0xfe, 0xfe, 0xfe, 0xfe, 0xfe, 0xfe, 0xfe, 0xfe, 0xfe, 0xfe, 0xfe, 0xfe, 0xfe, 0x0, 0x0, 0xfe, 0xfe, 0xfe, 0xfe, 0xfe, 0x0, 0x0, 0x0, 0xfe, 0xfe, 0xfe, 0xfe, 0x0, 0x0, 0xa, 0x64, 0xfe, 0xfe, 0xfe, 0xfe, 0x0, 0x0, 0x53, 0x9		 //tile:0
, 0xfe, 0xfe, 0xfe, 0xfe, 0xfe, 0xfe, 0xfe, 0xfe, 0xfe, 0xfe, 0xfe, 0xfe, 0xfe, 0xfe, 0xfe, 0xfe, 0xfe, 0xfe, 0xfe, 0xfe, 0xfe, 0xfe, 0xfe, 0xfe, 0xfe, 0xfe, 0xfe, 0xfe, 0xfe, 0xfe, 0xfe, 0xfe, 0xfe, 0xfe, 0xfe, 0xfe, 0xfe, 0xfe, 0xfe, 0xfe, 0xfe, 0xfe, 0xfe, 0xfe, 0xfe, 0xfe, 0xfe, 0xfe, 0xfe, 0xfe, 0xfe, 0xfe, 0xfe, 0xfe, 0xfe, 0xfe, 0xfe, 0xfe, 0xfe, 0xfe, 0xfe, 0xfe, 0xfe, 0xfe, 0x0, 0x0, 0x0, 0x0, 0x0, 0x0, 0x0, 0x0, 0x0, 0x0, 0x0, 0x0, 0x0, 0x0, 0x0, 0x0, 0x53, 0x13, 0x13, 0x53, 0x13, 0x13, 0x53, 0x13, 0x5c, 0x64, 0x9c, 0x64, 0x5c, 0x64, 0x5c, 0x5b		 //tile:1
, 0xfe, 0xfe, 0xfe, 0xfe, 0xfe, 0xfe, 0xfe, 0xfe, 0xfe, 0xfe, 0xfe, 0xfe, 0xfe, 0xfe, 0xfe, 0xfe, 0xfe, 0xfe, 0xfe, 0xfe, 0xfe, 0xfe, 0xfe, 0xfe, 0xfe, 0xfe, 0xfe, 0xfe, 0xfe, 0xfe, 0xfe, 0xfe, 0xfe, 0xfe, 0xfe, 0xfe, 0xfe, 0xfe, 0xfe, 0xfe, 0xfe, 0xfe, 0xfe, 0xfe, 0xfe, 0xfe, 0xfe, 0xfe, 0xfe, 0xfe, 0xfe, 0xfe, 0xfe, 0xfe, 0xfe, 0xfe, 0xfe, 0xfe, 0xfe, 0xfe, 0xfe, 0xfe, 0xfe, 0xfe, 0x0, 0x0, 0xfe, 0xfe, 0xfe, 0xfe, 0xfe, 0xfe, 0x0, 0x0, 0x0, 0xfe, 0xfe, 0xfe, 0xfe, 0xfe, 0x5c, 0x9, 0x0, 0x0, 0xfe, 0xfe, 0xfe, 0xfe, 0x52, 0x6d, 0x0, 0x0, 0xfe, 0xfe, 0xfe, 0xfe		 //tile:2
, 0xfe, 0xfe, 0xfe, 0xfe, 0xfe, 0xfe, 0xfe, 0xfe, 0xfe, 0xfe, 0xfe, 0xfe, 0xfe, 0xfe, 0xfe, 0xfe, 0xfe, 0xfe, 0xfe, 0xfe, 0xfe, 0xfe, 0xfe, 0xfe, 0xfe, 0xfe, 0xfe, 0xfe, 0xfe, 0xfe, 0xfe, 0xfe, 0xfe, 0xfe, 0xfe, 0xfe, 0xfe, 0xfe, 0xfe, 0xfe, 0xfe, 0xfe, 0xfe, 0xfe, 0xfe, 0xfe, 0xfe, 0xfe, 0xfe, 0xfe, 0xfe, 0xfe, 0xfe, 0xfe, 0xfe, 0xfe, 0xfe, 0xfe, 0xfe, 0xfe, 0xfe, 0xfe, 0xfe, 0xfe, 0xfe, 0xfe, 0xfe, 0xfe, 0xfe, 0xfe, 0xfe, 0x0, 0xfe, 0xfe, 0xfe, 0xfe, 0xfe, 0xfe, 0x0, 0x0, 0xfe, 0xfe, 0xfe, 0xfe, 0xfe, 0xfe, 0x0, 0x0, 0xfe, 0xfe, 0xfe, 0xfe, 0xfe, 0x0, 0x0, 0x0		 //tile:3
, 0xfe, 0xfe, 0xfe, 0xfe, 0xfe, 0xfe, 0xfe, 0xfe, 0xfe, 0xfe, 0xfe, 0xfe, 0xfe, 0xfe, 0xfe, 0xfe, 0xfe, 0xfe, 0xfe, 0xfe, 0xfe, 0xfe, 0xfe, 0xfe, 0xfe, 0xfe, 0xfe, 0xfe, 0xfe, 0xfe, 0xfe, 0xfe, 0xfe, 0xfe, 0xfe, 0xfe, 0xfe, 0xfe, 0xfe, 0xfe, 0xfe, 0xfe, 0xfe, 0xfe, 0xfe, 0xfe, 0xfe, 0xfe, 0xfe, 0xfe, 0xfe, 0xfe, 0xfe, 0xfe, 0xfe, 0xfe, 0xfe, 0xfe, 0xfe, 0xfe, 0xfe, 0xfe, 0xfe, 0xfe, 0x0, 0x0, 0x0, 0x0, 0x0, 0x0, 0x0, 0x0, 0x0, 0x0, 0x0, 0x0, 0x0, 0x0, 0x0, 0x0, 0x52, 0x1b, 0x53, 0x13, 0x53, 0x13, 0x13, 0x53, 0x66, 0x1, 0x53, 0x64, 0x64, 0x64, 0x64, 0x64		 //tile:4
, 0xfe, 0xfe, 0xfe, 0xfe, 0xfe, 0xfe, 0xfe, 0xfe, 0xfe, 0xfe, 0xfe, 0xfe, 0xfe, 0xfe, 0xfe, 0xfe, 0xfe, 0xfe, 0xfe, 0xfe, 0xfe, 0xfe, 0xfe, 0xfe, 0xfe, 0xfe, 0xfe, 0xfe, 0xfe, 0xfe, 0xfe, 0xfe, 0xfe, 0xfe, 0xfe, 0xfe, 0xfe, 0xfe, 0xfe, 0xfe, 0xfe, 0xfe, 0xfe, 0xfe, 0xfe, 0xfe, 0xfe, 0xfe, 0xfe, 0xfe, 0xfe, 0xfe, 0xfe, 0xfe, 0xfe, 0xfe, 0xfe, 0xfe, 0xfe, 0xfe, 0xfe, 0xfe, 0xfe, 0xfe, 0x0, 0x0, 0x0, 0x0, 0x0, 0xfe, 0xfe, 0xfe, 0x0, 0x0, 0x0, 0x0, 0x0, 0x0, 0xfe, 0xfe, 0x13, 0x13, 0x5b, 0x12, 0x0, 0x0, 0x0, 0xfe, 0x5c, 0x64, 0x41, 0x5b, 0x49, 0x0, 0x0, 0xfe		 //tile:5
, 0xfe, 0xfe, 0xfe, 0xfe, 0xfe, 0xfe, 0xfe, 0xfe, 0xfe, 0xfe, 0xfe, 0xfe, 0xfe, 0xfe, 0xfe, 0xfe, 0xfe, 0xfe, 0xfe, 0xfe, 0xfe, 0xfe, 0xfe, 0xfe, 0xfe, 0xfe, 0xfe, 0xfe, 0xfe, 0xfe, 0xfe, 0xfe, 0xfe, 0xfe, 0xfe, 0xfe, 0xfe, 0xfe, 0xfe, 0xfe, 0xfe, 0xfe, 0xfe, 0xfe, 0xfe, 0xfe, 0xfe, 0xfe, 0xfe, 0xfe, 0xfe, 0xfe, 0xfe, 0xfe, 0xfe, 0xfe, 0xfe, 0xfe, 0xfe, 0xfe, 0xfe, 0xfe, 0xfe, 0xfe, 0xfe, 0x0, 0x0, 0x0, 0x0, 0x0, 0x0, 0x0, 0x0, 0x0, 0x0, 0x0, 0x0, 0x0, 0x0, 0x0, 0x0, 0x0, 0xa, 0x5b, 0x13, 0x13, 0x53, 0x13, 0x0, 0x0, 0xa, 0x9, 0x63, 0x64, 0x64, 0x64		 //tile:6
, 0xfe, 0xfe, 0xfe, 0xfe, 0xfe, 0xfe, 0xfe, 0xfe, 0xfe, 0xfe, 0xfe, 0xfe, 0xfe, 0xfe, 0xfe, 0xfe, 0xfe, 0xfe, 0xfe, 0xfe, 0xfe, 0xfe, 0xfe, 0xfe, 0xfe, 0xfe, 0xfe, 0xfe, 0xfe, 0xfe, 0xfe, 0xfe, 0xfe, 0xfe, 0xfe, 0xfe, 0xfe, 0xfe, 0xfe, 0xfe, 0xfe, 0xfe, 0xfe, 0xfe, 0xfe, 0xfe, 0xfe, 0xfe, 0xfe, 0xfe, 0xfe, 0xfe, 0xfe, 0xfe, 0xfe, 0xfe, 0xfe, 0xfe, 0xfe, 0xfe, 0xfe, 0xfe, 0xfe, 0xfe, 0x0, 0x0, 0x0, 0x0, 0x0, 0x0, 0x0, 0x0, 0x0, 0x0, 0x0, 0x0, 0x0, 0x0, 0x0, 0x0, 0x13, 0x53, 0x13, 0x13, 0x53, 0x13, 0x13, 0x53, 0x9c, 0x64, 0x64, 0xa4, 0x64, 0x5c, 0xa4, 0x64		 //tile:7
, 0xfe, 0xfe, 0xfe, 0xfe, 0xfe, 0xfe, 0xfe, 0xfe, 0xfe, 0xfe, 0xfe, 0xfe, 0xfe, 0xfe, 0xfe, 0xfe, 0xfe, 0xfe, 0xfe, 0xfe, 0xfe, 0xfe, 0xfe, 0xfe, 0xfe, 0xfe, 0xfe, 0xfe, 0xfe, 0xfe, 0xfe, 0xfe, 0xfe, 0xfe, 0xfe, 0xfe, 0xfe, 0xfe, 0xfe, 0xfe, 0xfe, 0xfe, 0xfe, 0xfe, 0xfe, 0xfe, 0xfe, 0xfe, 0xfe, 0xfe, 0xfe, 0xfe, 0xfe, 0xfe, 0xfe, 0xfe, 0xfe, 0xfe, 0xfe, 0xfe, 0xfe, 0xfe, 0xfe, 0xfe, 0x0, 0x0, 0x0, 0x0, 0x0, 0x0, 0x0, 0x0, 0x0, 0x0, 0x0, 0x0, 0x0, 0x0, 0x0, 0x0, 0x13, 0x13, 0x53, 0x13, 0x13, 0x5c, 0x53, 0x0, 0x5c, 0xa4, 0x64, 0x64, 0x5a, 0x9, 0x13, 0x5b		 //tile:8
, 0xfe, 0xfe, 0xfe, 0xfe, 0x0, 0x0, 0xfe, 0xfe, 0xfe, 0xfe, 0xfe, 0x0, 0x1d, 0x1d, 0x0, 0xfe, 0xfe, 0xfe, 0x0, 0x1d, 0x6f, 0x65, 0x0, 0xfe, 0xfe, 0xfe, 0x0, 0x1d, 0x6f, 0x6f, 0x0, 0xfe, 0xfe, 0x0, 0x7, 0x5, 0x5, 0x0, 0xfe, 0xfe, 0x0, 0x7, 0x7, 0x7, 0x5, 0x7, 0x0, 0x0, 0x6f, 0x0, 0x7, 0x7, 0x0, 0x0, 0x7, 0x6f, 0x0, 0x0, 0xb6, 0xb6, 0x0, 0xfe, 0x0, 0x0, 0xfe, 0x0, 0xff, 0xff, 0xff, 0x0, 0xfe, 0xfe, 0x5, 0xff, 0xff, 0x0, 0xff, 0xff, 0x0, 0xfe, 0x5, 0xff, 0xff, 0x0, 0xff, 0xff, 0x0, 0xfe, 0x0, 0x0, 0x0, 0x0, 0x5, 0x5, 0x0, 0xfe		 //tile:9
, 0xfe, 0xfe, 0xfe, 0xfe, 0x0, 0x0, 0xa5, 0x1, 0xfe, 0xfe, 0xfe, 0xfe, 0x0, 0x0, 0xb7, 0x9, 0xfe, 0xfe, 0xfe, 0x0, 0x0, 0x0, 0xad, 0x9, 0xfe, 0xfe, 0xfe, 0x0, 0x0, 0x0, 0x64, 0x9, 0xfe, 0xfe, 0xfe, 0x0, 0x0, 0x52, 0x52, 0x52, 0xfe, 0xfe, 0xfe, 0x0, 0x0, 0x64, 0x9, 0x64, 0xfe, 0xfe, 0xfe, 0x0, 0x0, 0xad, 0x9, 0xb6, 0xfe, 0xfe, 0x0, 0x0, 0x0, 0x65, 0x9, 0xbf, 0xfe, 0xfe, 0x0, 0x0, 0x1, 0x5b, 0x9, 0xbf, 0xfe, 0xfe, 0x0, 0x0, 0xa, 0x12, 0x52, 0xb7, 0xfe, 0xfe, 0x0, 0x0, 0x1c, 0x9, 0x6d, 0x76, 0xfe, 0xfe, 0x0, 0x0, 0x1c, 0x9, 0xb7, 0x6e		 //tile:10
, 0x0, 0x0, 0x0, 0x0, 0x0, 0xfe, 0xfe, 0xfe, 0x9, 0x9, 0x9, 0x0, 0x0, 0x0, 0xfe, 0xfe, 0x13, 0x53, 0x5b, 0x52, 0x0, 0x0, 0x0, 0xfe, 0x65, 0x5b, 0x9, 0x64, 0x49, 0x0, 0x0, 0x0, 0x6e, 0x6f, 0x65, 0x1, 0xb6, 0x0, 0x0, 0x0, 0x26, 0x66, 0x6f, 0x9, 0xa5, 0x0, 0x0, 0x0, 0x66, 0x26, 0x66, 0x9, 0x5c, 0x0, 0x0, 0x0, 0x66, 0x66, 0x65, 0x9, 0x65, 0x0, 0x0, 0x0, 0x66, 0x65, 0x5c, 0x9, 0x6e, 0x0, 0x0, 0x0, 0x6e, 0x66, 0x5c, 0x9, 0x5c, 0x0, 0x0, 0x0, 0x6e, 0x6d, 0x52, 0x9, 0xb, 0x0, 0x0, 0x0, 0x64, 0x64, 0x1, 0x13, 0x9, 0x0, 0x0, 0x0		 //tile:11
, 0x0, 0x0, 0x0, 0x0, 0x0, 0xfe, 0xfe, 0xfe, 0x9, 0x9, 0x9, 0x0, 0x0, 0x0, 0xfe, 0xfe, 0x4b, 0x13, 0x53, 0x5b, 0x0, 0x0, 0xfe, 0xfe, 0x6d, 0x6d, 0x41, 0xb7, 0x0, 0x0, 0xfe, 0xfe, 0xb7, 0xad, 0xa, 0xbf, 0x0, 0x0, 0xfe, 0xfe, 0x6e, 0x52, 0x52, 0xaf, 0x0, 0x0, 0xfe, 0xfe, 0x65, 0x9, 0xae, 0x12, 0x0, 0x0, 0xfe, 0xfe, 0x9, 0xa, 0xb7, 0x0, 0x0, 0x0, 0xfe, 0xfe, 0x12, 0x65, 0x12, 0x0, 0x0, 0xfe, 0xfe, 0xfe, 0x65, 0x52, 0x0, 0x0, 0x0, 0xfe, 0xfe, 0xfe, 0x0, 0x0, 0x0, 0x0, 0xfe, 0xfe, 0xfe, 0xfe, 0x0, 0x0, 0x0, 0xfe, 0xfe, 0xfe, 0xfe, 0xfe		 //tile:12
, 0xfe, 0xfe, 0x0, 0x0, 0x13, 0x9, 0xb7, 0x6e, 0xfe, 0x0, 0x0, 0x0, 0x12, 0x4a, 0x6f, 0x66, 0xfe, 0x0, 0x0, 0x12, 0x9, 0x5c, 0x66, 0x26, 0xfe, 0x0, 0x0, 0x12, 0x1, 0x6d, 0x66, 0x66, 0xfe, 0x0, 0x0, 0xa, 0x9, 0x77, 0x66, 0x66, 0xfe, 0x0, 0x0, 0xa, 0x9, 0xb7, 0x65, 0x65, 0xfe, 0x0, 0x0, 0x9, 0x52, 0xb7, 0x6d, 0x6e, 0xfe, 0x0, 0x0, 0xa, 0x9, 0x6d, 0x65, 0x65, 0xfe, 0x0, 0x0, 0x9, 0x1, 0x9, 0x9, 0xa, 0xfe, 0x0, 0x0, 0x0, 0x9, 0x9, 0x1, 0x1, 0xfe, 0xfe, 0x0, 0x0, 0x0, 0x0, 0x0, 0x0, 0xfe, 0xfe, 0xfe, 0x0, 0x0, 0x0, 0x0, 0x0		 //tile:13
, 0x9, 0x1, 0xa, 0x1c, 0x0, 0x0, 0x0, 0x0, 0x9, 0x12, 0x1c, 0x0, 0x0, 0x0, 0x0, 0x0, 0x5b, 0x4a, 0xa, 0x0, 0x0, 0x0, 0x0, 0x9, 0xbf, 0x52, 0xa, 0x1, 0x0, 0x0, 0x0, 0xa, 0x6e, 0x52, 0xa, 0x0, 0x0, 0x0, 0x0, 0xa, 0x6e, 0x9, 0xa, 0x0, 0x0, 0x0, 0x0, 0xa, 0x12, 0x9, 0x9, 0x0, 0x0, 0x0, 0x0, 0x9, 0x1, 0xa, 0x0, 0x0, 0x0, 0x0, 0x0, 0x1, 0xa, 0x0, 0x0, 0x0, 0xfe, 0x0, 0x0, 0x9, 0x0, 0x0, 0x0, 0xfe, 0xfe, 0x0, 0x0, 0x9, 0x0, 0x0, 0x0, 0xfe, 0xfe, 0x0, 0x0, 0x0, 0x0, 0xfe, 0xfe, 0xfe, 0xfe, 0xfe, 0x0, 0x0		 //tile:14
, 0x65, 0x25, 0x5c, 0x9, 0x1c, 0x0, 0x0, 0x0, 0x65, 0x65, 0x53, 0x9, 0x1b, 0x0, 0x0, 0xfe, 0x26, 0x65, 0x9, 0x9, 0xb, 0x0, 0x0, 0xfe, 0x25, 0x65, 0x9, 0x12, 0x1, 0x0, 0x0, 0xfe, 0x65, 0x5c, 0x1, 0x12, 0x0, 0x0, 0x0, 0xfe, 0x25, 0x5b, 0x9, 0xa, 0x0, 0x0, 0xfe, 0xfe, 0x65, 0xa, 0x9, 0x9, 0x0, 0x0, 0xfe, 0xfe, 0x65, 0x5a, 0x1, 0x9, 0x0, 0x0, 0xfe, 0xfe, 0xa, 0x12, 0x9, 0x9, 0x0, 0x0, 0xfe, 0xfe, 0x9, 0x1, 0x9, 0x9, 0x0, 0x0, 0xfe, 0xfe, 0x0, 0x0, 0x0, 0x0, 0x0, 0x0, 0xfe, 0xfe, 0x0, 0x0, 0x0, 0x0, 0x0, 0xfe, 0xfe, 0xfe		 //tile:15
, 0xfe, 0xfe, 0x0, 0x0, 0x0, 0x0, 0x0, 0x0, 0xfe, 0xfe, 0x0, 0xb6, 0xff, 0xff, 0xff, 0xff, 0xfe, 0xfe, 0x0, 0xff, 0xff, 0xff, 0xff, 0xff, 0xfe, 0x0, 0x49, 0xff, 0xff, 0x52, 0x52, 0x52, 0xfe, 0x0, 0x5b, 0xff, 0xff, 0xa4, 0xa4, 0xa4, 0xfe, 0x0, 0xa4, 0xff, 0xff, 0xff, 0xff, 0xff, 0xfe, 0x0, 0xad, 0xff, 0xf6, 0xad, 0xad, 0xad, 0xfe, 0x0, 0xf6, 0xff, 0x5b, 0x0, 0x0, 0x0, 0x0, 0x0, 0xff, 0xff, 0x52, 0x0, 0xfe, 0xfe, 0x0, 0x52, 0xff, 0xff, 0x0, 0x0, 0xfe, 0xfe, 0x0, 0x0, 0x52, 0x52, 0x0, 0xfe, 0xfe, 0xfe, 0xfe, 0x0, 0x0, 0x0, 0x0, 0xfe, 0xfe, 0xfe		 //tile:16
, 0x0, 0x0, 0x0, 0x0, 0x0, 0x0, 0x0, 0x0, 0xff, 0xff, 0xff, 0xff, 0xff, 0xff, 0xa4, 0x0, 0xff, 0xff, 0xff, 0xff, 0xff, 0xff, 0x5b, 0x0, 0x52, 0xad, 0xff, 0xad, 0x52, 0x52, 0x0, 0x0, 0x0, 0xb6, 0xff, 0xa4, 0x0, 0x0, 0x0, 0xfe, 0x0, 0xff, 0xff, 0x52, 0x0, 0xfe, 0xfe, 0xfe, 0x49, 0xff, 0xff, 0x9, 0x0, 0xfe, 0xfe, 0xfe, 0x52, 0xff, 0xff, 0x0, 0x0, 0xfe, 0xfe, 0xfe, 0xa4, 0xff, 0xad, 0x0, 0xfe, 0xfe, 0xfe, 0xfe, 0xad, 0xff, 0xa4, 0x0, 0xfe, 0xfe, 0xfe, 0xfe, 0x49, 0x52, 0x9, 0x0, 0xfe, 0xfe, 0xfe, 0xfe, 0x0, 0x0, 0x0, 0x0, 0xfe, 0xfe, 0xfe, 0xfe		 //tile:17
, 0x0, 0x0, 0x0, 0xfe, 0xfe, 0xfe, 0xfe, 0xfe, 0x0, 0xb7, 0xb7, 0x0, 0xfe, 0xfe, 0xfe, 0xfe, 0x0, 0xbf, 0x76, 0xb7, 0x0, 0xfe, 0xfe, 0xfe, 0x0, 0xbf, 0x76, 0x76, 0xb7, 0x0, 0xfe, 0xfe, 0x0, 0xbf, 0x76, 0x6e, 0x76, 0x76, 0x0, 0xfe, 0x0, 0xbf, 0x76, 0x76, 0x76, 0x76, 0x76, 0x0, 0x0, 0xbf, 0x6e, 0x76, 0x6e, 0x6e, 0xa, 0x0, 0x0, 0xbf, 0x76, 0x76, 0x6e, 0xa, 0x0, 0xfe, 0x0, 0xbf, 0x6e, 0x76, 0xa, 0x0, 0xfe, 0xfe, 0x0, 0xbf, 0x76, 0xa, 0x0, 0xfe, 0xfe, 0xfe, 0x0, 0xa, 0xa, 0x0, 0xfe, 0xfe, 0xfe, 0xfe, 0x0, 0x0, 0x0, 0xfe, 0xfe, 0xfe, 0xfe, 0xfe		 //tile:18
, 0xfe, 0xfe, 0x0, 0x0, 0x0, 0x0, 0x0, 0xfe, 0xfe, 0xfe, 0x0, 0xad, 0xff, 0xa4, 0x0, 0xfe, 0xfe, 0xfe, 0x0, 0xf6, 0xff, 0xa4, 0x0, 0xfe, 0xfe, 0xfe, 0x0, 0xff, 0xff, 0x52, 0x0, 0xfe, 0xfe, 0x0, 0x52, 0xff, 0xff, 0x9, 0x0, 0xfe, 0xfe, 0x0, 0x5b, 0xff, 0xff, 0x0, 0x0, 0xfe, 0xfe, 0x0, 0xa4, 0xff, 0xad, 0x0, 0x0, 0x0, 0xfe, 0x0, 0xad, 0xff, 0xad, 0x52, 0x52, 0x52, 0xfe, 0x0, 0xff, 0xff, 0xff, 0xff, 0xff, 0xff, 0xfe, 0x0, 0xff, 0xff, 0xff, 0xff, 0xff, 0xff, 0xfe, 0x0, 0x52, 0x52, 0x52, 0x52, 0x52, 0x52, 0xfe, 0x0, 0x0, 0x0, 0x0, 0x0, 0x0, 0x0		 //tile:19
, 0xfe, 0xfe, 0x0, 0x0, 0x0, 0x0, 0x0, 0x0, 0xfe, 0xfe, 0x0, 0x5b, 0xff, 0xff, 0xff, 0xff, 0xfe, 0xfe, 0x0, 0xa4, 0xff, 0xff, 0xff, 0xff, 0xfe, 0xfe, 0x0, 0xad, 0xff, 0xad, 0x52, 0x52, 0xfe, 0xfe, 0x0, 0xf6, 0xff, 0xad, 0xa4, 0xa4, 0xfe, 0x0, 0x0, 0xff, 0xff, 0xff, 0xff, 0xff, 0x0, 0x0, 0x52, 0xff, 0xff, 0xad, 0xad, 0xad, 0x52, 0x9, 0x5b, 0xff, 0xff, 0x52, 0x52, 0x52, 0xff, 0xa4, 0xa4, 0xff, 0xff, 0xff, 0xff, 0xff, 0xff, 0x52, 0xad, 0xff, 0xff, 0xff, 0xff, 0xff, 0x52, 0x0, 0x49, 0x52, 0x52, 0x52, 0x52, 0x52, 0x0, 0x0, 0x0, 0x0, 0x0, 0x0, 0x0, 0x0		 //tile:20
, 0x0, 0x0, 0x0, 0x0, 0x0, 0x0, 0x0, 0x0, 0xff, 0xff, 0xff, 0x0, 0xff, 0xff, 0x5b, 0x0, 0xff, 0xff, 0xf6, 0x9, 0xff, 0xff, 0xa4, 0x0, 0x52, 0x52, 0x49, 0x0, 0xff, 0xff, 0xa4, 0x0, 0x5b, 0x0, 0x0, 0x0, 0xb6, 0xff, 0xad, 0x5b, 0xad, 0x0, 0x0, 0x0, 0xad, 0xff, 0xf6, 0xf6, 0x5b, 0x0, 0x0, 0x0, 0xa4, 0xff, 0xff, 0xff, 0x52, 0x52, 0x0, 0x0, 0x5b, 0xff, 0xff, 0xff, 0xff, 0xb6, 0x0, 0x0, 0x52, 0xff, 0xff, 0xff, 0xff, 0xad, 0x0, 0xfe, 0x0, 0xff, 0xff, 0xad, 0x52, 0x9, 0x0, 0xfe, 0x0, 0x52, 0x52, 0x9, 0x0, 0x0, 0xfe, 0xfe, 0x0, 0x0, 0x0, 0x0		 //tile:21
, 0x0, 0x0, 0x0, 0x0, 0x0, 0x0, 0x0, 0x0, 0x0, 0xff, 0xff, 0xa4, 0xad, 0xff, 0xff, 0xff, 0xa4, 0xff, 0xff, 0x49, 0xf6, 0xff, 0xff, 0xff, 0xff, 0xff, 0xad, 0x0, 0xff, 0xff, 0x5b, 0x52, 0xff, 0xff, 0x52, 0x52, 0xff, 0xff, 0xa4, 0xa4, 0xff, 0xad, 0x0, 0x5b, 0xff, 0xff, 0xff, 0xff, 0xff, 0x52, 0x0, 0xa4, 0xff, 0xff, 0xad, 0xad, 0xad, 0x0, 0x0, 0xad, 0xff, 0xad, 0x52, 0x52, 0x52, 0x0, 0x0, 0xff, 0xff, 0xff, 0xff, 0xff, 0x0, 0x0, 0x9, 0xff, 0xff, 0xff, 0xff, 0xff, 0x0, 0xfe, 0x0, 0x52, 0x52, 0x52, 0x52, 0x52, 0xfe, 0xfe, 0x0, 0x0, 0x0, 0x0, 0x0, 0x0		 //tile:22
, 0x0, 0x0, 0x0, 0x0, 0x0, 0x0, 0x0, 0x0, 0xff, 0xff, 0xff, 0xad, 0x5b, 0xff, 0xff, 0x0, 0xff, 0xff, 0xff, 0xa4, 0xa4, 0xff, 0xad, 0x0, 0x52, 0x52, 0x52, 0x9, 0xad, 0xff, 0xa4, 0x0, 0xa4, 0x52, 0x0, 0x0, 0xff, 0xff, 0x5b, 0x0, 0xff, 0x52, 0x0, 0x0, 0xff, 0xff, 0x52, 0x0, 0xad, 0x9, 0x0, 0x52, 0xff, 0xff, 0x0, 0x0, 0x52, 0x52, 0x9, 0x5b, 0xff, 0xff, 0x52, 0x52, 0xff, 0xff, 0xa4, 0xa4, 0xff, 0xff, 0xff, 0xff, 0xff, 0xff, 0x52, 0xad, 0xff, 0xff, 0xff, 0xff, 0x52, 0x52, 0x0, 0x49, 0x52, 0x52, 0x52, 0x52, 0x0, 0x0, 0x0, 0x0, 0x0, 0x0, 0x0, 0x0		 //tile:23
, 0xfe, 0xfe, 0xfe, 0xfe, 0xfe, 0xfe, 0xfe, 0xfe, 0xfe, 0xfe, 0xfe, 0xfe, 0x0, 0x0, 0x0, 0xfe, 0xfe, 0xfe, 0xfe, 0x0, 0x0, 0x52, 0x49, 0x0, 0xfe, 0xfe, 0xfe, 0x0, 0x5b, 0xff, 0xad, 0x0, 0xfe, 0xfe, 0xfe, 0x0, 0xa4, 0xff, 0xa4, 0x0, 0xfe, 0xfe, 0xfe, 0x0, 0x0, 0x0, 0x0, 0x0, 0x0, 0x0, 0x0, 0xfe, 0xfe, 0xfe, 0xfe, 0xfe, 0x52, 0x52, 0x52, 0x0, 0x0, 0x0, 0x0, 0xfe, 0xff, 0xff, 0xb6, 0x49, 0xad, 0xa4, 0x0, 0xfe, 0xff, 0xff, 0xa4, 0x5b, 0xff, 0xa4, 0x0, 0xfe, 0x52, 0x52, 0x9, 0x9, 0x52, 0x9, 0x0, 0xfe, 0x0, 0x0, 0x0, 0x0, 0x0, 0x0, 0xfe, 0xfe		 //tile:24
, 0xfe, 0x0, 0x0, 0x0, 0x0, 0x0, 0x0, 0x0, 0xfe, 0x0, 0x5b, 0x5b, 0x5b, 0x5b, 0x5b, 0x9, 0x0, 0x0, 0x76, 0x76, 0x76, 0x76, 0x76, 0x12, 0x0, 0x12, 0x76, 0x76, 0x76, 0x76, 0x76, 0x0, 0x0, 0x12, 0x76, 0x5b, 0x0, 0x76, 0x76, 0x0, 0x0, 0x5b, 0x76, 0x0, 0x0, 0x76, 0x6d, 0x0, 0x0, 0x5b, 0x76, 0x0, 0x0, 0x76, 0x6d, 0x0, 0x0, 0x6d, 0x76, 0x0, 0x5b, 0x76, 0x64, 0x0, 0x0, 0x6d, 0x76, 0x76, 0x6d, 0x76, 0x5b, 0x0, 0x0, 0x76, 0x76, 0x76, 0x76, 0x76, 0x12, 0x0, 0x0, 0x5b, 0x5b, 0x5b, 0x5b, 0x5b, 0x9, 0x0, 0x0, 0x0, 0x0, 0x0, 0x0, 0x0, 0x0, 0xfe		 //tile:25
, 0xfe, 0xfe, 0x0, 0x0, 0x0, 0x0, 0x0, 0xfe, 0xfe, 0x0, 0x9, 0x5b, 0x5b, 0x12, 0x0, 0xfe, 0xfe, 0x0, 0x5b, 0x76, 0x76, 0x5b, 0x0, 0xfe, 0xfe, 0x0, 0x12, 0x76, 0x76, 0x12, 0x0, 0xfe, 0xfe, 0x0, 0x0, 0x5b, 0x76, 0x12, 0x0, 0xfe, 0xfe, 0xfe, 0x0, 0x64, 0x76, 0x0, 0xfe, 0xfe, 0xfe, 0xfe, 0x0, 0x6d, 0x76, 0x0, 0xfe, 0xfe, 0xfe, 0xfe, 0x0, 0x76, 0x6d, 0x0, 0xfe, 0xfe, 0xfe, 0xfe, 0x0, 0x76, 0x6d, 0x0, 0xfe, 0xfe, 0xfe, 0xfe, 0x9, 0x76, 0x64, 0x0, 0xfe, 0xfe, 0xfe, 0xfe, 0x9, 0x5b, 0x12, 0x0, 0xfe, 0xfe, 0xfe, 0xfe, 0x0, 0x0, 0x0, 0x0, 0xfe, 0xfe		 //tile:26
, 0xfe, 0x0, 0x0, 0x0, 0x0, 0x0, 0x0, 0x0, 0xfe, 0x0, 0x76, 0x76, 0x76, 0x76, 0x76, 0x5b, 0xfe, 0x0, 0x76, 0x76, 0x76, 0x76, 0x76, 0x12, 0xfe, 0x0, 0x0, 0x0, 0x0, 0x64, 0x76, 0x9, 0x0, 0x9, 0x5b, 0x5b, 0x5b, 0x6d, 0x76, 0x0, 0x0, 0x12, 0x76, 0x76, 0x76, 0x76, 0x76, 0x0, 0x0, 0x5b, 0x76, 0x6d, 0x6d, 0x6d, 0x64, 0x0, 0x0, 0x64, 0x76, 0x0, 0x0, 0x0, 0x9, 0x0, 0x0, 0x6d, 0x76, 0x76, 0x76, 0x76, 0x5b, 0x0, 0x0, 0x6d, 0x76, 0x76, 0x76, 0x76, 0x5b, 0x0, 0x0, 0x12, 0x12, 0x12, 0x12, 0x12, 0x0, 0x0, 0x0, 0x0, 0x0, 0x0, 0x0, 0x0, 0x0, 0xfe		 //tile:27
, 0xfe, 0x0, 0x0, 0x0, 0x0, 0x0, 0x0, 0x0, 0x0, 0x0, 0x6d, 0x6d, 0x6d, 0x6d, 0x6d, 0x9, 0x0, 0x12, 0x76, 0x76, 0x76, 0x76, 0x76, 0x0, 0x0, 0x9, 0x5b, 0x5b, 0x76, 0x76, 0x6d, 0x0, 0xfe, 0x0, 0x0, 0x0, 0x76, 0x76, 0x9, 0x0, 0xfe, 0x0, 0x12, 0x76, 0x76, 0x12, 0x0, 0xfe, 0xfe, 0x0, 0x9, 0x76, 0x76, 0x5b, 0x0, 0x0, 0x0, 0x0, 0x0, 0x0, 0x76, 0x76, 0x9, 0x0, 0x0, 0x76, 0x76, 0x76, 0x76, 0x76, 0x12, 0x0, 0x0, 0x76, 0x76, 0x76, 0x76, 0x76, 0x12, 0x0, 0x0, 0x12, 0x12, 0x12, 0x12, 0x12, 0x0, 0x0, 0x0, 0x0, 0x0, 0x0, 0x0, 0x0, 0x0, 0xfe		 //tile:28
, 0xfe, 0x0, 0x0, 0x0, 0x0, 0x0, 0x0, 0x0, 0x0, 0x0, 0x6d, 0x12, 0x0, 0x12, 0x6d, 0x9, 0x0, 0x12, 0x76, 0x5b, 0x0, 0x64, 0x76, 0x0, 0x0, 0x12, 0x76, 0x12, 0x0, 0x6d, 0x76, 0x0, 0x0, 0x5b, 0x76, 0x12, 0x0, 0x76, 0x6d, 0x0, 0x0, 0x64, 0x76, 0x0, 0x0, 0x76, 0x6d, 0x0, 0x0, 0x6d, 0x76, 0x6d, 0x6d, 0x76, 0x5b, 0x0, 0x0, 0x6d, 0x76, 0x76, 0x76, 0x76, 0x5b, 0x0, 0x0, 0x5b, 0x5b, 0x5b, 0x6d, 0x76, 0x12, 0x0, 0x0, 0x0, 0x0, 0x0, 0x5b, 0x76, 0x12, 0x0, 0xfe, 0xfe, 0xfe, 0x0, 0x9, 0x12, 0x0, 0x0, 0xfe, 0xfe, 0xfe, 0x0, 0x0, 0x0, 0x0, 0xfe		 //tile:29
, 0xfe, 0x0, 0x0, 0x0, 0x0, 0x0, 0x0, 0x0, 0x0, 0x9, 0x5b, 0x5b, 0x5b, 0x5b, 0x5b, 0x0, 0x0, 0x5b, 0x76, 0x76, 0x76, 0x76, 0x6d, 0x0, 0x0, 0x64, 0x76, 0x6d, 0x6d, 0x6d, 0x64, 0x0, 0x0, 0x6d, 0x76, 0x0, 0x0, 0x0, 0x9, 0x0, 0x0, 0x6d, 0x76, 0x76, 0x76, 0x76, 0x5b, 0x0, 0x0, 0x76, 0x76, 0x76, 0x76, 0x76, 0x12, 0x0, 0x0, 0x0, 0x0, 0x0, 0x5b, 0x76, 0x9, 0x0, 0x12, 0x76, 0x76, 0x76, 0x76, 0x76, 0x0, 0x0, 0x12, 0x76, 0x76, 0x76, 0x76, 0x76, 0x0, 0x0, 0x9, 0x12, 0x12, 0x12, 0x12, 0x9, 0x0, 0xfe, 0x0, 0x0, 0x0, 0x0, 0x0, 0x0, 0x0, 0xfe		 //tile:30
, 0xfe, 0x0, 0x0, 0x0, 0x0, 0x0, 0x0, 0x0, 0x0, 0x0, 0x6d, 0x6d, 0x6d, 0x6d, 0x6d, 0x9, 0x0, 0x12, 0x76, 0x76, 0x76, 0x76, 0x76, 0x0, 0x0, 0x12, 0x76, 0x64, 0x5b, 0x5b, 0x5b, 0x0, 0x0, 0x5b, 0x76, 0x5b, 0x0, 0x0, 0x0, 0x0, 0x0, 0x5b, 0x76, 0x76, 0x76, 0x76, 0x6d, 0x0, 0x0, 0x6d, 0x76, 0x76, 0x76, 0x76, 0x64, 0x0, 0x0, 0x6d, 0x76, 0x0, 0x0, 0x76, 0x5b, 0x0, 0x0, 0x76, 0x76, 0x0, 0x0, 0x76, 0x12, 0x0, 0x0, 0x76, 0x76, 0x76, 0x76, 0x76, 0x12, 0x0, 0x9, 0x5b, 0x5b, 0x5b, 0x5b, 0x5b, 0x0, 0x0, 0x0, 0x0, 0x0, 0x0, 0x0, 0x0, 0x0, 0xfe		 //tile:31
, 0x0, 0x0, 0x0, 0x0, 0x0, 0x0, 0x0, 0x0, 0x0, 0x76, 0x76, 0x76, 0x76, 0x76, 0x5b, 0x0, 0x0, 0x76, 0x76, 0x76, 0x76, 0x76, 0x12, 0x0, 0x0, 0x5b, 0x5b, 0x5b, 0x6d, 0x76, 0x12, 0x0, 0x0, 0x0, 0x0, 0x0, 0x64, 0x76, 0x0, 0x0, 0xfe, 0xfe, 0xfe, 0x0, 0x6d, 0x76, 0x0, 0xfe, 0xfe, 0xfe, 0xfe, 0x0, 0x76, 0x6d, 0x0, 0xfe, 0xfe, 0xfe, 0xfe, 0x0, 0x76, 0x6d, 0x0, 0xfe, 0xfe, 0xfe, 0x0, 0x9, 0x76, 0x64, 0x0, 0xfe, 0xfe, 0xfe, 0x0, 0x12, 0x76, 0x5b, 0x0, 0xfe, 0xfe, 0xfe, 0x0, 0x9, 0x5b, 0x9, 0x0, 0xfe, 0xfe, 0xfe, 0x0, 0x0, 0x0, 0x0, 0x0, 0xfe		 //tile:32
, 0xfe, 0x0, 0x0, 0x0, 0x0, 0x0, 0x0, 0x0, 0xfe, 0x0, 0x6d, 0x76, 0x76, 0x76, 0x76, 0x5b, 0xfe, 0x0, 0x76, 0x76, 0x76, 0x76, 0x76, 0x5b, 0xfe, 0x0, 0x76, 0x6d, 0x0, 0x64, 0x76, 0x12, 0x0, 0x9, 0x76, 0x6d, 0x0, 0x6d, 0x76, 0x9, 0x0, 0x0, 0x76, 0x76, 0x76, 0x76, 0x6d, 0x0, 0x0, 0x12, 0x76, 0x6d, 0x6d, 0x76, 0x76, 0x0, 0x0, 0x5b, 0x76, 0x0, 0x0, 0x76, 0x6d, 0x0, 0x0, 0x64, 0x76, 0x76, 0x76, 0x76, 0x64, 0x0, 0x0, 0x6d, 0x76, 0x76, 0x76, 0x76, 0x5b, 0x0, 0x0, 0x9, 0x12, 0x12, 0x12, 0x12, 0x9, 0x0, 0x0, 0x0, 0x0, 0x0, 0x0, 0x0, 0x0, 0xfe		 //tile:33
, 0xfe, 0x0, 0x0, 0x0, 0x0, 0x0, 0x0, 0x0, 0xfe, 0x0, 0x6d, 0x76, 0x76, 0x76, 0x76, 0x5b, 0xfe, 0x0, 0x76, 0x76, 0x76, 0x76, 0x76, 0x5b, 0xfe, 0x0, 0x76, 0x6d, 0x0, 0x64, 0x76, 0x12, 0xfe, 0x9, 0x76, 0x6d, 0x0, 0x6d, 0x76, 0x9, 0xfe, 0x12, 0x76, 0x76, 0x76, 0x76, 0x76, 0x0, 0xfe, 0x9, 0x6d, 0x6d, 0x6d, 0x76, 0x76, 0x0, 0x0, 0x9, 0x0, 0x0, 0x0, 0x76, 0x6d, 0x0, 0x0, 0x64, 0x76, 0x76, 0x76, 0x76, 0x64, 0x0, 0x0, 0x6d, 0x76, 0x76, 0x76, 0x76, 0x5b, 0x0, 0x0, 0x9, 0x12, 0x12, 0x12, 0x12, 0x9, 0x0, 0xfe, 0x0, 0x0, 0x0, 0x0, 0x0, 0x0, 0xfe		 //tile:34
, 0xfe, 0xfe, 0xfe, 0xfe, 0xfe, 0x0, 0x0, 0x0, 0xfe, 0xfe, 0xfe, 0xfe, 0xfe, 0x0, 0x21, 0x0, 0xfe, 0xfe, 0xfe, 0xfe, 0x0, 0x19, 0x31, 0x0, 0xfe, 0xfe, 0xfe, 0xfe, 0x0, 0x31, 0x31, 0x0, 0xfe, 0xfe, 0xfe, 0x0, 0x19, 0x31, 0x31, 0x0, 0x0, 0x0, 0xfe, 0x0, 0x31, 0x31, 0x11, 0x0, 0x0, 0x29, 0x0, 0x0, 0x31, 0x21, 0x0, 0xfe, 0x21, 0x31, 0x21, 0x21, 0x31, 0x0, 0xfe, 0xfe, 0x8, 0x29, 0x31, 0x31, 0x19, 0x0, 0xfe, 0xfe, 0x0, 0x8, 0x31, 0x31, 0x8, 0xfe, 0xfe, 0xfe, 0xfe, 0x0, 0x21, 0x21, 0x0, 0xfe, 0xfe, 0xfe, 0xfe, 0xfe, 0x0, 0x8, 0xfe, 0xfe, 0xfe, 0xfe		 //tile:35
, 0xfe, 0xfe, 0xfe, 0xfe, 0xfe, 0xfe, 0xfe, 0xfe, 0xfe, 0xfe, 0xfe, 0xfe, 0xfe, 0xfe, 0xfe, 0xfe, 0xfe, 0xfe, 0xfe, 0xfe, 0xfe, 0xfe, 0xfe, 0xfe, 0xfe, 0xfe, 0xfe, 0xfe, 0xfe, 0xfe, 0xfe, 0xfe, 0xfe, 0xfe, 0xfe, 0xfe, 0xfe, 0xfe, 0xfe, 0xfe, 0xfe, 0xfe, 0xfe, 0xfe, 0xfe, 0xfe, 0xfe, 0xfe, 0xfe, 0xfe, 0xfe, 0xfe, 0xfe, 0xfe, 0xfe, 0xfe, 0xfe, 0xfe, 0xfe, 0xfe, 0xfe, 0xfe, 0xfe, 0xfe, 0xfe, 0xfe, 0xfe, 0xfe, 0xfe, 0xfe, 0xfe, 0xfe, 0xfe, 0xfe, 0xfe, 0xfe, 0xfe, 0xfe, 0xfe, 0xfe, 0xfe, 0xfe, 0xfe, 0xfe, 0xfe, 0xfe, 0xfe, 0xfe, 0xfe, 0xfe, 0xfe, 0xfe, 0xfe, 0xfe, 0xfe, 0xfe		 //tile:36
};

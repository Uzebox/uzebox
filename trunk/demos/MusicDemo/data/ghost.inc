//*********************************//
// MIDI file: C:\Documents and Settings\Admin\My Documents\projet\atmel\uzebox2\music\ghost.mid
//*********************************//
const char song_ghost[] PROGMEM ={
0x00,0xff,0x06,0x01,0x53,0x00,0xc0,0x00,0x00,0xc1,0x00,0x00,0xc2,0x00,0x00,0x92,0x2c,0x7f,0x00,0xc3,0x07,0x12,0x92,0x2f,0x7f,0x12,0x90,0x44,0x7f,0x00,0x91,0x3f,
0x7f,0x00,0x92,0x33,0x7f,0x13,0x27,0x7f,0x12,0x2c,0x7f,0x12,0x33,0x7f,0x13,0x90,0x43,0x7f,0x00,0x91,0x3f,0x7f,0x00,0x92,0x33,0x7f,0x24,0x90,0x42,0x7f,0x00,0x91,
0x3f,0x7f,0x00,0x92,0x2c,0x7f,0x13,0x2f,0x7f,0x12,0x33,0x7f,0x12,0x27,0x7f,0x13,0x90,0x41,0x7f,0x00,0x91,0x3f,0x7f,0x00,0x92,0x2c,0x7f,0x12,0x33,0x7f,0x13,0x90,
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0x2e,0x7f,0x12,0x90,0x37,0x7f,0x00,0x91,0x30,0x7f,0x00,0x92,0x2b,0x7f,0x13,0xff,0x06,0x01,0x45,0x00,0xff,0x2f,0x00 };

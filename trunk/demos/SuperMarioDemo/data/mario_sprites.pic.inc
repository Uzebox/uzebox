//picture: smw_sprites.raw
//Horizontal Tiles=36
//Vertical Tiles=3
//Tile Width=8
//Tile Height=8
#define MARIO_SPRITES_TILESET_SIZE 63

const char mario_sprites_tileset[] PROGMEM ={
 0xfe, 0xfe, 0xfe, 0xfe, 0xfe, 0xfe, 0xfe, 0xfe, 0xfe, 0xfe, 0xfe, 0xfe, 0xfe, 0xfe, 0xfe, 0xfe, 0xfe, 0xfe, 0xfe, 0xfe, 0xfe, 0xfe, 0xfe, 0xfe, 0xfe, 0xfe, 0xfe, 0xfe, 0xfe, 0xfe, 0xfe, 0x02, 0xfe, 0xfe, 0xfe, 0xfe, 0xfe, 0x02, 0x02, 0x57, 0xfe, 0xfe, 0xfe, 0xfe, 0x02, 0x57, 0x57, 0x4d, 0xfe, 0xfe, 0xfe, 0x02, 0x4d, 0x57, 0x4d, 0x4d, 0xfe, 0xfe, 0x02, 0x4d, 0x4d, 0x4d, 0x00, 0x00		 //tile:0 
, 0xfe, 0xfe, 0xfe, 0xfe, 0xfe, 0xfe, 0xfe, 0xfe, 0xfe, 0xfe, 0xfe, 0xfe, 0xfe, 0xfe, 0xfe, 0xfe, 0xfe, 0xfe, 0xfe, 0xfe, 0xfe, 0xfe, 0xfe, 0xfe, 0x02, 0x02, 0x02, 0x02, 0xfe, 0xfe, 0xfe, 0xfe, 0x57, 0x57, 0x77, 0x57, 0x02, 0xfe, 0xfe, 0xfe, 0x4d, 0x66, 0x77, 0xff, 0x02, 0xfe, 0xfe, 0xfe, 0x00, 0x00, 0x00, 0x00, 0x00, 0x00, 0xfe, 0xfe, 0x00, 0x00, 0x00, 0x00, 0x00, 0x00, 0x00, 0xfe		 //tile:1 
, 0xfe, 0xfe, 0xfe, 0xfe, 0xfe, 0xfe, 0xfe, 0xfe, 0xfe, 0xfe, 0xfe, 0xfe, 0xfe, 0xfe, 0xfe, 0xfe, 0xfe, 0xfe, 0xfe, 0xfe, 0xfe, 0xfe, 0xfe, 0xfe, 0x02, 0x02, 0x02, 0x02, 0xfe, 0xfe, 0xfe, 0xfe, 0x57, 0x57, 0xbf, 0x57, 0x02, 0xfe, 0xfe, 0xfe, 0x4d, 0x37, 0xbf, 0xff, 0x02, 0xfe, 0xfe, 0xfe, 0x00, 0x00, 0x00, 0x00, 0x00, 0x00, 0xfe, 0xfe, 0x00, 0x00, 0x00, 0x00, 0x00, 0x00, 0x00, 0xfe		 //tile:2 
, 0xfe, 0xfe, 0xfe, 0xfe, 0x14, 0x14, 0xfe, 0xfe, 0xfe, 0xfe, 0xfe, 0x14, 0xff, 0xff, 0x14, 0xfe, 0xfe, 0xfe, 0x14, 0xff, 0xff, 0xff, 0xff, 0x14, 0x02, 0x02, 0x02, 0x02, 0xff, 0xff, 0xff, 0x14, 0x57, 0x57, 0x77, 0x57, 0x02, 0xff, 0x14, 0xfe, 0x4d, 0x66, 0x77, 0xff, 0x02, 0x14, 0x02, 0xfe, 0x00, 0x00, 0x00, 0x00, 0x00, 0x00, 0xfe, 0xfe, 0x00, 0x00, 0x00, 0x00, 0x00, 0x00, 0x00, 0xfe		 //tile:3 
, 0xfe, 0xfe, 0xfe, 0xfe, 0xfe, 0xfe, 0xfe, 0xfe, 0xfe, 0xfe, 0xfe, 0xfe, 0xfe, 0xfe, 0xfe, 0xfe, 0xfe, 0xfe, 0xfe, 0xfe, 0xfe, 0xfe, 0xfe, 0xfe, 0xfe, 0xfe, 0xfe, 0xfe, 0x02, 0x02, 0x02, 0x02, 0xfe, 0xfe, 0xfe, 0x02, 0x57, 0x77, 0x57, 0x57, 0xfe, 0xfe, 0xfe, 0x02, 0xff, 0x77, 0x66, 0x4d, 0xfe, 0xfe, 0x00, 0x00, 0x00, 0x00, 0x00, 0x00, 0xfe, 0x00, 0x00, 0x00, 0x00, 0x00, 0x00, 0x00		 //tile:4 
, 0xfe, 0xfe, 0xfe, 0xfe, 0xfe, 0xfe, 0xfe, 0xfe, 0xfe, 0xfe, 0xfe, 0xfe, 0xfe, 0xfe, 0xfe, 0xfe, 0xfe, 0xfe, 0xfe, 0xfe, 0xfe, 0xfe, 0xfe, 0xfe, 0x02, 0xfe, 0xfe, 0xfe, 0xfe, 0xfe, 0xfe, 0xfe, 0x57, 0x02, 0x02, 0xfe, 0xfe, 0xfe, 0xfe, 0xfe, 0x4d, 0x57, 0x57, 0x02, 0xfe, 0xfe, 0xfe, 0xfe, 0x4d, 0x4d, 0x57, 0x4d, 0x02, 0xfe, 0xfe, 0xfe, 0x00, 0x00, 0x4d, 0x4d, 0x4d, 0x02, 0xfe, 0xfe		 //tile:5 
, 0xfe, 0xfe, 0xfe, 0xfe, 0xfe, 0xfe, 0xfe, 0xfe, 0xfe, 0xfe, 0xfe, 0xfe, 0xfe, 0xfe, 0xfe, 0xfe, 0xfe, 0xfe, 0xfe, 0xfe, 0xfe, 0xfe, 0xfe, 0xfe, 0xfe, 0xfe, 0xfe, 0xfe, 0x02, 0x02, 0x02, 0x02, 0xfe, 0xfe, 0xfe, 0x02, 0x57, 0xbf, 0x57, 0x57, 0xfe, 0xfe, 0xfe, 0x02, 0xff, 0xbf, 0x37, 0x4d, 0xfe, 0xfe, 0x00, 0x00, 0x00, 0x00, 0x00, 0x00, 0xfe, 0x00, 0x00, 0x00, 0x00, 0x00, 0x00, 0x00		 //tile:6 
, 0xfe, 0xfe, 0x14, 0x14, 0xfe, 0xfe, 0xfe, 0xfe, 0xfe, 0x14, 0xff, 0xff, 0x14, 0xfe, 0xfe, 0xfe, 0x14, 0xff, 0xff, 0xff, 0xff, 0x14, 0xfe, 0xfe, 0x14, 0xff, 0xff, 0xff, 0x02, 0x02, 0x02, 0x02, 0xfe, 0x14, 0xff, 0x02, 0x57, 0x77, 0x57, 0x57, 0xfe, 0x02, 0x14, 0x02, 0xff, 0x77, 0x66, 0x4d, 0xfe, 0xfe, 0x00, 0x00, 0x00, 0x00, 0x00, 0x00, 0xfe, 0x00, 0x00, 0x00, 0x00, 0x00, 0x00, 0x00		 //tile:7 
, 0xfe, 0xfe, 0xfe, 0xfe, 0xfe, 0xfe, 0x00, 0x00, 0xfe, 0xfe, 0xfe, 0xfe, 0x00, 0x00, 0x0d, 0x0d, 0xfe, 0x00, 0x00, 0x00, 0x0d, 0x00, 0x00, 0x00, 0xfe, 0x00, 0x00, 0x0d, 0x00, 0x00, 0x0d, 0x0d, 0xfe, 0xff, 0x00, 0x00, 0x00, 0xff, 0x0d, 0x0d, 0xfe, 0xff, 0xff, 0x00, 0xff, 0xff, 0xff, 0x0d, 0x00, 0xff, 0x00, 0x0d, 0x00, 0xff, 0xff, 0x0d, 0x00, 0xff, 0xff, 0x0d, 0xff, 0xff, 0x0d, 0x0d		 //tile:8 
, 0x00, 0x00, 0xfe, 0xfe, 0xfe, 0xfe, 0xfe, 0xfe, 0x0d, 0x0d, 0x00, 0x00, 0xfe, 0xfe, 0xfe, 0xfe, 0x0d, 0x0d, 0x0d, 0x27, 0x00, 0xfe, 0xfe, 0xfe, 0x0d, 0x0d, 0x27, 0xff, 0x27, 0x00, 0xfe, 0xfe, 0x0d, 0x0d, 0x0d, 0x27, 0x0d, 0x0d, 0x00, 0xfe, 0x0d, 0x0d, 0x0d, 0x0d, 0x0d, 0x0d, 0x00, 0xfe, 0x0d, 0x0d, 0x0d, 0x0d, 0x0d, 0x0d, 0x0d, 0x00, 0x0d, 0x0d, 0x0d, 0x0d, 0x0d, 0x0d, 0x0d, 0x00		 //tile:9 
, 0xfe, 0xfe, 0xfe, 0xfe, 0xfe, 0xfe, 0xfe, 0xfe, 0xfe, 0xfe, 0xfe, 0xfe, 0xfe, 0xfe, 0x00, 0x00, 0xfe, 0xfe, 0xfe, 0xfe, 0x00, 0x00, 0x0d, 0x0d, 0x00, 0x00, 0x00, 0x00, 0x0d, 0x0d, 0x0d, 0x00, 0xfe, 0xfe, 0x00, 0x00, 0x00, 0x0d, 0x00, 0x00, 0xfe, 0x00, 0x0d, 0xff, 0x00, 0x00, 0x00, 0xff, 0xfe, 0x00, 0xff, 0xff, 0xff, 0x00, 0xff, 0xff, 0x00, 0x0d, 0xff, 0xff, 0x00, 0x0d, 0x00, 0xff		 //tile:10 
, 0xfe, 0xfe, 0xfe, 0xfe, 0xfe, 0xfe, 0xfe, 0xfe, 0x00, 0x00, 0xfe, 0xfe, 0xfe, 0xfe, 0xfe, 0xfe, 0x0d, 0x0d, 0x00, 0x00, 0xfe, 0xfe, 0xfe, 0xfe, 0x00, 0x00, 0x00, 0x27, 0x00, 0xfe, 0xfe, 0xfe, 0x00, 0x0d, 0x27, 0xff, 0x27, 0x00, 0xfe, 0xfe, 0x0d, 0x0d, 0x0d, 0x27, 0x0d, 0x0d, 0x00, 0xfe, 0xff, 0x0d, 0x0d, 0x0d, 0x0d, 0x0d, 0x00, 0xfe, 0xff, 0x0d, 0x0d, 0x0d, 0x0d, 0x0d, 0x0d, 0x00		 //tile:11 
, 0xfe, 0xfe, 0xfe, 0xfe, 0xfe, 0xfe, 0x00, 0x00, 0xfe, 0xfe, 0xfe, 0xfe, 0x00, 0x00, 0x0d, 0x0d, 0xfe, 0xfe, 0xfe, 0x00, 0x27, 0x0d, 0x0d, 0x0d, 0xfe, 0xfe, 0x00, 0x27, 0xff, 0x27, 0x0d, 0x0d, 0xfe, 0x00, 0x0d, 0x0d, 0x27, 0x0d, 0x0d, 0x0d, 0xfe, 0x00, 0x0d, 0x0d, 0x0d, 0x0d, 0x0d, 0x0d, 0x00, 0x0d, 0x0d, 0x0d, 0x0d, 0x0d, 0x0d, 0x0d, 0x00, 0x0d, 0x0d, 0x0d, 0x0d, 0x0d, 0x0d, 0x0d		 //tile:12 
, 0x00, 0x00, 0xfe, 0xfe, 0xfe, 0xfe, 0xfe, 0xfe, 0x0d, 0x0d, 0x00, 0x00, 0xfe, 0xfe, 0xfe, 0xfe, 0x00, 0x00, 0x00, 0x0d, 0x00, 0x00, 0x00, 0xfe, 0x0d, 0x0d, 0x00, 0x00, 0x0d, 0x00, 0x00, 0xfe, 0x0d, 0x0d, 0xff, 0x00, 0x00, 0x00, 0xff, 0xfe, 0x0d, 0xff, 0xff, 0xff, 0x00, 0xff, 0xff, 0xfe, 0x0d, 0xff, 0xff, 0x00, 0x0d, 0x00, 0xff, 0x00, 0x0d, 0x0d, 0xff, 0xff, 0x0d, 0xff, 0xff, 0x00		 //tile:13 
, 0xfe, 0xfe, 0xfe, 0xfe, 0xfe, 0xfe, 0xfe, 0xfe, 0xfe, 0xfe, 0xfe, 0xfe, 0xfe, 0xfe, 0x00, 0x00, 0xfe, 0xfe, 0xfe, 0xfe, 0x00, 0x00, 0x0d, 0x0d, 0xfe, 0xfe, 0xfe, 0x00, 0x27, 0x00, 0x00, 0x00, 0xfe, 0xfe, 0x00, 0x27, 0xff, 0x27, 0x0d, 0x00, 0xfe, 0x00, 0x0d, 0x0d, 0x27, 0x0d, 0x0d, 0x0d, 0xfe, 0x00, 0x0d, 0x0d, 0x0d, 0x0d, 0x0d, 0xff, 0x00, 0x0d, 0x0d, 0x0d, 0x0d, 0x0d, 0x0d, 0xff		 //tile:14 
, 0xfe, 0xfe, 0xfe, 0xfe, 0xfe, 0xfe, 0xfe, 0xfe, 0x00, 0x00, 0xfe, 0xfe, 0xfe, 0xfe, 0xfe, 0xfe, 0x0d, 0x0d, 0x00, 0x00, 0xfe, 0xfe, 0xfe, 0xfe, 0x00, 0x0d, 0x0d, 0x0d, 0x00, 0x00, 0x00, 0x00, 0x00, 0x00, 0x0d, 0x00, 0x00, 0x00, 0xfe, 0xfe, 0xff, 0x00, 0x00, 0x00, 0xff, 0x0d, 0x00, 0xfe, 0xff, 0xff, 0x00, 0xff, 0xff, 0xff, 0x00, 0xfe, 0xff, 0x00, 0x0d, 0x00, 0xff, 0xff, 0x0d, 0x00		 //tile:15 
, 0xfe, 0xfe, 0xfe, 0xfe, 0xfe, 0xfe, 0xfe, 0xfe, 0xfe, 0xfe, 0xfe, 0xfe, 0xfe, 0xfe, 0xfe, 0xfe, 0xfe, 0xfe, 0xfe, 0xfe, 0xfe, 0xfe, 0xfe, 0xfe, 0xfe, 0xfe, 0xfe, 0xfe, 0xfe, 0xfe, 0xfe, 0xfe, 0xfe, 0xfe, 0xfe, 0xfe, 0xfe, 0xfe, 0xfe, 0xfe, 0xfe, 0xfe, 0xfe, 0xfe, 0xfe, 0xfe, 0xfe, 0xfe, 0xfe, 0xfe, 0xfe, 0xfe, 0xfe, 0xfe, 0xfe, 0xfe, 0xfe, 0xfe, 0xfe, 0xfe, 0xfe, 0xfe, 0xfe, 0xfe		 //tile:16 
, 0xfe, 0xfe, 0x02, 0xb7, 0x00, 0x00, 0x00, 0x5f, 0xfe, 0x02, 0xb7, 0x14, 0xb7, 0x00, 0x5f, 0xb7, 0xfe, 0x02, 0x5f, 0x14, 0xb7, 0x00, 0x00, 0xb7, 0xfe, 0x02, 0x00, 0x5f, 0xb7, 0x00, 0xb7, 0xb7, 0xfe, 0xfe, 0x00, 0x00, 0x5f, 0x5f, 0xb7, 0x00, 0xfe, 0xfe, 0xfe, 0x00, 0x14, 0x14, 0x5f, 0x5f, 0xfe, 0xfe, 0xfe, 0xfe, 0x02, 0x4d, 0x14, 0x14, 0xfe, 0xfe, 0xfe, 0x02, 0x4d, 0x4d, 0x57, 0xa2		 //tile:17 
, 0x00, 0x5f, 0x00, 0x5f, 0xfe, 0xfe, 0xfe, 0xfe, 0x00, 0xb7, 0x00, 0xb7, 0x14, 0x14, 0xfe, 0xfe, 0xb7, 0xb7, 0xb7, 0xb7, 0xb7, 0xb7, 0x14, 0xfe, 0x00, 0x5f, 0x5f, 0x5f, 0x5f, 0x5f, 0x14, 0xfe, 0x00, 0x00, 0x00, 0x00, 0x00, 0x00, 0xfe, 0xfe, 0x5f, 0x00, 0x00, 0x00, 0x00, 0xfe, 0xfe, 0xfe, 0x14, 0x14, 0x89, 0xfe, 0xfe, 0xfe, 0xfe, 0xfe, 0xa2, 0xb4, 0xb4, 0x89, 0xfe, 0xfe, 0xfe, 0xfe		 //tile:18 
, 0xfe, 0xfe, 0x02, 0xb7, 0x00, 0x00, 0x00, 0x5f, 0xfe, 0x02, 0xb7, 0x14, 0xb7, 0x00, 0x5f, 0xb7, 0xfe, 0x02, 0x5f, 0x14, 0xb7, 0x00, 0x00, 0xb7, 0xfe, 0x02, 0x00, 0x5f, 0xb7, 0x00, 0xb7, 0xb7, 0xfe, 0xfe, 0x00, 0x00, 0x5f, 0x5f, 0xb7, 0x00, 0xfe, 0xfe, 0xfe, 0x00, 0x14, 0x5f, 0x5f, 0x5f, 0xfe, 0xfe, 0xfe, 0x14, 0x4d, 0x14, 0x14, 0x14, 0xfe, 0xfe, 0xfe, 0x14, 0x4d, 0x4d, 0x57, 0x14		 //tile:19 
, 0xfe, 0xfe, 0x02, 0x4d, 0x00, 0x00, 0x00, 0x00, 0xfe, 0x02, 0x4d, 0x4d, 0xb7, 0x00, 0x00, 0x5f, 0xfe, 0x02, 0x4d, 0xb7, 0x14, 0xb7, 0x00, 0xb7, 0xfe, 0x02, 0x4d, 0x5f, 0x14, 0xb7, 0x00, 0x00, 0xfe, 0xfe, 0x02, 0x00, 0x5f, 0xb7, 0x00, 0xb7, 0xfe, 0x02, 0x4d, 0x00, 0x00, 0x5f, 0x02, 0x14, 0xfe, 0x02, 0x4d, 0xff, 0x00, 0x14, 0x14, 0xff, 0xfe, 0x02, 0xff, 0xff, 0xff, 0x14, 0xff, 0xff		 //tile:20 
, 0x5f, 0x5f, 0x5f, 0x5f, 0x5f, 0xfe, 0xfe, 0xfe, 0xb7, 0x00, 0xb7, 0x00, 0xb7, 0xfe, 0xfe, 0xfe, 0xb7, 0x00, 0xb7, 0x00, 0xb7, 0x14, 0x14, 0xfe, 0xb7, 0xb7, 0xb7, 0xb7, 0xb7, 0xb7, 0xb7, 0x14, 0xb7, 0x00, 0x5f, 0x5f, 0x5f, 0x5f, 0x5f, 0x14, 0x14, 0x00, 0x00, 0x00, 0x00, 0x00, 0x00, 0xfe, 0xff, 0x14, 0x00, 0x00, 0x00, 0x00, 0xfe, 0xfe, 0xff, 0xff, 0x4d, 0x57, 0x02, 0xfe, 0xfe, 0xfe		 //tile:21 
, 0xfe, 0xfe, 0x02, 0xb7, 0x00, 0x00, 0x00, 0x5f, 0xfe, 0x02, 0xb7, 0x14, 0xb7, 0x00, 0x5f, 0xb7, 0xfe, 0x02, 0x5f, 0x14, 0xb7, 0x00, 0x00, 0xb7, 0xfe, 0x02, 0x00, 0x5f, 0xb7, 0x00, 0xb7, 0xb7, 0xfe, 0xfe, 0x00, 0x00, 0x5f, 0x5f, 0xb7, 0x00, 0xfe, 0x14, 0x14, 0x14, 0x4d, 0x14, 0x5f, 0x5f, 0x14, 0x14, 0xff, 0xff, 0x14, 0x4d, 0x14, 0x14, 0x14, 0xff, 0xff, 0xff, 0xff, 0x14, 0x57, 0xa2		 //tile:22 
, 0x00, 0x5f, 0x00, 0x5f, 0x4d, 0x02, 0xfe, 0xfe, 0x00, 0xb7, 0x00, 0xb7, 0x14, 0x14, 0xfe, 0xfe, 0xb7, 0xb7, 0xb7, 0xb7, 0xb7, 0xb7, 0x14, 0xfe, 0x00, 0x5f, 0x5f, 0x5f, 0x5f, 0x5f, 0x14, 0xfe, 0x00, 0x00, 0x00, 0x00, 0x00, 0x00, 0xfe, 0xfe, 0x5f, 0x00, 0x00, 0x00, 0x00, 0xfe, 0xfe, 0xfe, 0x14, 0x14, 0x89, 0xfe, 0xfe, 0xfe, 0xfe, 0xfe, 0xa2, 0xb4, 0xb4, 0x89, 0xfe, 0xfe, 0xfe, 0xfe		 //tile:23 
, 0xfe, 0xfe, 0x02, 0x4d, 0x00, 0x00, 0x00, 0x00, 0xfe, 0x02, 0x4d, 0x4d, 0x00, 0x00, 0x5f, 0xb7, 0xfe, 0x02, 0x4d, 0xb7, 0x00, 0x00, 0xb7, 0xb7, 0xfe, 0x02, 0xb7, 0x14, 0xb7, 0x00, 0xb7, 0xb7, 0xfe, 0x00, 0x5f, 0x14, 0xb7, 0x00, 0x00, 0xb7, 0xfe, 0xfe, 0x00, 0x5f, 0xb7, 0x00, 0xb7, 0xb7, 0xfe, 0x14, 0xff, 0xff, 0x14, 0x5f, 0xb7, 0x00, 0x14, 0xff, 0xff, 0xff, 0xff, 0x14, 0x5f, 0x5f		 //tile:24 
, 0x00, 0x5f, 0x00, 0x00, 0xfe, 0xfe, 0xfe, 0xfe, 0xb7, 0xb7, 0xb7, 0xb7, 0xfe, 0xfe, 0xfe, 0xfe, 0x00, 0xb7, 0x00, 0xb7, 0xfe, 0xfe, 0xfe, 0xfe, 0x00, 0xb7, 0x00, 0xb7, 0x14, 0x14, 0xfe, 0xfe, 0xb7, 0xb7, 0xb7, 0xb7, 0xb7, 0xb7, 0x14, 0xfe, 0x00, 0x5f, 0x5f, 0x5f, 0x5f, 0x5f, 0x14, 0xfe, 0x00, 0x00, 0x00, 0x00, 0x00, 0x00, 0xff, 0x14, 0x5f, 0x00, 0x00, 0x00, 0x00, 0xff, 0xff, 0x14		 //tile:25 
, 0xfe, 0xfe, 0xfe, 0xfe, 0x5f, 0x00, 0x5f, 0x00, 0xfe, 0xfe, 0x14, 0x14, 0xb7, 0x00, 0xb7, 0x00, 0xfe, 0x14, 0xb7, 0xb7, 0xb7, 0xb7, 0xb7, 0xb7, 0xfe, 0x14, 0x5f, 0x5f, 0x5f, 0x5f, 0x5f, 0x00, 0xfe, 0xfe, 0x00, 0x00, 0x00, 0x00, 0x00, 0x00, 0xfe, 0xfe, 0xfe, 0x00, 0x00, 0x00, 0x00, 0x5f, 0xfe, 0xfe, 0xfe, 0xfe, 0xfe, 0x89, 0x14, 0x14, 0xfe, 0xfe, 0xfe, 0xfe, 0x89, 0xb4, 0xb4, 0xa2		 //tile:26 
, 0x5f, 0x00, 0x00, 0x00, 0xb7, 0x02, 0xfe, 0xfe, 0xb7, 0x5f, 0x00, 0xb7, 0x14, 0xb7, 0x02, 0xfe, 0xb7, 0x00, 0x00, 0xb7, 0x14, 0x5f, 0x02, 0xfe, 0xb7, 0xb7, 0x00, 0xb7, 0x5f, 0x00, 0x02, 0xfe, 0x00, 0xb7, 0x5f, 0x5f, 0x00, 0x00, 0xfe, 0xfe, 0x5f, 0x5f, 0x14, 0x14, 0x00, 0xfe, 0xfe, 0xfe, 0x14, 0x14, 0x4d, 0x02, 0xfe, 0xfe, 0xfe, 0xfe, 0xa2, 0x57, 0x4d, 0x4d, 0x02, 0xfe, 0xfe, 0xfe		 //tile:27 
, 0x5f, 0x00, 0x00, 0x00, 0xb7, 0x02, 0xfe, 0xfe, 0xb7, 0x5f, 0x00, 0xb7, 0x14, 0xb7, 0x02, 0xfe, 0xb7, 0x00, 0x00, 0xb7, 0x14, 0x5f, 0x02, 0xfe, 0xb7, 0xb7, 0x00, 0xb7, 0x5f, 0x00, 0x02, 0xfe, 0x00, 0xb7, 0x5f, 0x5f, 0x00, 0x00, 0xfe, 0xfe, 0x5f, 0x5f, 0x5f, 0x14, 0x00, 0xfe, 0xfe, 0xfe, 0x14, 0x14, 0x14, 0x4d, 0x14, 0xfe, 0xfe, 0xfe, 0x14, 0x57, 0x4d, 0x4d, 0x14, 0xfe, 0xfe, 0xfe		 //tile:28 
, 0xfe, 0xfe, 0xfe, 0x5f, 0x5f, 0x5f, 0x5f, 0x5f, 0xfe, 0xfe, 0xfe, 0xb7, 0x00, 0xb7, 0x00, 0xb7, 0xfe, 0x14, 0x14, 0xb7, 0x00, 0xb7, 0x00, 0xb7, 0x14, 0xb7, 0xb7, 0xb7, 0xb7, 0xb7, 0xb7, 0xb7, 0x14, 0x5f, 0x5f, 0x5f, 0x5f, 0x5f, 0x00, 0xb7, 0xfe, 0x00, 0x00, 0x00, 0x00, 0x00, 0x00, 0x14, 0xfe, 0xfe, 0x00, 0x00, 0x00, 0x00, 0x14, 0xff, 0xfe, 0xfe, 0xfe, 0x02, 0x57, 0x4d, 0xff, 0xff		 //tile:29 
, 0x00, 0x00, 0x00, 0x00, 0x4d, 0x02, 0xfe, 0xfe, 0x5f, 0x00, 0x00, 0xb7, 0x4d, 0x4d, 0x02, 0xfe, 0xb7, 0x00, 0xb7, 0x14, 0xb7, 0x4d, 0x02, 0xfe, 0x00, 0x00, 0xb7, 0x14, 0x5f, 0x4d, 0x02, 0xfe, 0xb7, 0x00, 0xb7, 0x5f, 0x00, 0x02, 0xfe, 0xfe, 0x14, 0x02, 0x5f, 0x00, 0x00, 0x4d, 0x02, 0xfe, 0xff, 0x14, 0x14, 0x00, 0xff, 0x4d, 0x02, 0xfe, 0xff, 0xff, 0x14, 0xff, 0xff, 0xff, 0x02, 0xfe		 //tile:30 
, 0xfe, 0xfe, 0x02, 0x4d, 0x5f, 0x00, 0x5f, 0x00, 0xfe, 0xfe, 0x14, 0x14, 0xb7, 0x00, 0xb7, 0x00, 0xfe, 0x14, 0xb7, 0xb7, 0xb7, 0xb7, 0xb7, 0xb7, 0xfe, 0x14, 0x5f, 0x5f, 0x5f, 0x5f, 0x5f, 0x00, 0xfe, 0xfe, 0x00, 0x00, 0x00, 0x00, 0x00, 0x00, 0xfe, 0xfe, 0xfe, 0x00, 0x00, 0x00, 0x00, 0x5f, 0xfe, 0xfe, 0xfe, 0xfe, 0xfe, 0x89, 0x14, 0x14, 0xfe, 0xfe, 0xfe, 0xfe, 0x89, 0xb4, 0xb4, 0xa2		 //tile:31 
, 0x5f, 0x00, 0x00, 0x00, 0xb7, 0x02, 0xfe, 0xfe, 0xb7, 0x5f, 0x00, 0xb7, 0x14, 0xb7, 0x02, 0xfe, 0xb7, 0x00, 0x00, 0xb7, 0x14, 0x5f, 0x02, 0xfe, 0xb7, 0xb7, 0x00, 0xb7, 0x5f, 0x00, 0x02, 0xfe, 0x00, 0xb7, 0x5f, 0x5f, 0x00, 0x00, 0xfe, 0xfe, 0x5f, 0x5f, 0x14, 0x4d, 0x14, 0x14, 0x14, 0xfe, 0x14, 0x14, 0x4d, 0x14, 0xff, 0xff, 0x14, 0x14, 0xa2, 0x57, 0x14, 0xff, 0xff, 0xff, 0xff, 0x14		 //tile:32 
, 0xfe, 0xfe, 0xfe, 0xfe, 0x00, 0x00, 0x5f, 0x00, 0xfe, 0xfe, 0xfe, 0xfe, 0xb7, 0xb7, 0xb7, 0xb7, 0xfe, 0xfe, 0xfe, 0xfe, 0xb7, 0x00, 0xb7, 0x00, 0xfe, 0xfe, 0x14, 0x14, 0xb7, 0x00, 0xb7, 0x00, 0xfe, 0x14, 0xb7, 0xb7, 0xb7, 0xb7, 0xb7, 0xb7, 0xfe, 0x14, 0x5f, 0x5f, 0x5f, 0x5f, 0x5f, 0x00, 0x14, 0xff, 0x00, 0x00, 0x00, 0x00, 0x00, 0x00, 0x14, 0xff, 0xff, 0x00, 0x00, 0x00, 0x00, 0x5f		 //tile:33 
, 0x00, 0x00, 0x00, 0x00, 0x4d, 0x02, 0xfe, 0xfe, 0xb7, 0x5f, 0x00, 0x00, 0x4d, 0x4d, 0x02, 0xfe, 0xb7, 0xb7, 0x00, 0x00, 0xb7, 0x4d, 0x02, 0xfe, 0xb7, 0xb7, 0x00, 0xb7, 0x14, 0xb7, 0x02, 0xfe, 0xb7, 0x00, 0x00, 0xb7, 0x14, 0x5f, 0x00, 0xfe, 0xb7, 0xb7, 0x00, 0xb7, 0x5f, 0x00, 0xfe, 0xfe, 0x00, 0xb7, 0x5f, 0x14, 0xff, 0xff, 0x14, 0xfe, 0x5f, 0x5f, 0x14, 0xff, 0xff, 0xff, 0xff, 0x14		 //tile:34 
, 0x00, 0x27, 0x27, 0x27, 0x27, 0x27, 0x27, 0x0d, 0xfe, 0x00, 0x00, 0x00, 0x00, 0x00, 0xff, 0x27, 0xfe, 0x00, 0x27, 0x27, 0x27, 0x27, 0x00, 0x00, 0xfe, 0xfe, 0x00, 0x27, 0x27, 0x27, 0x27, 0x27, 0xfe, 0xfe, 0xfe, 0x00, 0x00, 0x27, 0x1f, 0x1f, 0xfe, 0xfe, 0xfe, 0xfe, 0xfe, 0x1f, 0x3f, 0x3f, 0xfe, 0xfe, 0xfe, 0xfe, 0x1f, 0xff, 0x2f, 0x2f, 0xfe, 0xfe, 0xfe, 0xfe, 0x00, 0x00, 0x00, 0x00		 //tile:35 
, 0x0d, 0x0d, 0x0d, 0x0d, 0x0d, 0x0d, 0x0d, 0x00, 0x27, 0x0d, 0x0d, 0x0d, 0x0d, 0x0d, 0x00, 0xfe, 0x27, 0x27, 0x0d, 0x0d, 0x0d, 0x0d, 0x00, 0xfe, 0x27, 0x27, 0x27, 0x0d, 0x0d, 0x00, 0xfe, 0xfe, 0x1f, 0x1f, 0x27, 0x00, 0x00, 0xfe, 0xfe, 0xfe, 0x2f, 0x2f, 0x1f, 0xfe, 0xfe, 0xfe, 0xfe, 0xfe, 0x2f, 0x2f, 0x1f, 0xfe, 0xfe, 0xfe, 0xfe, 0xfe, 0x00, 0x00, 0x00, 0xfe, 0xfe, 0xfe, 0xfe, 0xfe		 //tile:36 
, 0x00, 0x0d, 0x0d, 0xff, 0xff, 0x0d, 0xff, 0xff, 0x00, 0x0d, 0x0d, 0x27, 0x27, 0x27, 0x27, 0x27, 0xfe, 0x00, 0x27, 0xff, 0x00, 0x00, 0x00, 0x00, 0xfe, 0x00, 0x27, 0x00, 0x27, 0x27, 0x27, 0x27, 0xfe, 0x1f, 0x00, 0x27, 0x27, 0x27, 0x27, 0x27, 0x00, 0xff, 0x3f, 0x00, 0x00, 0x27, 0x27, 0x27, 0xfe, 0x00, 0x00, 0x2f, 0x2f, 0x00, 0x00, 0x00, 0xfe, 0xfe, 0xfe, 0x00, 0x00, 0x00, 0x00, 0xfe		 //tile:37 
, 0x0d, 0x0d, 0x0d, 0x0d, 0x0d, 0x0d, 0x0d, 0x00, 0x27, 0x0d, 0x0d, 0x0d, 0x0d, 0x0d, 0x0d, 0x00, 0xff, 0x27, 0x27, 0x0d, 0x0d, 0x0d, 0x00, 0xfe, 0x00, 0x00, 0x27, 0x27, 0x1f, 0x1f, 0x1f, 0xfe, 0x27, 0x27, 0x1f, 0x1f, 0x3f, 0x2f, 0x2f, 0x1f, 0x27, 0x1f, 0xff, 0x3f, 0x3f, 0x2f, 0x2f, 0x00, 0x00, 0x1f, 0x3f, 0x3f, 0x2f, 0x00, 0x00, 0xfe, 0xfe, 0x00, 0x00, 0x00, 0x00, 0xfe, 0xfe, 0xfe		 //tile:38 
, 0x00, 0x0d, 0x0d, 0x0d, 0x0d, 0x0d, 0x0d, 0x0d, 0xfe, 0x00, 0x0d, 0x0d, 0x0d, 0x0d, 0x0d, 0x27, 0xfe, 0x00, 0x0d, 0x0d, 0x0d, 0x0d, 0x27, 0x27, 0xfe, 0xfe, 0x00, 0x0d, 0x0d, 0x27, 0x27, 0x27, 0xfe, 0xfe, 0xfe, 0x00, 0x00, 0x27, 0x1f, 0x1f, 0xfe, 0xfe, 0xfe, 0xfe, 0xfe, 0x1f, 0x2f, 0x2f, 0xfe, 0xfe, 0xfe, 0xfe, 0xfe, 0x1f, 0x2f, 0x2f, 0xfe, 0xfe, 0xfe, 0xfe, 0xfe, 0x00, 0x00, 0x00		 //tile:39 
, 0x0d, 0x27, 0x27, 0x27, 0x27, 0x27, 0x27, 0x00, 0x27, 0xff, 0x00, 0x00, 0x00, 0x00, 0x00, 0xfe, 0x00, 0x00, 0x27, 0x27, 0x27, 0x27, 0x00, 0xfe, 0x27, 0x27, 0x27, 0x27, 0x27, 0x00, 0xfe, 0xfe, 0x1f, 0x1f, 0x27, 0x00, 0x00, 0xfe, 0xfe, 0xfe, 0x3f, 0x3f, 0x1f, 0xfe, 0xfe, 0xfe, 0xfe, 0xfe, 0x2f, 0x2f, 0xff, 0x1f, 0xfe, 0xfe, 0xfe, 0xfe, 0x00, 0x00, 0x00, 0x00, 0xfe, 0xfe, 0xfe, 0xfe		 //tile:40 
, 0x00, 0x0d, 0x0d, 0x0d, 0x0d, 0x0d, 0x0d, 0x0d, 0x00, 0x0d, 0x0d, 0x0d, 0x0d, 0x0d, 0x0d, 0x27, 0xfe, 0x00, 0x0d, 0x0d, 0x0d, 0x27, 0x27, 0xff, 0xfe, 0x1f, 0x1f, 0x1f, 0x27, 0x27, 0x00, 0x00, 0x1f, 0x2f, 0x2f, 0x3f, 0x1f, 0x1f, 0x27, 0x27, 0x00, 0x2f, 0x2f, 0x3f, 0x3f, 0xff, 0x1f, 0x27, 0xfe, 0x00, 0x00, 0x2f, 0x3f, 0x3f, 0x1f, 0x00, 0xfe, 0xfe, 0xfe, 0x00, 0x00, 0x00, 0x00, 0xfe		 //tile:41 
, 0xff, 0xff, 0x0d, 0xff, 0xff, 0x0d, 0x0d, 0x00, 0x27, 0x27, 0x27, 0x27, 0x27, 0x0d, 0x0d, 0x00, 0x00, 0x00, 0x00, 0x00, 0xff, 0x27, 0x00, 0xfe, 0x27, 0x27, 0x27, 0x27, 0x00, 0x27, 0x00, 0xfe, 0x27, 0x27, 0x27, 0x27, 0x27, 0x00, 0x1f, 0xfe, 0x27, 0x27, 0x27, 0x00, 0x00, 0x3f, 0xff, 0x00, 0x00, 0x00, 0x00, 0x2f, 0x2f, 0x00, 0x00, 0xfe, 0xfe, 0x00, 0x00, 0x00, 0x00, 0xfe, 0xfe, 0xfe		 //tile:42 
, 0xfe, 0xfe, 0xfe, 0x02, 0x14, 0x14, 0x14, 0xa2, 0xfe, 0xfe, 0xfe, 0x14, 0xff, 0xff, 0xff, 0x14, 0xfe, 0xfe, 0xfe, 0x14, 0xff, 0xff, 0x14, 0xa2, 0xfe, 0xfe, 0xfe, 0x14, 0xff, 0xff, 0x14, 0xa2, 0xfe, 0xfe, 0xfe, 0xfe, 0x14, 0x14, 0x14, 0x14, 0xfe, 0xfe, 0xfe, 0xfe, 0x00, 0x14, 0x14, 0x14, 0xfe, 0xfe, 0xfe, 0xfe, 0x00, 0x00, 0x00, 0x00, 0xfe, 0xfe, 0xfe, 0xfe, 0xfe, 0xfe, 0xfe, 0xfe		 //tile:43 
, 0xff, 0xff, 0xb4, 0xff, 0x89, 0xfe, 0xfe, 0xfe, 0xff, 0xff, 0xb4, 0xff, 0x89, 0xfe, 0xfe, 0xfe, 0xa2, 0xa2, 0xb4, 0xb4, 0x89, 0xfe, 0xfe, 0xfe, 0xa2, 0x89, 0xa2, 0x89, 0xfe, 0xfe, 0xfe, 0xfe, 0x00, 0x14, 0x00, 0xfe, 0xfe, 0xfe, 0xfe, 0xfe, 0x77, 0x00, 0x77, 0x00, 0xfe, 0xfe, 0xfe, 0xfe, 0x00, 0x00, 0x00, 0x00, 0xfe, 0xfe, 0xfe, 0xfe, 0xfe, 0xfe, 0xfe, 0xfe, 0xfe, 0xfe, 0xfe, 0xfe		 //tile:44 
, 0xfe, 0xfe, 0x00, 0x14, 0xff, 0xff, 0xff, 0x14, 0xfe, 0x00, 0x14, 0x14, 0xff, 0xff, 0x14, 0xa2, 0xfe, 0x00, 0x14, 0x14, 0xff, 0xff, 0x14, 0xa2, 0xfe, 0x00, 0x14, 0x89, 0x14, 0x14, 0xa2, 0xa2, 0xfe, 0x00, 0x14, 0xbf, 0x00, 0xfe, 0x89, 0x89, 0xfe, 0xfe, 0x00, 0x00, 0xfe, 0xfe, 0xfe, 0xfe, 0xfe, 0xfe, 0xfe, 0xfe, 0xfe, 0xfe, 0xfe, 0xfe, 0xfe, 0xfe, 0xfe, 0xfe, 0xfe, 0xfe, 0xfe, 0xfe		 //tile:45 
, 0xff, 0xff, 0xb4, 0xff, 0x89, 0x00, 0x00, 0xfe, 0xff, 0xff, 0xb4, 0xff, 0x00, 0xbf, 0x00, 0x00, 0xa2, 0xa2, 0xb4, 0x89, 0x00, 0x14, 0x00, 0x00, 0xa2, 0xa2, 0x89, 0x00, 0x14, 0x00, 0x00, 0xfe, 0x89, 0x89, 0xfe, 0x00, 0x14, 0x00, 0x00, 0xfe, 0xfe, 0xfe, 0xfe, 0xfe, 0x00, 0x00, 0xfe, 0xfe, 0xfe, 0xfe, 0xfe, 0xfe, 0xfe, 0xfe, 0xfe, 0xfe, 0xfe, 0xfe, 0xfe, 0xfe, 0xfe, 0xfe, 0xfe, 0xfe		 //tile:46 
, 0xfe, 0x14, 0xff, 0xff, 0xff, 0x14, 0xff, 0xff, 0xfe, 0xfe, 0x14, 0xff, 0x14, 0x14, 0x14, 0xff, 0xfe, 0xfe, 0xfe, 0x14, 0xff, 0xff, 0xa2, 0x14, 0xfe, 0xfe, 0xfe, 0x89, 0xa2, 0xa2, 0xa2, 0x00, 0xfe, 0xfe, 0x89, 0xa2, 0xa2, 0xa2, 0x89, 0x00, 0xfe, 0xfe, 0x00, 0x14, 0x14, 0x00, 0xfe, 0xfe, 0xfe, 0x00, 0x77, 0x14, 0x14, 0x00, 0xfe, 0xfe, 0xfe, 0x00, 0x00, 0x00, 0x00, 0x00, 0xfe, 0xfe		 //tile:47 
, 0xff, 0xff, 0x14, 0x02, 0x89, 0xfe, 0xfe, 0xfe, 0x14, 0x02, 0x02, 0xb4, 0x89, 0xfe, 0xfe, 0xfe, 0x14, 0x77, 0x14, 0xb4, 0x89, 0xfe, 0xfe, 0xfe, 0x00, 0x14, 0x14, 0x00, 0xfe, 0xfe, 0xfe, 0xfe, 0x00, 0x00, 0x14, 0x00, 0xfe, 0xfe, 0xfe, 0xfe, 0x00, 0x00, 0x00, 0xfe, 0xfe, 0xfe, 0xfe, 0xfe, 0xfe, 0xfe, 0xfe, 0xfe, 0xfe, 0xfe, 0xfe, 0xfe, 0xfe, 0xfe, 0xfe, 0xfe, 0xfe, 0xfe, 0xfe, 0xfe		 //tile:48 
, 0x14, 0xff, 0xff, 0xff, 0xff, 0x14, 0xa2, 0xa2, 0xfe, 0x14, 0xff, 0xff, 0x14, 0xa2, 0xa2, 0xa2, 0xfe, 0x00, 0x14, 0x14, 0xa2, 0xa2, 0xa2, 0xa2, 0xfe, 0x00, 0x14, 0x89, 0x89, 0x89, 0xa2, 0xa2, 0xfe, 0x00, 0x14, 0x77, 0x00, 0xfe, 0x89, 0x89, 0xfe, 0xfe, 0x00, 0x00, 0xfe, 0xfe, 0xfe, 0xfe, 0xfe, 0xfe, 0xfe, 0xfe, 0xfe, 0xfe, 0xfe, 0xfe, 0xfe, 0xfe, 0xfe, 0xfe, 0xfe, 0xfe, 0xfe, 0xfe		 //tile:49 
, 0xff, 0xff, 0xb4, 0xff, 0x89, 0x00, 0x00, 0xfe, 0xff, 0xff, 0xb4, 0xff, 0x00, 0x77, 0x00, 0x00, 0xa2, 0xa2, 0xb4, 0x89, 0x00, 0x14, 0x00, 0x00, 0xa2, 0xa2, 0x89, 0x00, 0x14, 0x00, 0x00, 0xfe, 0x89, 0x89, 0xfe, 0x00, 0x14, 0x00, 0x00, 0xfe, 0xfe, 0xfe, 0xfe, 0xfe, 0x00, 0x00, 0xfe, 0xfe, 0xfe, 0xfe, 0xfe, 0xfe, 0xfe, 0xfe, 0xfe, 0xfe, 0xfe, 0xfe, 0xfe, 0xfe, 0xfe, 0xfe, 0xfe, 0xfe		 //tile:50 
, 0x14, 0xff, 0xff, 0xff, 0xff, 0x14, 0x14, 0x14, 0xfe, 0x14, 0xff, 0xff, 0x14, 0x57, 0x57, 0xa2, 0xfe, 0x00, 0x14, 0x14, 0x89, 0xa2, 0xa2, 0xa2, 0xfe, 0x00, 0x14, 0x14, 0x89, 0xa2, 0xa2, 0xa2, 0xfe, 0x00, 0x14, 0x77, 0x89, 0x89, 0xa2, 0xa2, 0xfe, 0xfe, 0x00, 0x00, 0xfe, 0x89, 0x89, 0xa2, 0xfe, 0xfe, 0xfe, 0xfe, 0xfe, 0xfe, 0x89, 0x89, 0xfe, 0xfe, 0xfe, 0xfe, 0xfe, 0xfe, 0xfe, 0xfe		 //tile:51 
, 0x14, 0x14, 0x89, 0x14, 0xff, 0x00, 0x00, 0xfe, 0xa2, 0xb4, 0xb4, 0x89, 0x00, 0x77, 0x00, 0x00, 0xff, 0xff, 0xb4, 0xff, 0x00, 0x14, 0x00, 0x00, 0xff, 0xff, 0xb4, 0xff, 0x00, 0x14, 0x00, 0x00, 0xa2, 0xa2, 0xb4, 0x89, 0x00, 0x14, 0x00, 0x00, 0xa2, 0xa2, 0x89, 0xfe, 0xfe, 0x00, 0x00, 0xfe, 0x89, 0x89, 0xfe, 0xfe, 0xfe, 0xfe, 0xfe, 0xfe, 0xfe, 0xfe, 0xfe, 0xfe, 0xfe, 0xfe, 0xfe, 0xfe		 //tile:52 
, 0xfe, 0xfe, 0xfe, 0x89, 0xff, 0xb4, 0xff, 0xff, 0xfe, 0xfe, 0xfe, 0x89, 0xff, 0xb4, 0xff, 0xff, 0xfe, 0xfe, 0xfe, 0x89, 0xb4, 0xb4, 0xa2, 0xa2, 0xfe, 0xfe, 0xfe, 0xfe, 0x89, 0xa2, 0x89, 0xa2, 0xfe, 0xfe, 0xfe, 0xfe, 0xfe, 0x00, 0x14, 0x00, 0xfe, 0xfe, 0xfe, 0xfe, 0x00, 0x77, 0x00, 0x77, 0xfe, 0xfe, 0xfe, 0xfe, 0x00, 0x00, 0x00, 0x00, 0xfe, 0xfe, 0xfe, 0xfe, 0xfe, 0xfe, 0xfe, 0xfe		 //tile:53 
, 0xa2, 0x14, 0x14, 0x14, 0x02, 0xfe, 0xfe, 0xfe, 0x14, 0xff, 0xff, 0xff, 0x14, 0xfe, 0xfe, 0xfe, 0xa2, 0x14, 0xff, 0xff, 0x14, 0xfe, 0xfe, 0xfe, 0xa2, 0x14, 0xff, 0xff, 0x14, 0xfe, 0xfe, 0xfe, 0x14, 0x14, 0x14, 0x14, 0xfe, 0xfe, 0xfe, 0xfe, 0x14, 0x14, 0x14, 0x00, 0xfe, 0xfe, 0xfe, 0xfe, 0x00, 0x00, 0x00, 0x00, 0xfe, 0xfe, 0xfe, 0xfe, 0xfe, 0xfe, 0xfe, 0xfe, 0xfe, 0xfe, 0xfe, 0xfe		 //tile:54 
, 0xfe, 0x00, 0x00, 0x89, 0xff, 0xb4, 0xff, 0xff, 0x00, 0x00, 0xbf, 0x00, 0xff, 0xb4, 0xff, 0xff, 0x00, 0x00, 0x14, 0x00, 0x89, 0xb4, 0xa2, 0xa2, 0xfe, 0x00, 0x00, 0x14, 0x00, 0x89, 0xa2, 0xa2, 0xfe, 0x00, 0x00, 0x14, 0x00, 0xfe, 0x89, 0x89, 0xfe, 0xfe, 0x00, 0x00, 0xfe, 0xfe, 0xfe, 0xfe, 0xfe, 0xfe, 0xfe, 0xfe, 0xfe, 0xfe, 0xfe, 0xfe, 0xfe, 0xfe, 0xfe, 0xfe, 0xfe, 0xfe, 0xfe, 0xfe		 //tile:55 
, 0x14, 0xff, 0xff, 0xff, 0x14, 0x00, 0xfe, 0xfe, 0xa2, 0x14, 0xff, 0xff, 0x14, 0x14, 0x00, 0xfe, 0xa2, 0x14, 0xff, 0xff, 0x14, 0x14, 0x00, 0xfe, 0xa2, 0xa2, 0x14, 0x14, 0x89, 0x14, 0x00, 0xfe, 0x89, 0x89, 0xfe, 0x00, 0xbf, 0x14, 0x00, 0xfe, 0xfe, 0xfe, 0xfe, 0xfe, 0x00, 0x00, 0xfe, 0xfe, 0xfe, 0xfe, 0xfe, 0xfe, 0xfe, 0xfe, 0xfe, 0xfe, 0xfe, 0xfe, 0xfe, 0xfe, 0xfe, 0xfe, 0xfe, 0xfe		 //tile:56 
, 0xfe, 0xfe, 0xfe, 0x89, 0x02, 0x14, 0xff, 0xff, 0xfe, 0xfe, 0xfe, 0x89, 0xb4, 0x02, 0x02, 0x14, 0xfe, 0xfe, 0xfe, 0x89, 0xb4, 0x14, 0x77, 0x14, 0xfe, 0xfe, 0xfe, 0xfe, 0x00, 0x14, 0x14, 0x00, 0xfe, 0xfe, 0xfe, 0xfe, 0x00, 0x14, 0x00, 0x00, 0xfe, 0xfe, 0xfe, 0xfe, 0xfe, 0x00, 0x00, 0x00, 0xfe, 0xfe, 0xfe, 0xfe, 0xfe, 0xfe, 0xfe, 0xfe, 0xfe, 0xfe, 0xfe, 0xfe, 0xfe, 0xfe, 0xfe, 0xfe		 //tile:57 
, 0xff, 0xff, 0x14, 0xff, 0xff, 0xff, 0x14, 0xfe, 0xff, 0x14, 0x14, 0x14, 0xff, 0x14, 0xfe, 0xfe, 0x14, 0xa2, 0xff, 0xff, 0x14, 0xfe, 0xfe, 0xfe, 0x00, 0xa2, 0xa2, 0xa2, 0x89, 0xfe, 0xfe, 0xfe, 0x00, 0x89, 0xa2, 0xa2, 0xa2, 0x89, 0xfe, 0xfe, 0xfe, 0xfe, 0x00, 0x14, 0x14, 0x00, 0xfe, 0xfe, 0xfe, 0xfe, 0x00, 0x14, 0x14, 0x77, 0x00, 0xfe, 0xfe, 0xfe, 0x00, 0x00, 0x00, 0x00, 0x00, 0xfe		 //tile:58 
, 0xfe, 0x00, 0x00, 0x89, 0xff, 0xb4, 0xff, 0xff, 0x00, 0x00, 0x77, 0x00, 0xff, 0xb4, 0xff, 0xff, 0x00, 0x00, 0x14, 0x00, 0x89, 0xb4, 0xa2, 0xa2, 0xfe, 0x00, 0x00, 0x14, 0x00, 0x89, 0xa2, 0xa2, 0xfe, 0x00, 0x00, 0x14, 0x00, 0xfe, 0x89, 0x89, 0xfe, 0xfe, 0x00, 0x00, 0xfe, 0xfe, 0xfe, 0xfe, 0xfe, 0xfe, 0xfe, 0xfe, 0xfe, 0xfe, 0xfe, 0xfe, 0xfe, 0xfe, 0xfe, 0xfe, 0xfe, 0xfe, 0xfe, 0xfe		 //tile:59 
, 0xa2, 0xa2, 0x14, 0xff, 0xff, 0xff, 0xff, 0x14, 0xa2, 0xa2, 0xa2, 0x14, 0xff, 0xff, 0x14, 0xfe, 0xa2, 0xa2, 0xa2, 0xa2, 0x14, 0x14, 0x00, 0xfe, 0xa2, 0xa2, 0x89, 0x89, 0x89, 0x14, 0x00, 0xfe, 0x89, 0x89, 0xfe, 0x00, 0x77, 0x14, 0x00, 0xfe, 0xfe, 0xfe, 0xfe, 0xfe, 0x00, 0x00, 0xfe, 0xfe, 0xfe, 0xfe, 0xfe, 0xfe, 0xfe, 0xfe, 0xfe, 0xfe, 0xfe, 0xfe, 0xfe, 0xfe, 0xfe, 0xfe, 0xfe, 0xfe		 //tile:60 
, 0xfe, 0x00, 0x00, 0xff, 0x14, 0x89, 0x14, 0x14, 0x00, 0x00, 0x77, 0x00, 0x89, 0xb4, 0xb4, 0xa2, 0x00, 0x00, 0x14, 0x00, 0xff, 0xb4, 0xff, 0xff, 0x00, 0x00, 0x14, 0x00, 0xff, 0xb4, 0xff, 0xff, 0x00, 0x00, 0x14, 0x00, 0x89, 0xb4, 0xa2, 0xa2, 0xfe, 0x00, 0x00, 0xfe, 0xfe, 0x89, 0xa2, 0xa2, 0xfe, 0xfe, 0xfe, 0xfe, 0xfe, 0xfe, 0x89, 0x89, 0xfe, 0xfe, 0xfe, 0xfe, 0xfe, 0xfe, 0xfe, 0xfe		 //tile:61 
, 0x14, 0x14, 0x14, 0xff, 0xff, 0xff, 0xff, 0x14, 0xa2, 0x57, 0x57, 0x14, 0xff, 0xff, 0x14, 0xfe, 0xa2, 0xa2, 0xa2, 0x89, 0x14, 0x14, 0x00, 0xfe, 0xa2, 0xa2, 0xa2, 0x89, 0x14, 0x14, 0x00, 0xfe, 0xa2, 0xa2, 0x89, 0x89, 0x77, 0x14, 0x00, 0xfe, 0xa2, 0x89, 0x89, 0xfe, 0x00, 0x00, 0xfe, 0xfe, 0x89, 0x89, 0xfe, 0xfe, 0xfe, 0xfe, 0xfe, 0xfe, 0xfe, 0xfe, 0xfe, 0xfe, 0xfe, 0xfe, 0xfe, 0xfe		 //tile:62 
};

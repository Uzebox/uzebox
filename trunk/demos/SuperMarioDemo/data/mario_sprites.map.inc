const char map_rwalk1[] PROGMEM ={
2,3
,0x00,0x01,0x11,0x12,0x2b,0x2c};
const char map_rwalk2[] PROGMEM ={
2,3
,0x00,0x02,0x13,0x12,0x2d,0x2e};
const char map_rskid[] PROGMEM ={
2,3
,0x00,0x01,0x14,0x15,0x2f,0x30};
const char map_rjump1[] PROGMEM ={
2,3
,0x00,0x03,0x16,0x17,0x31,0x32};
const char map_rjump2[] PROGMEM ={
2,3
,0x00,0x01,0x18,0x19,0x33,0x34};
const char map_lwalk1[] PROGMEM ={
2,3
,0x04,0x05,0x1a,0x1b,0x35,0x36};
const char map_lwalk2[] PROGMEM ={
2,3
,0x06,0x05,0x1a,0x1c,0x37,0x38};
const char map_lskid[] PROGMEM ={
2,3
,0x04,0x05,0x1d,0x1e,0x39,0x3a};
const char map_ljump1[] PROGMEM ={
2,3
,0x07,0x05,0x1f,0x20,0x3b,0x3c};
const char map_ljump2[] PROGMEM ={
2,3
,0x04,0x05,0x21,0x22,0x3d,0x3e};
const char map_lgoomba1[] PROGMEM ={
2,2
,0x08,0x09,0x23,0x24};
const char map_lgoomba2[] PROGMEM ={
2,2
,0x0a,0x0b,0x25,0x26};
const char map_rgoomba1[] PROGMEM ={
2,2
,0x0c,0x0d,0x27,0x28};
const char map_rgoomba2[] PROGMEM ={
2,2
,0x0e,0x0f,0x29,0x2a};

const char map_main[] PROGMEM ={
27,22
,0x00,0x00,0x00,0x00,0x00,0x00,0x00,0x00,0x00,0x00,0x00,0x00,0x00,0x00,0x00,0x00,0x00,0x00,0x00,0x00
,0x00,0x00,0x00,0x00,0x00,0x00,0x00,0x93,0x1e,0x1a,0x1b,0x1c,0x1d,0x1e,0x1f,0x1a,0x1b,0x1c,0x1d,0x1e
,0x1f,0x1a,0x1b,0x1c,0x1d,0x1e,0x1f,0x1a,0x1b,0x1c,0x1d,0x1e,0x1f,0x94,0x95,0x96,0x97,0x98,0x99,0x95
,0x96,0x33,0x97,0x98,0x99,0x95,0x96,0x33,0x97,0x98,0x99,0x95,0x96,0x33,0x97,0x98,0x99,0x95,0x96,0x33
,0x97,0x05,0x06,0x00,0x00,0x00,0x00,0x00,0x00,0x00,0x00,0x00,0x00,0x00,0x00,0x00,0x00,0x00,0x00,0x00
,0x00,0x00,0x00,0x00,0x00,0x00,0x00,0x01,0x10,0x11,0x00,0x00,0x00,0x00,0x00,0x00,0x00,0x00,0x00,0x00
,0x00,0x00,0x00,0x00,0x00,0x00,0x00,0x00,0x00,0x00,0x00,0x00,0x00,0x00,0x0c,0x1e,0x1f,0x00,0x00,0x00
,0x00,0x00,0x00,0x00,0x00,0x00,0x00,0x00,0x00,0x00,0x00,0x00,0x00,0x00,0x00,0x00,0x00,0x00,0x00,0x00
,0x00,0x1a,0x96,0x33,0x00,0x00,0x00,0x00,0x00,0x00,0x00,0x00,0x00,0x00,0x00,0x00,0x00,0x00,0x00,0x00
,0x00,0x00,0x00,0x00,0x00,0x00,0x00,0x00,0x97,0x05,0x06,0x00,0x00,0x00,0x00,0x00,0x00,0x00,0x00,0x00
,0x00,0x00,0x00,0x00,0x00,0x00,0x00,0x00,0x00,0x00,0x00,0x00,0x00,0x00,0x00,0x01,0x10,0x11,0x00,0x00
,0x00,0x00,0x00,0x00,0x00,0x00,0x00,0x00,0x00,0x00,0x00,0x00,0x00,0x00,0x00,0x00,0x00,0x00,0x00,0x00
,0x00,0x00,0x0c,0x1e,0x1f,0x00,0x00,0x00,0x00,0x00,0x00,0x00,0x00,0x00,0x00,0x00,0x00,0x00,0x00,0x00
,0x00,0x00,0x00,0x00,0x00,0x00,0x00,0x00,0x00,0x1a,0x96,0x33,0x00,0x00,0x00,0x00,0x00,0x00,0x00,0x00
,0x00,0x00,0x00,0x00,0x00,0x00,0x00,0x00,0x00,0x00,0x00,0x00,0x00,0x00,0x00,0x00,0x97,0x05,0x06,0x00
,0x00,0x00,0x00,0x00,0x00,0x00,0x00,0x00,0x00,0x00,0x00,0x00,0x00,0x00,0x00,0x00,0x00,0x00,0x00,0x00
,0x00,0x00,0x00,0x01,0x10,0x11,0x00,0x00,0x00,0x00,0x00,0x00,0x00,0x00,0x00,0x00,0x00,0x00,0x00,0x00
,0x00,0x00,0x00,0x00,0x00,0x00,0x00,0x00,0x00,0x00,0x0c,0x1e,0x1f,0x00,0x00,0x00,0x00,0x00,0x00,0x00
,0x00,0x00,0x00,0x00,0x00,0x00,0x00,0x00,0x00,0x00,0x00,0x00,0x00,0x00,0x00,0x00,0x00,0x1a,0x96,0x33
,0x00,0x00,0x00,0x00,0x00,0x00,0x00,0x00,0x00,0x00,0x00,0x00,0x00,0x00,0x00,0x00,0x00,0x00,0x00,0x00
,0x00,0x00,0x00,0x00,0x97,0x05,0x06,0x00,0x00,0x00,0x00,0x00,0x00,0x00,0x00,0x00,0x00,0x00,0x00,0x00
,0x00,0x00,0x00,0x00,0x00,0x00,0x00,0x00,0x00,0x00,0x00,0x01,0x10,0x11,0x00,0x00,0x00,0x00,0x00,0x00
,0x00,0x00,0x00,0x00,0x00,0x00,0x00,0x00,0x00,0x00,0x00,0x00,0x00,0x00,0x00,0x00,0x00,0x00,0x0c,0x1e
,0x1f,0x00,0x00,0x00,0x00,0x00,0x00,0x00,0x00,0x00,0x00,0x00,0x00,0x00,0x00,0x00,0x00,0x00,0x00,0x00
,0x00,0x00,0x00,0x00,0x00,0x1a,0x96,0x33,0x00,0x00,0x00,0x00,0x00,0x00,0x00,0x00,0x00,0x00,0x00,0x00
,0x00,0x00,0x00,0x00,0x00,0x00,0x00,0x00,0x00,0x00,0x00,0x00,0x97,0x05,0x06,0x01,0x02,0x03,0x04,0x05
,0x06,0x01,0x02,0x03,0x04,0x05,0x06,0x01,0x02,0x03,0x04,0x05,0x06,0x01,0x02,0x03,0x04,0x05,0x06,0x01
,0x10,0x11,0x0c,0x0d,0x0e,0x0f,0x10,0x11,0x0c,0x0d,0x0e,0x0f,0x10,0x11,0x0c,0x0d,0x0e,0x0f,0x10,0x11
,0x0c,0x0d,0x0e,0x0f,0x10,0x11,0x0c,0x9a,0x1f,0x1a,0x1b,0x1c,0x1d,0x1e,0x1f,0x1a,0x1b,0x1c,0x1d,0x1e
,0x1f,0x1a,0x1b,0x1c,0x1d,0x1e,0x1f,0x1a,0x1b,0x1c,0x1d,0x1e,0x1f,0x9b};
const char map_mole1[] PROGMEM ={
6,4
,0x01,0x02,0x03,0x04,0x05,0x06,0x0c,0x0d,0x0e,0x0f,0x10,0x11,0x1a,0x1b,0x1c,0x1d,0x1e,0x1f,0x2e,0x2f
,0x30,0x31,0x32,0x33};
const char map_mole2[] PROGMEM ={
6,4
,0x01,0x02,0x03,0x04,0x05,0x06,0x0c,0x0d,0x0e,0x0f,0x10,0x11,0x1a,0x20,0x21,0x22,0x1e,0x1f,0x2e,0x34
,0x35,0x36,0x32,0x33};
const char map_mole3[] PROGMEM ={
6,4
,0x01,0x02,0x03,0x04,0x05,0x06,0x0c,0x0d,0x0e,0x0f,0x10,0x11,0x1a,0x23,0x24,0x25,0x1e,0x1f,0x2e,0x37
,0x38,0x39,0x32,0x33};
const char map_mole4[] PROGMEM ={
6,4
,0x01,0x02,0x03,0x04,0x05,0x06,0x0c,0x12,0x13,0x14,0x10,0x11,0x1a,0x26,0x27,0x28,0x1e,0x1f,0x3a,0x3b
,0x3c,0x3d,0x32,0x33};
const char map_mole5[] PROGMEM ={
6,4
,0x01,0x02,0x03,0x04,0x05,0x06,0x0c,0x53,0x24,0x54,0x10,0x11,0x1a,0x6b,0x6c,0x6d,0x1e,0x1f,0x7b,0x7c
,0x7d,0x7e,0x7f,0x33};
const char map_mole6[] PROGMEM ={
6,4
,0x01,0x02,0x03,0x04,0x05,0x06,0x0c,0x55,0x56,0x57,0x10,0x11,0x1a,0x6e,0x6f,0x70,0x1e,0x1f,0x80,0x81
,0x82,0x83,0x7f,0x33};
const char map_mole7[] PROGMEM ={
6,4
,0x01,0x02,0x03,0x04,0x05,0x06,0x0c,0x58,0x59,0x5a,0x10,0x11,0x1a,0x71,0x72,0x73,0x1e,0x1f,0x84,0x85
,0x86,0x87,0x88,0x33};
const char map_hole[] PROGMEM ={
6,4
,0x01,0x02,0x03,0x04,0x05,0x06,0x0c,0x0d,0x0e,0x0f,0x10,0x11,0x1a,0x1b,0x1c,0x1d,0x1e,0x1f,0x2e,0x89
,0x8a,0x8b,0x32,0x33};
const char map_startBtnUp[] PROGMEM ={
5,2
,0x07,0x08,0x09,0x0a,0x0b,0x15,0x16,0x17,0x18,0x19};
const char map_startBtnDown[] PROGMEM ={
5,2
,0x29,0x2a,0x2b,0x2c,0x2d,0x3e,0x3f,0x40,0x41,0x42};
const char map_ready[] PROGMEM ={
7,2
,0x43,0x44,0x45,0x46,0x47,0x48,0x49,0x5b,0x5c,0x5d,0x5e,0x5f,0x60,0x61};
const char map_gameOver[] PROGMEM ={
9,2
,0x4a,0x4b,0x4c,0x4d,0x4e,0x4f,0x50,0x51,0x52,0x62,0x63,0x64,0x65,0x66,0x67,0x68,0x69,0x6a};
const char map_whack[] PROGMEM ={
7,2
,0x74,0x75,0x76,0x77,0x78,0x79,0x7a,0x8c,0x8d,0x8e,0x8f,0x90,0x91,0x92};

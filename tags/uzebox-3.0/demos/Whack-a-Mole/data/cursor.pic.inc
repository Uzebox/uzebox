//picture: cursor.raw
//Horizontal Tiles=16
//Vertical Tiles=16
//Tile Width=8
//Tile Height=8
#define CURSOR_TILESET_SIZE 21

const char cursor_tileset[] PROGMEM ={
 0xfe, 0xfe, 0xfe, 0xfe, 0xfe, 0x00, 0x00, 0xfe, 0xfe, 0xfe, 0xfe, 0xfe, 0x00, 0xff, 0xad, 0x01, 0xfe, 0xfe, 0xfe, 0xfe, 0x00, 0xff, 0xad, 0x01, 0xfe, 0xfe, 0xfe, 0xfe, 0x00, 0xff, 0xad, 0x00, 0xfe, 0xfe, 0xfe, 0xfe, 0x00, 0xff, 0xad, 0x00, 0xfe, 0xfe, 0xfe, 0xfe, 0x00, 0xff, 0xad, 0x00, 0xfe, 0x00, 0x00, 0xfe, 0x00, 0xff, 0xff, 0x00, 0x00, 0xff, 0xff, 0x00, 0x00, 0xff, 0xff, 0xff		 //tile:0 
, 0xfe, 0xfe, 0xfe, 0xfe, 0xfe, 0xfe, 0xfe, 0xfe, 0xfe, 0xfe, 0xfe, 0xfe, 0xfe, 0xfe, 0xfe, 0xfe, 0xfe, 0xfe, 0xfe, 0xfe, 0xfe, 0xfe, 0xfe, 0xfe, 0xfe, 0xfe, 0xfe, 0xfe, 0xfe, 0xfe, 0xfe, 0xfe, 0x00, 0x00, 0x00, 0x00, 0xfe, 0xfe, 0xfe, 0xfe, 0xff, 0xad, 0x00, 0xad, 0x00, 0x00, 0xfe, 0xfe, 0xff, 0xad, 0x00, 0xad, 0x00, 0xad, 0x00, 0xfe, 0xff, 0xff, 0xff, 0xad, 0xff, 0xad, 0x00, 0xfe		 //tile:1 
, 0xfe, 0xfe, 0xfe, 0xfe, 0xfe, 0xfe, 0xfe, 0xfe, 0xfe, 0xfe, 0xfe, 0xfe, 0xfe, 0xfe, 0xfe, 0xfe, 0xfe, 0xfe, 0xfe, 0xfe, 0xfe, 0xfe, 0xfe, 0xfe, 0xfe, 0xfe, 0xfe, 0xfe, 0xfe, 0xfe, 0xfe, 0xfe, 0xfe, 0xfe, 0xfe, 0xfe, 0xfe, 0xfe, 0xfe, 0xfe, 0xfe, 0xfe, 0xfe, 0xfe, 0xfe, 0xfe, 0xfe, 0xfe, 0xfe, 0xfe, 0xfe, 0xfe, 0xfe, 0xfe, 0xfe, 0xfe, 0xfe, 0xfe, 0xfe, 0xfe, 0xfe, 0xfe, 0xfe, 0xfe		 //tile:2 
, 0xfe, 0xfe, 0xfe, 0xfe, 0xfe, 0xfe, 0xfe, 0xfe, 0xfe, 0xfe, 0xfe, 0xfe, 0xfe, 0xfe, 0xfe, 0xfe, 0xfe, 0xfe, 0xfe, 0xfe, 0xfe, 0x00, 0x00, 0xfe, 0xfe, 0xfe, 0xfe, 0xfe, 0x00, 0x0b, 0x0b, 0x00, 0xfe, 0xfe, 0xfe, 0x00, 0x6e, 0x1e, 0x00, 0x0b, 0xfe, 0xfe, 0xfe, 0x00, 0x14, 0x00, 0x0b, 0x14, 0xfe, 0xfe, 0xfe, 0xfe, 0x00, 0x0b, 0x14, 0x6e, 0xfe, 0xfe, 0xfe, 0x00, 0x0b, 0x14, 0x6e, 0x6e		 //tile:3 
, 0xfe, 0xfe, 0x00, 0x00, 0xfe, 0xfe, 0xfe, 0xfe, 0xfe, 0x00, 0x0b, 0x0b, 0x00, 0xfe, 0xfe, 0xfe, 0x00, 0x0b, 0x14, 0x6e, 0x6e, 0x00, 0xfe, 0xfe, 0x0b, 0x14, 0x6e, 0x6e, 0x1e, 0x1e, 0x00, 0xfe, 0x14, 0x6e, 0x6e, 0x1e, 0x1e, 0x1e, 0x1e, 0x00, 0x6e, 0x6e, 0x1e, 0x1e, 0x1e, 0x1e, 0x14, 0x0b, 0x6e, 0x1e, 0x1e, 0x1e, 0x1e, 0x14, 0x14, 0x0b, 0x1e, 0x1e, 0x1e, 0x1e, 0x14, 0x14, 0x0b, 0x0b		 //tile:4 
, 0xfe, 0xfe, 0xfe, 0xfe, 0xfe, 0xfe, 0xfe, 0xfe, 0xfe, 0xfe, 0xfe, 0xfe, 0xfe, 0xfe, 0xfe, 0xfe, 0xfe, 0xfe, 0xfe, 0xfe, 0xfe, 0xfe, 0xfe, 0xfe, 0xfe, 0xfe, 0xfe, 0xfe, 0xfe, 0xfe, 0xfe, 0xfe, 0xfe, 0xfe, 0xfe, 0xfe, 0xfe, 0xfe, 0xfe, 0xfe, 0x00, 0xfe, 0xfe, 0xfe, 0xfe, 0xfe, 0xfe, 0xfe, 0x00, 0xfe, 0xfe, 0xfe, 0xfe, 0xfe, 0xfe, 0xfe, 0x00, 0xfe, 0xfe, 0xfe, 0xfe, 0xfe, 0xfe, 0xfe		 //tile:5 
, 0xfe, 0xfe, 0xfe, 0xfe, 0xfe, 0xfe, 0xfe, 0xfe, 0xfe, 0xfe, 0xfe, 0xfe, 0xfe, 0xfe, 0xfe, 0xfe, 0xfe, 0xfe, 0xfe, 0x00, 0x00, 0x00, 0x00, 0x00, 0xfe, 0xfe, 0x00, 0x0b, 0x14, 0x6e, 0x1e, 0x1e, 0xfe, 0xfe, 0x00, 0x0b, 0x14, 0x6e, 0x1e, 0x1e, 0xfe, 0xfe, 0x00, 0x0b, 0x14, 0x6e, 0x1e, 0x1e, 0xfe, 0xfe, 0x00, 0x0b, 0x14, 0x6e, 0x1e, 0x1e, 0xfe, 0xfe, 0x00, 0x0b, 0x14, 0x6e, 0x1e, 0x1e		 //tile:6 
, 0xfe, 0xfe, 0xfe, 0xfe, 0xfe, 0xfe, 0xfe, 0xfe, 0xfe, 0xfe, 0xfe, 0xfe, 0xfe, 0xfe, 0xfe, 0xfe, 0x00, 0x00, 0xfe, 0xfe, 0xfe, 0xfe, 0xfe, 0xfe, 0x14, 0x0b, 0x00, 0xfe, 0xfe, 0xfe, 0xfe, 0xfe, 0x14, 0x0b, 0x00, 0xfe, 0xfe, 0xfe, 0xfe, 0xfe, 0x14, 0x0b, 0x00, 0xfe, 0xfe, 0xfe, 0xfe, 0xfe, 0x14, 0x0b, 0x00, 0xfe, 0xfe, 0xfe, 0xfe, 0xfe, 0x14, 0x0b, 0x00, 0xfe, 0xfe, 0xfe, 0xfe, 0xfe		 //tile:7 
, 0x00, 0xff, 0xff, 0xad, 0x00, 0xff, 0xff, 0x00, 0xfe, 0x00, 0xff, 0xff, 0xad, 0xff, 0xff, 0x00, 0xfe, 0xfe, 0x00, 0xff, 0xff, 0xff, 0xff, 0x00, 0xfe, 0xfe, 0x00, 0xff, 0xff, 0xff, 0xff, 0x00, 0xfe, 0xfe, 0xfe, 0x00, 0xff, 0xff, 0xff, 0xff, 0xfe, 0xfe, 0xfe, 0xfe, 0x00, 0xff, 0xff, 0xff, 0xfe, 0xfe, 0xfe, 0xfe, 0xfe, 0x00, 0xad, 0xad, 0xfe, 0xfe, 0xfe, 0xfe, 0xfe, 0xfe, 0x00, 0x00		 //tile:8 
, 0xad, 0x00, 0xad, 0x00, 0xff, 0xad, 0x00, 0xfe, 0xad, 0x00, 0xad, 0x00, 0xff, 0xad, 0x00, 0xfe, 0xad, 0x00, 0xad, 0x00, 0xff, 0xad, 0x00, 0xfe, 0xad, 0x00, 0xad, 0x00, 0xff, 0xad, 0x00, 0xfe, 0xff, 0xff, 0xff, 0xff, 0xad, 0x00, 0xfe, 0xfe, 0xff, 0xff, 0xff, 0xad, 0xad, 0x00, 0xfe, 0xfe, 0xad, 0xad, 0xad, 0xad, 0x00, 0xfe, 0xfe, 0xfe, 0x00, 0x00, 0x00, 0x00, 0xfe, 0xfe, 0xfe, 0xfe		 //tile:9 
, 0xfe, 0xfe, 0x00, 0x0b, 0x14, 0x6e, 0x6e, 0x1e, 0xfe, 0x00, 0x0b, 0x14, 0x6e, 0x6e, 0x1e, 0x1e, 0x00, 0x0b, 0x14, 0x6e, 0x6e, 0x1e, 0x1e, 0x1e, 0x00, 0x14, 0x6e, 0x6e, 0x1e, 0x1e, 0x1e, 0x1e, 0xfe, 0x00, 0x6e, 0x1e, 0x1e, 0x1e, 0x1e, 0x14, 0xfe, 0xfe, 0x00, 0x1e, 0x1e, 0x1e, 0x14, 0x14, 0xfe, 0xfe, 0xfe, 0x00, 0x14, 0x14, 0x14, 0x0b, 0xfe, 0xfe, 0xfe, 0xfe, 0x00, 0x0b, 0x0b, 0x0b		 //tile:10 
, 0x1e, 0x1e, 0x1e, 0x14, 0x14, 0x0b, 0x0b, 0x00, 0x1e, 0x1e, 0x14, 0x14, 0x0b, 0x0b, 0x00, 0xfe, 0x1e, 0x14, 0x14, 0x0b, 0x0b, 0x00, 0xfe, 0xfe, 0x14, 0x14, 0x0b, 0x0b, 0x00, 0x00, 0x00, 0xfe, 0x14, 0x0b, 0x0b, 0x00, 0x00, 0x00, 0x0b, 0x00, 0x0b, 0x0b, 0x00, 0x00, 0x00, 0x0b, 0x14, 0x0b, 0x0b, 0x00, 0xfe, 0x00, 0x0b, 0x14, 0x14, 0x14, 0x00, 0xfe, 0xfe, 0xfe, 0x00, 0x14, 0x1e, 0x1e		 //tile:11 
, 0xfe, 0xfe, 0xfe, 0xfe, 0xfe, 0xfe, 0xfe, 0xfe, 0xfe, 0xfe, 0xfe, 0xfe, 0xfe, 0xfe, 0xfe, 0xfe, 0xfe, 0xfe, 0xfe, 0xfe, 0xfe, 0xfe, 0xfe, 0xfe, 0xfe, 0xfe, 0xfe, 0xfe, 0xfe, 0xfe, 0xfe, 0xfe, 0xfe, 0xfe, 0xfe, 0xfe, 0xfe, 0xfe, 0xfe, 0xfe, 0x00, 0xfe, 0xfe, 0xfe, 0xfe, 0xfe, 0xfe, 0xfe, 0x0b, 0x00, 0xfe, 0xfe, 0xfe, 0xfe, 0xfe, 0xfe, 0x14, 0x0b, 0x00, 0xfe, 0xfe, 0xfe, 0xfe, 0xfe		 //tile:12 
, 0xfe, 0x00, 0x00, 0x0b, 0x14, 0x6e, 0x1e, 0x1e, 0x00, 0x1e, 0x00, 0x0b, 0x14, 0x6e, 0x1e, 0x1e, 0x00, 0x14, 0x00, 0x0b, 0x14, 0x6e, 0x1e, 0x1e, 0x00, 0x0b, 0x00, 0x0b, 0x14, 0x6e, 0x1e, 0x1e, 0xfe, 0x00, 0x00, 0x0b, 0x14, 0x6e, 0x1e, 0x1e, 0xfe, 0xfe, 0x00, 0x0b, 0x14, 0x6e, 0x1e, 0x1e, 0xfe, 0xfe, 0x00, 0x0b, 0x14, 0x6e, 0x1e, 0x1e, 0xfe, 0xfe, 0x00, 0x0b, 0x14, 0x6e, 0x1e, 0x1e		 //tile:13 
, 0x14, 0x0b, 0x00, 0x00, 0x00, 0x00, 0x00, 0x00, 0x14, 0x0b, 0x00, 0x00, 0x1e, 0x1e, 0x1e, 0x1e, 0x14, 0x0b, 0x00, 0x00, 0x14, 0x14, 0x14, 0x14, 0x14, 0x0b, 0x00, 0x00, 0x0b, 0x0b, 0x0b, 0x0b, 0x14, 0x0b, 0x00, 0x00, 0x00, 0x00, 0x00, 0x00, 0x14, 0x0b, 0x00, 0xfe, 0xfe, 0xfe, 0xfe, 0xfe, 0x14, 0x0b, 0x00, 0xfe, 0xfe, 0xfe, 0xfe, 0xfe, 0x14, 0x0b, 0x00, 0xfe, 0xfe, 0xfe, 0xfe, 0xfe		 //tile:14 
, 0x00, 0x00, 0x00, 0x00, 0x00, 0x00, 0x00, 0xfe, 0x1e, 0x1e, 0x1e, 0x1e, 0x1e, 0x1e, 0x0b, 0x00, 0x14, 0x14, 0x14, 0x14, 0x14, 0x14, 0x0b, 0x00, 0x0b, 0x0b, 0x0b, 0x0b, 0x0b, 0x0b, 0x0b, 0x00, 0x00, 0x00, 0x00, 0x00, 0x00, 0x00, 0x00, 0xfe, 0xfe, 0xfe, 0xfe, 0xfe, 0xfe, 0xfe, 0xfe, 0xfe, 0xfe, 0xfe, 0xfe, 0xfe, 0xfe, 0xfe, 0xfe, 0xfe, 0xfe, 0xfe, 0xfe, 0xfe, 0xfe, 0xfe, 0xfe, 0xfe		 //tile:15 
, 0xfe, 0xfe, 0xfe, 0xfe, 0xfe, 0x00, 0x00, 0x00, 0xfe, 0xfe, 0xfe, 0xfe, 0xfe, 0xfe, 0xfe, 0xfe, 0xfe, 0xfe, 0xfe, 0xfe, 0xfe, 0xfe, 0xfe, 0xfe, 0xfe, 0xfe, 0xfe, 0xfe, 0xfe, 0xfe, 0xfe, 0xfe, 0xfe, 0xfe, 0xfe, 0xfe, 0xfe, 0xfe, 0xfe, 0xfe, 0xfe, 0xfe, 0xfe, 0xfe, 0xfe, 0xfe, 0xfe, 0xfe, 0xfe, 0xfe, 0xfe, 0xfe, 0xfe, 0xfe, 0xfe, 0xfe, 0xfe, 0xfe, 0xfe, 0xfe, 0xfe, 0xfe, 0xfe, 0xfe		 //tile:16 
, 0xfe, 0xfe, 0xfe, 0xfe, 0xfe, 0x00, 0x14, 0x1e, 0xfe, 0xfe, 0xfe, 0xfe, 0xfe, 0xfe, 0x00, 0x14, 0xfe, 0xfe, 0xfe, 0xfe, 0xfe, 0xfe, 0xfe, 0x00, 0xfe, 0xfe, 0xfe, 0xfe, 0xfe, 0xfe, 0xfe, 0xfe, 0xfe, 0xfe, 0xfe, 0xfe, 0xfe, 0xfe, 0xfe, 0xfe, 0xfe, 0xfe, 0xfe, 0xfe, 0xfe, 0xfe, 0xfe, 0xfe, 0xfe, 0xfe, 0xfe, 0xfe, 0xfe, 0xfe, 0xfe, 0xfe, 0xfe, 0xfe, 0xfe, 0xfe, 0xfe, 0xfe, 0xfe, 0xfe		 //tile:17 
, 0x1e, 0x14, 0x0b, 0x00, 0xfe, 0xfe, 0xfe, 0xfe, 0x1e, 0x1e, 0x14, 0x0b, 0x00, 0xfe, 0xfe, 0xfe, 0x14, 0x1e, 0x1e, 0x1e, 0x0b, 0x00, 0xfe, 0xfe, 0x00, 0x14, 0x1e, 0x1e, 0x14, 0x0b, 0x00, 0xfe, 0xfe, 0x00, 0x14, 0x14, 0x14, 0x0b, 0x00, 0xfe, 0xfe, 0xfe, 0x00, 0x0b, 0x0b, 0x00, 0xfe, 0xfe, 0xfe, 0xfe, 0xfe, 0x00, 0x00, 0xfe, 0xfe, 0xfe, 0xfe, 0xfe, 0xfe, 0xfe, 0xfe, 0xfe, 0xfe, 0xfe		 //tile:18 
, 0xfe, 0xfe, 0x00, 0x0b, 0x14, 0x6e, 0x1e, 0x1e, 0xfe, 0xfe, 0x00, 0x0b, 0x14, 0x6e, 0x1e, 0x1e, 0xfe, 0xfe, 0xfe, 0x00, 0x00, 0x00, 0x00, 0x00, 0xfe, 0xfe, 0xfe, 0xfe, 0xfe, 0xfe, 0xfe, 0xfe, 0xfe, 0xfe, 0xfe, 0xfe, 0xfe, 0xfe, 0xfe, 0xfe, 0xfe, 0xfe, 0xfe, 0xfe, 0xfe, 0xfe, 0xfe, 0xfe, 0xfe, 0xfe, 0xfe, 0xfe, 0xfe, 0xfe, 0xfe, 0xfe, 0xfe, 0xfe, 0xfe, 0xfe, 0xfe, 0xfe, 0xfe, 0xfe		 //tile:19 
, 0x14, 0x0b, 0x00, 0xfe, 0xfe, 0xfe, 0xfe, 0xfe, 0x14, 0x0b, 0x00, 0xfe, 0xfe, 0xfe, 0xfe, 0xfe, 0x00, 0x00, 0xfe, 0xfe, 0xfe, 0xfe, 0xfe, 0xfe, 0xfe, 0xfe, 0xfe, 0xfe, 0xfe, 0xfe, 0xfe, 0xfe, 0xfe, 0xfe, 0xfe, 0xfe, 0xfe, 0xfe, 0xfe, 0xfe, 0xfe, 0xfe, 0xfe, 0xfe, 0xfe, 0xfe, 0xfe, 0xfe, 0xfe, 0xfe, 0xfe, 0xfe, 0xfe, 0xfe, 0xfe, 0xfe, 0xfe, 0xfe, 0xfe, 0xfe, 0xfe, 0xfe, 0xfe, 0xfe		 //tile:20 
};

//*********************************//
// MIDI file: F:\work\uzebox\sources\rev4-beta\demos\MusicDemo\data\dr_mario_03_uzebox_final.mid
//*********************************//
const char song_drmario_main[] PROGMEM ={
0x00,0xb0,0x07,0x7f,0x00,0xb1,0x07,0x7f,0x00,0xb2,0x07,0x7f,0x00,0xc2,0x0d,0x00,0xb2,0x07,0x7f,0x00,0x92,0x2b,0x5a,0x00,0xb3,0x07,0x7f,0x00,0x07,0x40,0x00,0x93,
0x04,0x64,0x01,0xc1,0x1f,0x00,0xb1,0x07,0x6e,0x00,0x91,0x2b,0x57,0x02,0x93,0x04,0x00,0x00,0xc0,0x1f,0x00,0xb0,0x07,0x6e,0x00,0x90,0x2b,0x42,0x08,0x92,0x2b,0x00,
0x01,0x2b,0x5a,0x00,0x93,0x04,0x64,0x01,0x91,0x2b,0x00,0x00,0x2b,0x57,0x02,0x90,0x2b,0x00,0x00,0x93,0x04,0x00,0x00,0x90,0x2b,0x42,0x08,0x92,0x2b,0x00,0x01,0x2e,
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0x3d,0x93,0x07,0x64,0x03,0x07,0x00,0x12,0xff,0x06,0x01,0x45,0x04,0x91,0x2c,0x00,0x01,0x90,0x2c,0x00,0x00,0xff,0x2f,0x00 };

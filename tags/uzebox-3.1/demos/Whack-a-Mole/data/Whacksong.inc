//*********************************//
// MIDI file: C:\Documents and Settings\Admin\My Documents\projet\atmel\uzebox2\\demos\MouseTest\data\Whacksong\Whacksong.mid
//*********************************//
const char song_Whacksong[] PROGMEM ={
0x00,0xc0,0x00,0x00,0xb0,0x07,0x7f,0x00,0xc0,0x00,0x00,0xc1,0x00,0x00,0xb1,0x07,0x6a,0x00,0xc2,0x00,0x00,0xb2,0x07,0x6c,0x00,0x90,0x47,0x61,0x00,0xc2,0x00,0x00,
0x92,0x3b,0x60,0x00,0xc1,0x00,0x00,0x91,0x43,0x61,0x04,0x43,0x00,0x00,0x90,0x47,0x00,0x08,0x92,0x3b,0x00,0x06,0x90,0x53,0x58,0x00,0x91,0x4f,0x58,0x04,0x90,0x53,
0x00,0x00,0x91,0x4f,0x00,0x02,0x90,0x47,0x4d,0x00,0x91,0x43,0x4d,0x04,0x90,0x47,0x00,0x00,0x91,0x43,0x00,0x09,0x90,0x53,0x61,0x00,0x91,0x4f,0x61,0x04,0x90,0x53,
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0x01,0x90,0x4a,0x00,0x01,0x91,0x47,0x00,0x00,0xff,0x2f,0x00 };

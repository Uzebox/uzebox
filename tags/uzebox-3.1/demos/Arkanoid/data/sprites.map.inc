const char map_vaus1[] PROGMEM ={
5,2
,0x18,0x19,0x19,0x1a,0x1b,0x22,0x23,0x24,0x25,0x26};
const char map_vaus2[] PROGMEM ={
5,2
,0x1c,0x19,0x19,0x1d,0x1b,0x22,0x23,0x24,0x25,0x26};
const char map_vaus3[] PROGMEM ={
5,2
,0x1e,0x19,0x19,0x1f,0x1b,0x22,0x23,0x24,0x25,0x26};
const char map_vaus4[] PROGMEM ={
5,2
,0x20,0x19,0x19,0x21,0x1b,0x22,0x23,0x24,0x25,0x26};
const char map_vausLong1[] PROGMEM ={
7,2
,0x18,0x19,0x19,0x19,0x19,0x1a,0x1b,0x22,0x23,0x24,0x24,0x24,0x25,0x26};
const char map_vausLong2[] PROGMEM ={
7,2
,0x1c,0x19,0x19,0x19,0x19,0x1d,0x1b,0x22,0x23,0x24,0x24,0x24,0x25,0x26};
const char map_vausLong3[] PROGMEM ={
7,2
,0x1e,0x19,0x19,0x19,0x19,0x1f,0x1b,0x22,0x23,0x24,0x24,0x24,0x25,0x26};
const char map_vausLong4[] PROGMEM ={
7,2
,0x20,0x19,0x19,0x19,0x19,0x21,0x1b,0x22,0x23,0x24,0x24,0x24,0x25,0x26};
const char map_vausdie1[] PROGMEM ={
5,2
,0x27,0x28,0x29,0x2a,0x1b,0x22,0x23,0x24,0x25,0x26};
const char map_vausdie2[] PROGMEM ={
5,2
,0x2b,0x2c,0x2d,0x2e,0x1b,0x22,0x23,0x24,0x25,0x26};
const char map_vausdie3[] PROGMEM ={
5,2
,0x2f,0x30,0x31,0x32,0x17,0x41,0x42,0x43,0x44,0x17};
const char map_vausdie4[] PROGMEM ={
5,2
,0x33,0x34,0x35,0x36,0x37,0x45,0x46,0x47,0x48,0x49};
const char map_vausdie5[] PROGMEM ={
5,2
,0x38,0x39,0x3a,0x3b,0x3c,0x4a,0x4b,0x4c,0x4d,0x4e};
const char map_vausdie6[] PROGMEM ={
5,2
,0x3d,0x3e,0x3f,0x17,0x40,0x4f,0x50,0x51,0x52,0x53};
const char map_vauswarp1[] PROGMEM ={
5,2
,0x54,0x55,0x56,0x57,0x17,0x17,0x17,0x17,0x17,0x17};
const char map_vauswarp2[] PROGMEM ={
5,2
,0x58,0x59,0x5a,0x5b,0x17,0x17,0x17,0x17,0x17,0x17};
const char map_vauswarp3[] PROGMEM ={
5,2
,0x5c,0x5d,0x5e,0x5f,0x17,0x17,0x17,0x17,0x17,0x17};
const char map_vauswarp4[] PROGMEM ={
5,2
,0x60,0x61,0x62,0x63,0x17,0x17,0x17,0x17,0x17,0x17};
const char map_vauswarp5[] PROGMEM ={
5,2
,0x64,0x65,0x66,0x67,0x1b,0x22,0x23,0x24,0x25,0x26};
const char map_vauswarp6[] PROGMEM ={
5,2
,0x68,0x69,0x6a,0x6b,0x1b,0x22,0x23,0x24,0x25,0x26};
const char map_vausLeftHalf[] PROGMEM ={
2,2
,0x18,0x19,0x22,0x23};
const char map_vausRightHalf[] PROGMEM ={
3,2
,0x19,0x1a,0x1b,0x24,0x25,0x26};
const char map_vausMiddle[] PROGMEM ={
1,2
,0x19,0x24};
const char map_vausTransformLaser1[] PROGMEM ={
5,2
,0x6c,0x19,0x19,0x6d,0x17,0x7a,0x7b,0x24,0x7c,0x17};
const char map_vausTransformLaser2[] PROGMEM ={
5,2
,0x6e,0x19,0x19,0x6f,0x17,0x17,0x7d,0x24,0x7c,0x17};
const char map_vausTransformLaser3[] PROGMEM ={
5,2
,0x17,0x19,0x19,0x70,0x17,0x17,0x7e,0x24,0x7f,0x17};
const char map_vausTransformLaser4[] PROGMEM ={
5,2
,0x71,0x72,0x73,0x74,0x17,0x17,0x80,0x24,0x81,0x17};
const char map_vausTransformLaser5[] PROGMEM ={
5,2
,0x75,0x76,0x77,0x78,0x79,0x82,0x83,0x24,0x84,0x85};
const char map_vausLaser1[] PROGMEM ={
5,2
,0x86,0x76,0x77,0x87,0x88,0x8f,0x23,0x24,0x25,0x90};
const char map_vausLaser2[] PROGMEM ={
5,2
,0x89,0x76,0x77,0x8a,0x88,0x8f,0x23,0x24,0x25,0x90};
const char map_vausLaser3[] PROGMEM ={
5,2
,0x8b,0x76,0x77,0x8c,0x88,0x8f,0x23,0x24,0x25,0x90};
const char map_vausLaser4[] PROGMEM ={
5,2
,0x8d,0x76,0x77,0x8e,0x88,0x8f,0x23,0x24,0x25,0x90};
const char map_round[] PROGMEM ={
5,1
,0x0f,0x10,0x11,0x12,0x13};
const char map_ready[] PROGMEM ={
5,1
,0x0f,0x14,0x15,0x13,0x16};
const char map_s_powerup1[] PROGMEM ={
2,1
,0x91,0x92};
const char map_s_powerup2[] PROGMEM ={
2,1
,0x93,0x94};
const char map_s_powerup3[] PROGMEM ={
2,1
,0x95,0x96};
const char map_s_powerup4[] PROGMEM ={
2,1
,0x97,0x98};
const char map_e_powerup1[] PROGMEM ={
2,1
,0x99,0x9a};
const char map_e_powerup2[] PROGMEM ={
2,1
,0x9b,0x9c};
const char map_e_powerup3[] PROGMEM ={
2,1
,0x9d,0x9e};
const char map_e_powerup4[] PROGMEM ={
2,1
,0x9f,0xa0};
const char map_d_powerup1[] PROGMEM ={
2,1
,0xa1,0xa2};
const char map_d_powerup2[] PROGMEM ={
2,1
,0xa3,0xa4};
const char map_d_powerup3[] PROGMEM ={
2,1
,0xa5,0xa6};
const char map_d_powerup4[] PROGMEM ={
2,1
,0xa7,0xa8};
const char map_l_powerup1[] PROGMEM ={
2,1
,0xa9,0xaa};
const char map_l_powerup2[] PROGMEM ={
2,1
,0xab,0xac};
const char map_l_powerup3[] PROGMEM ={
2,1
,0xad,0xac};
const char map_l_powerup4[] PROGMEM ={
2,1
,0xae,0xaf};
const char map_c_powerup1[] PROGMEM ={
2,1
,0xb0,0xb1};
const char map_c_powerup2[] PROGMEM ={
2,1
,0xb2,0xb3};
const char map_c_powerup3[] PROGMEM ={
2,1
,0xb4,0xb5};
const char map_c_powerup4[] PROGMEM ={
2,1
,0xb6,0xb7};
const char map_b_powerup1[] PROGMEM ={
2,1
,0xb8,0xb9};
const char map_b_powerup2[] PROGMEM ={
2,1
,0xba,0xbb};
const char map_b_powerup3[] PROGMEM ={
2,1
,0xbc,0xbd};
const char map_b_powerup4[] PROGMEM ={
2,1
,0xbe,0xbf};
const char map_p_powerup1[] PROGMEM ={
2,1
,0xc0,0xc1};
const char map_p_powerup2[] PROGMEM ={
2,1
,0xc2,0xc3};
const char map_p_powerup3[] PROGMEM ={
2,1
,0xc4,0xc5};
const char map_p_powerup4[] PROGMEM ={
2,1
,0xc6,0xc7};

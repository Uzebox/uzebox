//*********************************//
// MIDI file: C:\Documents and Settings\Admin\My Documents\projet\atmel\uzebox2\\demos\Arkanoid\data\arkanoid1_converted.mid
//*********************************//
const char song_arkanoid1[] PROGMEM ={
0x00,0xc0,0x03,0x00,0xb0,0x07,0x7f,0x00,0x07,0x7f,0x00,0x5c,0x00,0x00,0x0b,0x7f,0x00,0xc0,0x00,0x00,0x90,0x30,0x28,0x00,0xb0,0x0b,0x50,0x00,0xb1,0x5c,0x00,0x00,
0x0b,0x7f,0x00,0x07,0x7f,0x00,0xc1,0x00,0x00,0x91,0x2b,0x28,0x00,0xb1,0x0b,0x50,0x00,0xb2,0x0b,0x7f,0x00,0x07,0x7f,0x00,0xc2,0x05,0x00,0x92,0x30,0x7f,0x01,0xb0,
0x0b,0x62,0x00,0xb1,0x0b,0x62,0x04,0xb0,0x0b,0x56,0x00,0xb1,0x0b,0x56,0x02,0xb0,0x0b,0x49,0x00,0xb1,0x0b,0x49,0x02,0x92,0x30,0x00,0x00,0xb0,0x0b,0x38,0x00,0xb1,
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0x0b,0x00,0x01,0x90,0x37,0x00,0x05,0xb1,0x07,0x00,0x00,0xb0,0x07,0x00,0x00,0xff,0x2f,0x00 };

//picture: font8x8_blue_small.raw
//Horizontal Tiles=16
//Vertical Tiles=4
//Tile Width=8
//Tile Height=8
#define FONT_TILESET_BLUE_SIZE 64

const char font_tileset_blue[] PROGMEM ={
 0x48, 0x48, 0x48, 0x48, 0x48, 0x48, 0x48, 0x48, 0x48, 0x48, 0x48, 0x48, 0x48, 0x48, 0x48, 0x48, 0x48, 0x48, 0x48, 0x48, 0x48, 0x48, 0x48, 0x48, 0x48, 0x48, 0x48, 0x48, 0x48, 0x48, 0x48, 0x48, 0x48, 0x48, 0x48, 0x48, 0x48, 0x48, 0x48, 0x48, 0x48, 0x48, 0x48, 0x48, 0x48, 0x48, 0x48, 0x48, 0x48, 0x48, 0x48, 0x48, 0x48, 0x48, 0x48, 0x48, 0x48, 0x48, 0x48, 0x48, 0x48, 0x48, 0x48, 0x48		 //tile:0 
, 0x48, 0x48, 0x48, 0x48, 0x48, 0x48, 0x48, 0x48, 0x48, 0x48, 0x48, 0x48, 0x48, 0x48, 0x48, 0x48, 0x48, 0x48, 0x48, 0x48, 0x48, 0x48, 0x48, 0x48, 0x48, 0x48, 0x9b, 0x48, 0x48, 0x48, 0x48, 0x48, 0x48, 0x48, 0x9b, 0x48, 0x48, 0x48, 0x48, 0x48, 0x48, 0x48, 0x9b, 0x48, 0x48, 0x48, 0x48, 0x48, 0x48, 0x48, 0x48, 0x48, 0x48, 0x48, 0x48, 0x48, 0x48, 0x48, 0x9b, 0x48, 0x48, 0x48, 0x48, 0x48		 //tile:1 
, 0x48, 0x48, 0x48, 0x48, 0x48, 0x48, 0x48, 0x48, 0x48, 0x48, 0x48, 0x48, 0x48, 0x48, 0x48, 0x48, 0x48, 0x48, 0x48, 0x48, 0x48, 0x48, 0x48, 0x48, 0x9b, 0x9b, 0x48, 0x9b, 0x9b, 0x48, 0x48, 0x48, 0x48, 0x9b, 0x48, 0x48, 0x9b, 0x48, 0x48, 0x48, 0x48, 0x48, 0x48, 0x48, 0x48, 0x48, 0x48, 0x48, 0x48, 0x48, 0x48, 0x48, 0x48, 0x48, 0x48, 0x48, 0x48, 0x48, 0x48, 0x48, 0x48, 0x48, 0x48, 0x48		 //tile:2 
, 0x48, 0x48, 0x48, 0x48, 0x48, 0x48, 0x48, 0x48, 0x48, 0x48, 0x48, 0x48, 0x48, 0x48, 0x48, 0x48, 0x48, 0x48, 0x48, 0x48, 0x48, 0x48, 0x48, 0x48, 0x48, 0x9b, 0x48, 0x9b, 0x48, 0x48, 0x48, 0x48, 0x9b, 0x9b, 0x9b, 0x9b, 0x9b, 0x48, 0x48, 0x48, 0x48, 0x9b, 0x48, 0x9b, 0x48, 0x48, 0x48, 0x48, 0x9b, 0x9b, 0x9b, 0x9b, 0x9b, 0x48, 0x48, 0x48, 0x48, 0x9b, 0x48, 0x9b, 0x48, 0x48, 0x48, 0x48		 //tile:3 
, 0x48, 0x48, 0x48, 0x48, 0x48, 0x48, 0x48, 0x48, 0x48, 0x48, 0x48, 0x48, 0x48, 0x48, 0x48, 0x48, 0x48, 0x48, 0x48, 0x48, 0x48, 0x48, 0x48, 0x48, 0x48, 0x48, 0x48, 0x9b, 0x48, 0x48, 0x48, 0x48, 0x48, 0x9b, 0x9b, 0x9b, 0x9b, 0x9b, 0x48, 0x48, 0x48, 0x9b, 0x48, 0x9b, 0x48, 0x48, 0x48, 0x48, 0x48, 0x9b, 0x9b, 0x9b, 0x9b, 0x9b, 0x48, 0x48, 0x48, 0x48, 0x48, 0x9b, 0x48, 0x48, 0x48, 0x48		 //tile:4 
, 0x48, 0x48, 0x48, 0x48, 0x48, 0x48, 0x48, 0x48, 0x48, 0x48, 0x48, 0x48, 0x48, 0x48, 0x48, 0x48, 0x48, 0x48, 0x48, 0x48, 0x48, 0x48, 0x48, 0x48, 0x48, 0x48, 0x48, 0x48, 0x48, 0x48, 0x48, 0x48, 0x48, 0x9b, 0x48, 0x48, 0x9b, 0x48, 0x48, 0x48, 0x48, 0x48, 0x48, 0x9b, 0x48, 0x48, 0x48, 0x48, 0x48, 0x48, 0x9b, 0x48, 0x48, 0x9b, 0x48, 0x48, 0x48, 0x48, 0x48, 0x48, 0x48, 0x48, 0x48, 0x48		 //tile:5 
, 0x48, 0x48, 0x48, 0x48, 0x48, 0x48, 0x48, 0x48, 0x48, 0x48, 0x48, 0x48, 0x48, 0x48, 0x48, 0x48, 0x48, 0x48, 0x48, 0x48, 0x48, 0x48, 0x48, 0x48, 0x48, 0x48, 0x9b, 0x48, 0x48, 0x48, 0x48, 0x48, 0x48, 0x9b, 0x9b, 0x9b, 0x48, 0x48, 0x48, 0x48, 0x48, 0x9b, 0x48, 0x9b, 0x9b, 0x48, 0x48, 0x48, 0x9b, 0x48, 0x48, 0x9b, 0x48, 0x48, 0x48, 0x48, 0x48, 0x9b, 0x9b, 0x48, 0x9b, 0x48, 0x48, 0x48		 //tile:6 
, 0x48, 0x48, 0x48, 0x48, 0x48, 0x48, 0x48, 0x48, 0x48, 0x48, 0x48, 0x48, 0x48, 0x48, 0x48, 0x48, 0x48, 0x48, 0x48, 0x48, 0x48, 0x48, 0x48, 0x48, 0x48, 0x48, 0x48, 0x9b, 0x48, 0x48, 0x48, 0x48, 0x48, 0x48, 0x9b, 0x48, 0x48, 0x48, 0x48, 0x48, 0x48, 0x48, 0x48, 0x48, 0x48, 0x48, 0x48, 0x48, 0x48, 0x48, 0x48, 0x48, 0x48, 0x48, 0x48, 0x48, 0x48, 0x48, 0x48, 0x48, 0x48, 0x48, 0x48, 0x48		 //tile:7 
, 0x48, 0x48, 0x48, 0x48, 0x48, 0x48, 0x48, 0x48, 0x48, 0x48, 0x48, 0x48, 0x48, 0x48, 0x48, 0x48, 0x48, 0x48, 0x48, 0x48, 0x48, 0x48, 0x48, 0x48, 0x48, 0x48, 0x48, 0x9b, 0x48, 0x48, 0x48, 0x48, 0x48, 0x48, 0x9b, 0x48, 0x48, 0x48, 0x48, 0x48, 0x48, 0x48, 0x9b, 0x48, 0x48, 0x48, 0x48, 0x48, 0x48, 0x48, 0x9b, 0x48, 0x48, 0x48, 0x48, 0x48, 0x48, 0x48, 0x48, 0x9b, 0x48, 0x48, 0x48, 0x48		 //tile:8 
, 0x48, 0x48, 0x48, 0x48, 0x48, 0x48, 0x48, 0x48, 0x48, 0x48, 0x48, 0x48, 0x48, 0x48, 0x48, 0x48, 0x48, 0x48, 0x48, 0x48, 0x48, 0x48, 0x48, 0x48, 0x48, 0x48, 0x9b, 0x48, 0x48, 0x48, 0x48, 0x48, 0x48, 0x48, 0x48, 0x9b, 0x48, 0x48, 0x48, 0x48, 0x48, 0x48, 0x48, 0x9b, 0x48, 0x48, 0x48, 0x48, 0x48, 0x48, 0x48, 0x9b, 0x48, 0x48, 0x48, 0x48, 0x48, 0x48, 0x9b, 0x48, 0x48, 0x48, 0x48, 0x48		 //tile:9 
, 0x48, 0x48, 0x48, 0x48, 0x48, 0x48, 0x48, 0x48, 0x48, 0x48, 0x48, 0x48, 0x48, 0x48, 0x48, 0x48, 0x48, 0x48, 0x48, 0x48, 0x48, 0x48, 0x48, 0x48, 0x48, 0x48, 0x48, 0x48, 0x48, 0x48, 0x48, 0x48, 0x9b, 0x48, 0x9b, 0x48, 0x9b, 0x48, 0x48, 0x48, 0x48, 0x9b, 0x9b, 0x9b, 0x48, 0x48, 0x48, 0x48, 0x9b, 0x48, 0x9b, 0x48, 0x9b, 0x48, 0x48, 0x48, 0x48, 0x48, 0x48, 0x48, 0x48, 0x48, 0x48, 0x48		 //tile:10 
, 0x48, 0x48, 0x48, 0x48, 0x48, 0x48, 0x48, 0x48, 0x48, 0x48, 0x48, 0x48, 0x48, 0x48, 0x48, 0x48, 0x48, 0x48, 0x48, 0x48, 0x48, 0x48, 0x48, 0x48, 0x48, 0x48, 0x9b, 0x48, 0x48, 0x48, 0x48, 0x48, 0x48, 0x48, 0x9b, 0x48, 0x48, 0x48, 0x48, 0x48, 0x9b, 0x9b, 0x9b, 0x9b, 0x9b, 0x48, 0x48, 0x48, 0x48, 0x48, 0x9b, 0x48, 0x48, 0x48, 0x48, 0x48, 0x48, 0x48, 0x9b, 0x48, 0x48, 0x48, 0x48, 0x48		 //tile:11 
, 0x48, 0x48, 0x48, 0x48, 0x48, 0x48, 0x48, 0x48, 0x48, 0x48, 0x48, 0x48, 0x48, 0x48, 0x48, 0x48, 0x48, 0x48, 0x48, 0x48, 0x48, 0x48, 0x48, 0x48, 0x48, 0x48, 0x48, 0x48, 0x48, 0x48, 0x48, 0x48, 0x48, 0x48, 0x48, 0x48, 0x48, 0x48, 0x48, 0x48, 0x48, 0x48, 0x48, 0x48, 0x48, 0x48, 0x48, 0x48, 0x48, 0x48, 0x9b, 0x48, 0x48, 0x48, 0x48, 0x48, 0x48, 0x9b, 0x48, 0x48, 0x48, 0x48, 0x48, 0x48		 //tile:12 
, 0x48, 0x48, 0x48, 0x48, 0x48, 0x48, 0x48, 0x48, 0x48, 0x48, 0x48, 0x48, 0x48, 0x48, 0x48, 0x48, 0x48, 0x48, 0x48, 0x48, 0x48, 0x48, 0x48, 0x48, 0x48, 0x48, 0x48, 0x48, 0x48, 0x48, 0x48, 0x48, 0x9b, 0x9b, 0x9b, 0x9b, 0x9b, 0x48, 0x48, 0x48, 0x48, 0x48, 0x48, 0x48, 0x48, 0x48, 0x48, 0x48, 0x48, 0x48, 0x48, 0x48, 0x48, 0x48, 0x48, 0x48, 0x48, 0x48, 0x48, 0x48, 0x48, 0x48, 0x48, 0x48		 //tile:13 
, 0x48, 0x48, 0x48, 0x48, 0x48, 0x48, 0x48, 0x48, 0x48, 0x48, 0x48, 0x48, 0x48, 0x48, 0x48, 0x48, 0x48, 0x48, 0x48, 0x48, 0x48, 0x48, 0x48, 0x48, 0x48, 0x48, 0x48, 0x48, 0x48, 0x48, 0x48, 0x48, 0x48, 0x48, 0x48, 0x48, 0x48, 0x48, 0x48, 0x48, 0x48, 0x48, 0x48, 0x48, 0x48, 0x48, 0x48, 0x48, 0x48, 0x48, 0x48, 0x48, 0x48, 0x48, 0x48, 0x48, 0x48, 0x48, 0x9b, 0x48, 0x48, 0x48, 0x48, 0x48		 //tile:14 
, 0x48, 0x48, 0x48, 0x48, 0x48, 0x48, 0x48, 0x48, 0x48, 0x48, 0x48, 0x48, 0x48, 0x48, 0x48, 0x48, 0x48, 0x48, 0x48, 0x48, 0x48, 0x48, 0x48, 0x48, 0x48, 0x48, 0x48, 0x48, 0x9b, 0x48, 0x48, 0x48, 0x48, 0x48, 0x48, 0x9b, 0x48, 0x48, 0x48, 0x48, 0x48, 0x48, 0x9b, 0x48, 0x48, 0x48, 0x48, 0x48, 0x48, 0x9b, 0x48, 0x48, 0x48, 0x48, 0x48, 0x48, 0x9b, 0x48, 0x48, 0x48, 0x48, 0x48, 0x48, 0x48		 //tile:15 
, 0x48, 0x48, 0x48, 0x48, 0x48, 0x48, 0x48, 0x48, 0x48, 0x48, 0x48, 0x48, 0x48, 0x48, 0x48, 0x48, 0x48, 0x48, 0x48, 0x48, 0x48, 0x48, 0x48, 0x48, 0x48, 0x9b, 0x9b, 0x9b, 0x48, 0x48, 0x48, 0x48, 0x9b, 0x9b, 0x48, 0x48, 0x9b, 0x48, 0x48, 0x48, 0x9b, 0x48, 0x9b, 0x48, 0x9b, 0x48, 0x48, 0x48, 0x9b, 0x48, 0x48, 0x9b, 0x9b, 0x48, 0x48, 0x48, 0x48, 0x9b, 0x9b, 0x9b, 0x48, 0x48, 0x48, 0x48		 //tile:16 
, 0x48, 0x48, 0x48, 0x48, 0x48, 0x48, 0x48, 0x48, 0x48, 0x48, 0x48, 0x48, 0x48, 0x48, 0x48, 0x48, 0x48, 0x48, 0x48, 0x48, 0x48, 0x48, 0x48, 0x48, 0x48, 0x48, 0x9b, 0x48, 0x48, 0x48, 0x48, 0x48, 0x48, 0x9b, 0x9b, 0x48, 0x48, 0x48, 0x48, 0x48, 0x48, 0x48, 0x9b, 0x48, 0x48, 0x48, 0x48, 0x48, 0x48, 0x48, 0x9b, 0x48, 0x48, 0x48, 0x48, 0x48, 0x48, 0x9b, 0x9b, 0x9b, 0x48, 0x48, 0x48, 0x48		 //tile:17 
, 0x48, 0x48, 0x48, 0x48, 0x48, 0x48, 0x48, 0x48, 0x48, 0x48, 0x48, 0x48, 0x48, 0x48, 0x48, 0x48, 0x48, 0x48, 0x48, 0x48, 0x48, 0x48, 0x48, 0x48, 0x9b, 0x9b, 0x9b, 0x9b, 0x48, 0x48, 0x48, 0x48, 0x48, 0x48, 0x48, 0x48, 0x9b, 0x48, 0x48, 0x48, 0x48, 0x9b, 0x9b, 0x9b, 0x48, 0x48, 0x48, 0x48, 0x9b, 0x48, 0x48, 0x48, 0x48, 0x48, 0x48, 0x48, 0x9b, 0x9b, 0x9b, 0x9b, 0x9b, 0x48, 0x48, 0x48		 //tile:18 
, 0x48, 0x48, 0x48, 0x48, 0x48, 0x48, 0x48, 0x48, 0x48, 0x48, 0x48, 0x48, 0x48, 0x48, 0x48, 0x48, 0x48, 0x48, 0x48, 0x48, 0x48, 0x48, 0x48, 0x48, 0x9b, 0x9b, 0x9b, 0x9b, 0x48, 0x48, 0x48, 0x48, 0x48, 0x48, 0x48, 0x48, 0x9b, 0x48, 0x48, 0x48, 0x48, 0x9b, 0x9b, 0x9b, 0x48, 0x48, 0x48, 0x48, 0x48, 0x48, 0x48, 0x48, 0x9b, 0x48, 0x48, 0x48, 0x9b, 0x9b, 0x9b, 0x9b, 0x48, 0x48, 0x48, 0x48		 //tile:19 
, 0x48, 0x48, 0x48, 0x48, 0x48, 0x48, 0x48, 0x48, 0x48, 0x48, 0x48, 0x48, 0x48, 0x48, 0x48, 0x48, 0x48, 0x48, 0x48, 0x48, 0x48, 0x48, 0x48, 0x48, 0x9b, 0x48, 0x48, 0x9b, 0x48, 0x48, 0x48, 0x48, 0x9b, 0x48, 0x48, 0x9b, 0x48, 0x48, 0x48, 0x48, 0x9b, 0x9b, 0x9b, 0x9b, 0x9b, 0x48, 0x48, 0x48, 0x48, 0x48, 0x48, 0x9b, 0x48, 0x48, 0x48, 0x48, 0x48, 0x48, 0x48, 0x9b, 0x48, 0x48, 0x48, 0x48		 //tile:20 
, 0x48, 0x48, 0x48, 0x48, 0x48, 0x48, 0x48, 0x48, 0x48, 0x48, 0x48, 0x48, 0x48, 0x48, 0x48, 0x48, 0x48, 0x48, 0x48, 0x48, 0x48, 0x48, 0x48, 0x48, 0x9b, 0x9b, 0x9b, 0x9b, 0x48, 0x48, 0x48, 0x48, 0x9b, 0x48, 0x48, 0x48, 0x48, 0x48, 0x48, 0x48, 0x9b, 0x9b, 0x9b, 0x9b, 0x48, 0x48, 0x48, 0x48, 0x48, 0x48, 0x48, 0x48, 0x9b, 0x48, 0x48, 0x48, 0x9b, 0x9b, 0x9b, 0x9b, 0x48, 0x48, 0x48, 0x48		 //tile:21 
, 0x48, 0x48, 0x48, 0x48, 0x48, 0x48, 0x48, 0x48, 0x48, 0x48, 0x48, 0x48, 0x48, 0x48, 0x48, 0x48, 0x48, 0x48, 0x48, 0x48, 0x48, 0x48, 0x48, 0x48, 0x48, 0x9b, 0x9b, 0x9b, 0x48, 0x48, 0x48, 0x48, 0x9b, 0x48, 0x48, 0x48, 0x48, 0x48, 0x48, 0x48, 0x9b, 0x9b, 0x9b, 0x9b, 0x48, 0x48, 0x48, 0x48, 0x9b, 0x48, 0x48, 0x48, 0x9b, 0x48, 0x48, 0x48, 0x48, 0x9b, 0x9b, 0x9b, 0x48, 0x48, 0x48, 0x48		 //tile:22 
, 0x48, 0x48, 0x48, 0x48, 0x48, 0x48, 0x48, 0x48, 0x48, 0x48, 0x48, 0x48, 0x48, 0x48, 0x48, 0x48, 0x48, 0x48, 0x48, 0x48, 0x48, 0x48, 0x48, 0x48, 0x9b, 0x9b, 0x9b, 0x9b, 0x9b, 0x48, 0x48, 0x48, 0x48, 0x48, 0x48, 0x48, 0x9b, 0x48, 0x48, 0x48, 0x48, 0x48, 0x48, 0x9b, 0x48, 0x48, 0x48, 0x48, 0x48, 0x48, 0x9b, 0x48, 0x48, 0x48, 0x48, 0x48, 0x48, 0x48, 0x9b, 0x48, 0x48, 0x48, 0x48, 0x48		 //tile:23 
, 0x48, 0x48, 0x48, 0x48, 0x48, 0x48, 0x48, 0x48, 0x48, 0x48, 0x48, 0x48, 0x48, 0x48, 0x48, 0x48, 0x48, 0x48, 0x48, 0x48, 0x48, 0x48, 0x48, 0x48, 0x48, 0x9b, 0x9b, 0x9b, 0x48, 0x48, 0x48, 0x48, 0x9b, 0x48, 0x48, 0x48, 0x9b, 0x48, 0x48, 0x48, 0x48, 0x9b, 0x9b, 0x9b, 0x48, 0x48, 0x48, 0x48, 0x9b, 0x48, 0x48, 0x48, 0x9b, 0x48, 0x48, 0x48, 0x48, 0x9b, 0x9b, 0x9b, 0x48, 0x48, 0x48, 0x48		 //tile:24 
, 0x48, 0x48, 0x48, 0x48, 0x48, 0x48, 0x48, 0x48, 0x48, 0x48, 0x48, 0x48, 0x48, 0x48, 0x48, 0x48, 0x48, 0x48, 0x48, 0x48, 0x48, 0x48, 0x48, 0x48, 0x48, 0x9b, 0x9b, 0x9b, 0x48, 0x48, 0x48, 0x48, 0x9b, 0x48, 0x48, 0x48, 0x9b, 0x48, 0x48, 0x48, 0x48, 0x9b, 0x9b, 0x9b, 0x9b, 0x48, 0x48, 0x48, 0x48, 0x48, 0x48, 0x48, 0x9b, 0x48, 0x48, 0x48, 0x48, 0x9b, 0x9b, 0x9b, 0x48, 0x48, 0x48, 0x48		 //tile:25 
, 0x48, 0x48, 0x48, 0x48, 0x48, 0x48, 0x48, 0x48, 0x48, 0x48, 0x48, 0x48, 0x48, 0x48, 0x48, 0x48, 0x48, 0x48, 0x48, 0x48, 0x48, 0x48, 0x48, 0x48, 0x48, 0x48, 0x48, 0x48, 0x48, 0x48, 0x48, 0x48, 0x48, 0x48, 0x48, 0x9b, 0x48, 0x48, 0x48, 0x48, 0x48, 0x48, 0x48, 0x48, 0x48, 0x48, 0x48, 0x48, 0x48, 0x48, 0x48, 0x9b, 0x48, 0x48, 0x48, 0x48, 0x48, 0x48, 0x48, 0x48, 0x48, 0x48, 0x48, 0x48		 //tile:26 
, 0x48, 0x48, 0x48, 0x48, 0x48, 0x48, 0x48, 0x48, 0x48, 0x48, 0x48, 0x48, 0x48, 0x48, 0x48, 0x48, 0x48, 0x48, 0x48, 0x48, 0x48, 0x48, 0x48, 0x48, 0x48, 0x48, 0x48, 0x48, 0x48, 0x48, 0x48, 0x48, 0x48, 0x48, 0x48, 0x9b, 0x48, 0x48, 0x48, 0x48, 0x48, 0x48, 0x48, 0x48, 0x48, 0x48, 0x48, 0x48, 0x48, 0x48, 0x48, 0x9b, 0x48, 0x48, 0x48, 0x48, 0x48, 0x48, 0x9b, 0x48, 0x48, 0x48, 0x48, 0x48		 //tile:27 
, 0x48, 0x48, 0x48, 0x48, 0x48, 0x48, 0x48, 0x48, 0x48, 0x48, 0x48, 0x48, 0x48, 0x48, 0x48, 0x48, 0x48, 0x48, 0x48, 0x48, 0x48, 0x48, 0x48, 0x48, 0x48, 0x48, 0x48, 0x9b, 0x48, 0x48, 0x48, 0x48, 0x48, 0x48, 0x9b, 0x48, 0x48, 0x48, 0x48, 0x48, 0x48, 0x9b, 0x48, 0x48, 0x48, 0x48, 0x48, 0x48, 0x48, 0x48, 0x9b, 0x48, 0x48, 0x48, 0x48, 0x48, 0x48, 0x48, 0x48, 0x9b, 0x48, 0x48, 0x48, 0x48		 //tile:28 
, 0x48, 0x48, 0x48, 0x48, 0x48, 0x48, 0x48, 0x48, 0x48, 0x48, 0x48, 0x48, 0x48, 0x48, 0x48, 0x48, 0x48, 0x48, 0x48, 0x48, 0x48, 0x48, 0x48, 0x48, 0x48, 0x48, 0x48, 0x48, 0x48, 0x48, 0x48, 0x48, 0x48, 0x9b, 0x9b, 0x9b, 0x9b, 0x48, 0x48, 0x48, 0x48, 0x48, 0x48, 0x48, 0x48, 0x48, 0x48, 0x48, 0x48, 0x9b, 0x9b, 0x9b, 0x9b, 0x48, 0x48, 0x48, 0x48, 0x48, 0x48, 0x48, 0x48, 0x48, 0x48, 0x48		 //tile:29 
, 0x48, 0x48, 0x48, 0x48, 0x48, 0x48, 0x48, 0x48, 0x48, 0x48, 0x48, 0x48, 0x48, 0x48, 0x48, 0x48, 0x48, 0x48, 0x48, 0x48, 0x48, 0x48, 0x48, 0x48, 0x48, 0x9b, 0x48, 0x48, 0x48, 0x48, 0x48, 0x48, 0x48, 0x48, 0x9b, 0x48, 0x48, 0x48, 0x48, 0x48, 0x48, 0x48, 0x48, 0x9b, 0x48, 0x48, 0x48, 0x48, 0x48, 0x48, 0x9b, 0x48, 0x48, 0x48, 0x48, 0x48, 0x48, 0x9b, 0x48, 0x48, 0x48, 0x48, 0x48, 0x48		 //tile:30 
, 0x48, 0x48, 0x48, 0x48, 0x48, 0x48, 0x48, 0x48, 0x48, 0x48, 0x48, 0x48, 0x48, 0x48, 0x48, 0x48, 0x48, 0x48, 0x48, 0x48, 0x48, 0x48, 0x48, 0x48, 0x48, 0x9b, 0x9b, 0x9b, 0x48, 0x48, 0x48, 0x48, 0x48, 0x48, 0x48, 0x48, 0x9b, 0x48, 0x48, 0x48, 0x48, 0x48, 0x9b, 0x9b, 0x48, 0x48, 0x48, 0x48, 0x48, 0x48, 0x48, 0x48, 0x48, 0x48, 0x48, 0x48, 0x48, 0x48, 0x9b, 0x48, 0x48, 0x48, 0x48, 0x48		 //tile:31 
, 0x48, 0x48, 0x48, 0x48, 0x48, 0x48, 0x48, 0x48, 0x48, 0x48, 0x48, 0x48, 0x48, 0x48, 0x48, 0x48, 0x48, 0x48, 0x48, 0x48, 0x48, 0x48, 0x48, 0x48, 0x48, 0x9b, 0x9b, 0x9b, 0x48, 0x48, 0x48, 0x48, 0x9b, 0x48, 0x48, 0x48, 0x9b, 0x48, 0x48, 0x48, 0x9b, 0x48, 0x9b, 0x9b, 0x9b, 0x48, 0x48, 0x48, 0x9b, 0x48, 0x9b, 0x48, 0x9b, 0x48, 0x48, 0x48, 0x48, 0x48, 0x9b, 0x9b, 0x48, 0x48, 0x48, 0x48		 //tile:32 
, 0x48, 0x48, 0x48, 0x48, 0x48, 0x48, 0x48, 0x48, 0x48, 0x48, 0x48, 0x48, 0x48, 0x48, 0x48, 0x48, 0x48, 0x48, 0x48, 0x48, 0x48, 0x48, 0x48, 0x48, 0x48, 0x9b, 0x9b, 0x9b, 0x48, 0x48, 0x48, 0x48, 0x9b, 0x48, 0x48, 0x48, 0x9b, 0x48, 0x48, 0x48, 0x9b, 0x9b, 0x9b, 0x9b, 0x9b, 0x48, 0x48, 0x48, 0x9b, 0x48, 0x48, 0x48, 0x9b, 0x48, 0x48, 0x48, 0x9b, 0x48, 0x48, 0x48, 0x9b, 0x48, 0x48, 0x48		 //tile:33 
, 0x48, 0x48, 0x48, 0x48, 0x48, 0x48, 0x48, 0x48, 0x48, 0x48, 0x48, 0x48, 0x48, 0x48, 0x48, 0x48, 0x48, 0x48, 0x48, 0x48, 0x48, 0x48, 0x48, 0x48, 0x9b, 0x9b, 0x9b, 0x9b, 0x48, 0x48, 0x48, 0x48, 0x9b, 0x48, 0x48, 0x48, 0x9b, 0x48, 0x48, 0x48, 0x9b, 0x9b, 0x9b, 0x9b, 0x48, 0x48, 0x48, 0x48, 0x9b, 0x48, 0x48, 0x48, 0x9b, 0x48, 0x48, 0x48, 0x9b, 0x9b, 0x9b, 0x9b, 0x48, 0x48, 0x48, 0x48		 //tile:34 
, 0x48, 0x48, 0x48, 0x48, 0x48, 0x48, 0x48, 0x48, 0x48, 0x48, 0x48, 0x48, 0x48, 0x48, 0x48, 0x48, 0x48, 0x48, 0x48, 0x48, 0x48, 0x48, 0x48, 0x48, 0x48, 0x9b, 0x9b, 0x9b, 0x9b, 0x48, 0x48, 0x48, 0x9b, 0x48, 0x48, 0x48, 0x48, 0x48, 0x48, 0x48, 0x9b, 0x48, 0x48, 0x48, 0x48, 0x48, 0x48, 0x48, 0x9b, 0x48, 0x48, 0x48, 0x48, 0x48, 0x48, 0x48, 0x48, 0x9b, 0x9b, 0x9b, 0x9b, 0x48, 0x48, 0x48		 //tile:35 
, 0x48, 0x48, 0x48, 0x48, 0x48, 0x48, 0x48, 0x48, 0x48, 0x48, 0x48, 0x48, 0x48, 0x48, 0x48, 0x48, 0x48, 0x48, 0x48, 0x48, 0x48, 0x48, 0x48, 0x48, 0x9b, 0x9b, 0x9b, 0x9b, 0x48, 0x48, 0x48, 0x48, 0x9b, 0x48, 0x48, 0x48, 0x9b, 0x48, 0x48, 0x48, 0x9b, 0x48, 0x48, 0x48, 0x9b, 0x48, 0x48, 0x48, 0x9b, 0x48, 0x48, 0x48, 0x9b, 0x48, 0x48, 0x48, 0x9b, 0x9b, 0x9b, 0x9b, 0x48, 0x48, 0x48, 0x48		 //tile:36 
, 0x48, 0x48, 0x48, 0x48, 0x48, 0x48, 0x48, 0x48, 0x48, 0x48, 0x48, 0x48, 0x48, 0x48, 0x48, 0x48, 0x48, 0x48, 0x48, 0x48, 0x48, 0x48, 0x48, 0x48, 0x9b, 0x9b, 0x9b, 0x9b, 0x9b, 0x48, 0x48, 0x48, 0x9b, 0x48, 0x48, 0x48, 0x48, 0x48, 0x48, 0x48, 0x9b, 0x9b, 0x9b, 0x9b, 0x48, 0x48, 0x48, 0x48, 0x9b, 0x48, 0x48, 0x48, 0x48, 0x48, 0x48, 0x48, 0x9b, 0x9b, 0x9b, 0x9b, 0x9b, 0x48, 0x48, 0x48		 //tile:37 
, 0x48, 0x48, 0x48, 0x48, 0x48, 0x48, 0x48, 0x48, 0x48, 0x48, 0x48, 0x48, 0x48, 0x48, 0x48, 0x48, 0x48, 0x48, 0x48, 0x48, 0x48, 0x48, 0x48, 0x48, 0x9b, 0x9b, 0x9b, 0x9b, 0x9b, 0x48, 0x48, 0x48, 0x9b, 0x48, 0x48, 0x48, 0x48, 0x48, 0x48, 0x48, 0x9b, 0x9b, 0x9b, 0x9b, 0x48, 0x48, 0x48, 0x48, 0x9b, 0x48, 0x48, 0x48, 0x48, 0x48, 0x48, 0x48, 0x9b, 0x48, 0x48, 0x48, 0x48, 0x48, 0x48, 0x48		 //tile:38 
, 0x48, 0x48, 0x48, 0x48, 0x48, 0x48, 0x48, 0x48, 0x48, 0x48, 0x48, 0x48, 0x48, 0x48, 0x48, 0x48, 0x48, 0x48, 0x48, 0x48, 0x48, 0x48, 0x48, 0x48, 0x48, 0x9b, 0x9b, 0x9b, 0x9b, 0x48, 0x48, 0x48, 0x9b, 0x48, 0x48, 0x48, 0x48, 0x48, 0x48, 0x48, 0x9b, 0x48, 0x9b, 0x9b, 0x9b, 0x48, 0x48, 0x48, 0x9b, 0x48, 0x48, 0x48, 0x9b, 0x48, 0x48, 0x48, 0x48, 0x9b, 0x9b, 0x9b, 0x48, 0x48, 0x48, 0x48		 //tile:39 
, 0x48, 0x48, 0x48, 0x48, 0x48, 0x48, 0x48, 0x48, 0x48, 0x48, 0x48, 0x48, 0x48, 0x48, 0x48, 0x48, 0x48, 0x48, 0x48, 0x48, 0x48, 0x48, 0x48, 0x48, 0x9b, 0x48, 0x48, 0x48, 0x9b, 0x48, 0x48, 0x48, 0x9b, 0x48, 0x48, 0x48, 0x9b, 0x48, 0x48, 0x48, 0x9b, 0x9b, 0x9b, 0x9b, 0x9b, 0x48, 0x48, 0x48, 0x9b, 0x48, 0x48, 0x48, 0x9b, 0x48, 0x48, 0x48, 0x9b, 0x48, 0x48, 0x48, 0x9b, 0x48, 0x48, 0x48		 //tile:40 
, 0x48, 0x48, 0x48, 0x48, 0x48, 0x48, 0x48, 0x48, 0x48, 0x48, 0x48, 0x48, 0x48, 0x48, 0x48, 0x48, 0x48, 0x48, 0x48, 0x48, 0x48, 0x48, 0x48, 0x48, 0x48, 0x9b, 0x9b, 0x9b, 0x48, 0x48, 0x48, 0x48, 0x48, 0x48, 0x9b, 0x48, 0x48, 0x48, 0x48, 0x48, 0x48, 0x48, 0x9b, 0x48, 0x48, 0x48, 0x48, 0x48, 0x48, 0x48, 0x9b, 0x48, 0x48, 0x48, 0x48, 0x48, 0x48, 0x9b, 0x9b, 0x9b, 0x48, 0x48, 0x48, 0x48		 //tile:41 
, 0x48, 0x48, 0x48, 0x48, 0x48, 0x48, 0x48, 0x48, 0x48, 0x48, 0x48, 0x48, 0x48, 0x48, 0x48, 0x48, 0x48, 0x48, 0x48, 0x48, 0x48, 0x48, 0x48, 0x48, 0x48, 0x48, 0x9b, 0x9b, 0x9b, 0x48, 0x48, 0x48, 0x48, 0x48, 0x48, 0x9b, 0x48, 0x48, 0x48, 0x48, 0x48, 0x48, 0x48, 0x9b, 0x48, 0x48, 0x48, 0x48, 0x9b, 0x48, 0x48, 0x9b, 0x48, 0x48, 0x48, 0x48, 0x48, 0x9b, 0x9b, 0x48, 0x48, 0x48, 0x48, 0x48		 //tile:42 
, 0x48, 0x48, 0x48, 0x48, 0x48, 0x48, 0x48, 0x48, 0x48, 0x48, 0x48, 0x48, 0x48, 0x48, 0x48, 0x48, 0x48, 0x48, 0x48, 0x48, 0x48, 0x48, 0x48, 0x48, 0x9b, 0x48, 0x48, 0x48, 0x9b, 0x48, 0x48, 0x48, 0x9b, 0x9b, 0x48, 0x9b, 0x48, 0x48, 0x48, 0x48, 0x9b, 0x48, 0x9b, 0x48, 0x48, 0x48, 0x48, 0x48, 0x9b, 0x48, 0x48, 0x9b, 0x48, 0x48, 0x48, 0x48, 0x9b, 0x48, 0x48, 0x48, 0x9b, 0x48, 0x48, 0x48		 //tile:43 
, 0x48, 0x48, 0x48, 0x48, 0x48, 0x48, 0x48, 0x48, 0x48, 0x48, 0x48, 0x48, 0x48, 0x48, 0x48, 0x48, 0x48, 0x48, 0x48, 0x48, 0x48, 0x48, 0x48, 0x48, 0x9b, 0x48, 0x48, 0x48, 0x48, 0x48, 0x48, 0x48, 0x9b, 0x48, 0x48, 0x48, 0x48, 0x48, 0x48, 0x48, 0x9b, 0x48, 0x48, 0x48, 0x48, 0x48, 0x48, 0x48, 0x9b, 0x48, 0x48, 0x48, 0x48, 0x48, 0x48, 0x48, 0x9b, 0x9b, 0x9b, 0x9b, 0x9b, 0x48, 0x48, 0x48		 //tile:44 
, 0x48, 0x48, 0x48, 0x48, 0x48, 0x48, 0x48, 0x48, 0x48, 0x48, 0x48, 0x48, 0x48, 0x48, 0x48, 0x48, 0x48, 0x48, 0x48, 0x48, 0x48, 0x48, 0x48, 0x48, 0x9b, 0x48, 0x48, 0x48, 0x9b, 0x48, 0x48, 0x48, 0x9b, 0x9b, 0x48, 0x9b, 0x9b, 0x48, 0x48, 0x48, 0x9b, 0x48, 0x9b, 0x48, 0x9b, 0x48, 0x48, 0x48, 0x9b, 0x48, 0x48, 0x48, 0x9b, 0x48, 0x48, 0x48, 0x9b, 0x48, 0x48, 0x48, 0x9b, 0x48, 0x48, 0x48		 //tile:45 
, 0x48, 0x48, 0x48, 0x48, 0x48, 0x48, 0x48, 0x48, 0x48, 0x48, 0x48, 0x48, 0x48, 0x48, 0x48, 0x48, 0x48, 0x48, 0x48, 0x48, 0x48, 0x48, 0x48, 0x48, 0x9b, 0x48, 0x48, 0x48, 0x9b, 0x48, 0x48, 0x48, 0x9b, 0x9b, 0x48, 0x48, 0x9b, 0x48, 0x48, 0x48, 0x9b, 0x48, 0x9b, 0x48, 0x9b, 0x48, 0x48, 0x48, 0x9b, 0x48, 0x48, 0x9b, 0x9b, 0x48, 0x48, 0x48, 0x9b, 0x48, 0x48, 0x48, 0x9b, 0x48, 0x48, 0x48		 //tile:46 
, 0x48, 0x48, 0x48, 0x48, 0x48, 0x48, 0x48, 0x48, 0x48, 0x48, 0x48, 0x48, 0x48, 0x48, 0x48, 0x48, 0x48, 0x48, 0x48, 0x48, 0x48, 0x48, 0x48, 0x48, 0x48, 0x9b, 0x9b, 0x9b, 0x48, 0x48, 0x48, 0x48, 0x9b, 0x48, 0x48, 0x48, 0x9b, 0x48, 0x48, 0x48, 0x9b, 0x48, 0x48, 0x48, 0x9b, 0x48, 0x48, 0x48, 0x9b, 0x48, 0x48, 0x48, 0x9b, 0x48, 0x48, 0x48, 0x48, 0x9b, 0x9b, 0x9b, 0x48, 0x48, 0x48, 0x48		 //tile:47 
, 0x48, 0x48, 0x48, 0x48, 0x48, 0x48, 0x48, 0x48, 0x48, 0x48, 0x48, 0x48, 0x48, 0x48, 0x48, 0x48, 0x48, 0x48, 0x48, 0x48, 0x48, 0x48, 0x48, 0x48, 0x9b, 0x9b, 0x9b, 0x9b, 0x48, 0x48, 0x48, 0x48, 0x9b, 0x48, 0x48, 0x48, 0x9b, 0x48, 0x48, 0x48, 0x9b, 0x9b, 0x9b, 0x9b, 0x48, 0x48, 0x48, 0x48, 0x9b, 0x48, 0x48, 0x48, 0x48, 0x48, 0x48, 0x48, 0x9b, 0x48, 0x48, 0x48, 0x48, 0x48, 0x48, 0x48		 //tile:48 
, 0x48, 0x48, 0x48, 0x48, 0x48, 0x48, 0x48, 0x48, 0x48, 0x48, 0x48, 0x48, 0x48, 0x48, 0x48, 0x48, 0x48, 0x48, 0x48, 0x48, 0x48, 0x48, 0x48, 0x48, 0x48, 0x9b, 0x9b, 0x9b, 0x48, 0x48, 0x48, 0x48, 0x9b, 0x48, 0x48, 0x48, 0x9b, 0x48, 0x48, 0x48, 0x9b, 0x48, 0x9b, 0x48, 0x9b, 0x48, 0x48, 0x48, 0x9b, 0x48, 0x48, 0x9b, 0x48, 0x48, 0x48, 0x48, 0x48, 0x9b, 0x9b, 0x48, 0x9b, 0x48, 0x48, 0x48		 //tile:49 
, 0x48, 0x48, 0x48, 0x48, 0x48, 0x48, 0x48, 0x48, 0x48, 0x48, 0x48, 0x48, 0x48, 0x48, 0x48, 0x48, 0x48, 0x48, 0x48, 0x48, 0x48, 0x48, 0x48, 0x48, 0x9b, 0x9b, 0x9b, 0x9b, 0x48, 0x48, 0x48, 0x48, 0x9b, 0x48, 0x48, 0x48, 0x9b, 0x48, 0x48, 0x48, 0x9b, 0x9b, 0x9b, 0x9b, 0x9b, 0x48, 0x48, 0x48, 0x9b, 0x48, 0x48, 0x9b, 0x48, 0x48, 0x48, 0x48, 0x9b, 0x48, 0x48, 0x48, 0x9b, 0x48, 0x48, 0x48		 //tile:50 
, 0x48, 0x48, 0x48, 0x48, 0x48, 0x48, 0x48, 0x48, 0x48, 0x48, 0x48, 0x48, 0x48, 0x48, 0x48, 0x48, 0x48, 0x48, 0x48, 0x48, 0x48, 0x48, 0x48, 0x48, 0x48, 0x9b, 0x9b, 0x9b, 0x9b, 0x48, 0x48, 0x48, 0x9b, 0x48, 0x48, 0x48, 0x48, 0x48, 0x48, 0x48, 0x9b, 0x9b, 0x9b, 0x9b, 0x9b, 0x48, 0x48, 0x48, 0x48, 0x48, 0x48, 0x48, 0x9b, 0x48, 0x48, 0x48, 0x9b, 0x9b, 0x9b, 0x9b, 0x48, 0x48, 0x48, 0x48		 //tile:51 
, 0x48, 0x48, 0x48, 0x48, 0x48, 0x48, 0x48, 0x48, 0x48, 0x48, 0x48, 0x48, 0x48, 0x48, 0x48, 0x48, 0x48, 0x48, 0x48, 0x48, 0x48, 0x48, 0x48, 0x48, 0x9b, 0x9b, 0x9b, 0x9b, 0x9b, 0x48, 0x48, 0x48, 0x48, 0x48, 0x9b, 0x48, 0x48, 0x48, 0x48, 0x48, 0x48, 0x48, 0x9b, 0x48, 0x48, 0x48, 0x48, 0x48, 0x48, 0x48, 0x9b, 0x48, 0x48, 0x48, 0x48, 0x48, 0x48, 0x48, 0x9b, 0x48, 0x48, 0x48, 0x48, 0x48		 //tile:52 
, 0x48, 0x48, 0x48, 0x48, 0x48, 0x48, 0x48, 0x48, 0x48, 0x48, 0x48, 0x48, 0x48, 0x48, 0x48, 0x48, 0x48, 0x48, 0x48, 0x48, 0x48, 0x48, 0x48, 0x48, 0x9b, 0x48, 0x48, 0x48, 0x9b, 0x48, 0x48, 0x48, 0x9b, 0x48, 0x48, 0x48, 0x9b, 0x48, 0x48, 0x48, 0x9b, 0x48, 0x48, 0x48, 0x9b, 0x48, 0x48, 0x48, 0x9b, 0x48, 0x48, 0x48, 0x9b, 0x48, 0x48, 0x48, 0x48, 0x9b, 0x9b, 0x9b, 0x48, 0x48, 0x48, 0x48		 //tile:53 
, 0x48, 0x48, 0x48, 0x48, 0x48, 0x48, 0x48, 0x48, 0x48, 0x48, 0x48, 0x48, 0x48, 0x48, 0x48, 0x48, 0x48, 0x48, 0x48, 0x48, 0x48, 0x48, 0x48, 0x48, 0x9b, 0x48, 0x48, 0x48, 0x9b, 0x48, 0x48, 0x48, 0x9b, 0x48, 0x48, 0x48, 0x9b, 0x48, 0x48, 0x48, 0x48, 0x9b, 0x48, 0x9b, 0x48, 0x48, 0x48, 0x48, 0x48, 0x9b, 0x48, 0x9b, 0x48, 0x48, 0x48, 0x48, 0x48, 0x48, 0x9b, 0x48, 0x48, 0x48, 0x48, 0x48		 //tile:54 
, 0x48, 0x48, 0x48, 0x48, 0x48, 0x48, 0x48, 0x48, 0x48, 0x48, 0x48, 0x48, 0x48, 0x48, 0x48, 0x48, 0x48, 0x48, 0x48, 0x48, 0x48, 0x48, 0x48, 0x48, 0x9b, 0x48, 0x48, 0x48, 0x9b, 0x48, 0x48, 0x48, 0x9b, 0x48, 0x9b, 0x48, 0x9b, 0x48, 0x48, 0x48, 0x9b, 0x48, 0x9b, 0x48, 0x9b, 0x48, 0x48, 0x48, 0x48, 0x9b, 0x48, 0x9b, 0x48, 0x48, 0x48, 0x48, 0x48, 0x9b, 0x48, 0x9b, 0x48, 0x48, 0x48, 0x48		 //tile:55 
, 0x48, 0x48, 0x48, 0x48, 0x48, 0x48, 0x48, 0x48, 0x48, 0x48, 0x48, 0x48, 0x48, 0x48, 0x48, 0x48, 0x48, 0x48, 0x48, 0x48, 0x48, 0x48, 0x48, 0x48, 0x9b, 0x48, 0x48, 0x48, 0x9b, 0x48, 0x48, 0x48, 0x48, 0x9b, 0x48, 0x9b, 0x48, 0x48, 0x48, 0x48, 0x48, 0x48, 0x9b, 0x48, 0x48, 0x48, 0x48, 0x48, 0x48, 0x9b, 0x48, 0x9b, 0x48, 0x48, 0x48, 0x48, 0x9b, 0x48, 0x48, 0x48, 0x9b, 0x48, 0x48, 0x48		 //tile:56 
, 0x48, 0x48, 0x48, 0x48, 0x48, 0x48, 0x48, 0x48, 0x48, 0x48, 0x48, 0x48, 0x48, 0x48, 0x48, 0x48, 0x48, 0x48, 0x48, 0x48, 0x48, 0x48, 0x48, 0x48, 0x9b, 0x48, 0x48, 0x48, 0x9b, 0x48, 0x48, 0x48, 0x9b, 0x48, 0x48, 0x48, 0x9b, 0x48, 0x48, 0x48, 0x48, 0x9b, 0x9b, 0x9b, 0x48, 0x48, 0x48, 0x48, 0x48, 0x48, 0x9b, 0x48, 0x48, 0x48, 0x48, 0x48, 0x48, 0x48, 0x9b, 0x48, 0x48, 0x48, 0x48, 0x48		 //tile:57 
, 0x48, 0x48, 0x48, 0x48, 0x48, 0x48, 0x48, 0x48, 0x48, 0x48, 0x48, 0x48, 0x48, 0x48, 0x48, 0x48, 0x48, 0x48, 0x48, 0x48, 0x48, 0x48, 0x48, 0x48, 0x9b, 0x9b, 0x9b, 0x9b, 0x9b, 0x48, 0x48, 0x48, 0x48, 0x48, 0x48, 0x9b, 0x48, 0x48, 0x48, 0x48, 0x48, 0x48, 0x9b, 0x48, 0x48, 0x48, 0x48, 0x48, 0x48, 0x9b, 0x48, 0x48, 0x48, 0x48, 0x48, 0x48, 0x9b, 0x9b, 0x9b, 0x9b, 0x9b, 0x48, 0x48, 0x48		 //tile:58 
, 0x48, 0x48, 0x48, 0x48, 0x48, 0x48, 0x48, 0x48, 0x48, 0x48, 0x48, 0x48, 0x48, 0x48, 0x48, 0x48, 0x48, 0x48, 0x48, 0x48, 0x48, 0x48, 0x48, 0x48, 0x48, 0x9b, 0x9b, 0x9b, 0x48, 0x48, 0x48, 0x48, 0x48, 0x9b, 0x48, 0x48, 0x48, 0x48, 0x48, 0x48, 0x48, 0x9b, 0x48, 0x48, 0x48, 0x48, 0x48, 0x48, 0x48, 0x9b, 0x48, 0x48, 0x48, 0x48, 0x48, 0x48, 0x48, 0x9b, 0x9b, 0x9b, 0x48, 0x48, 0x48, 0x48		 //tile:59 
, 0x48, 0x48, 0x48, 0x48, 0x48, 0x48, 0x48, 0x48, 0x48, 0x48, 0x48, 0x48, 0x48, 0x48, 0x48, 0x48, 0x48, 0x48, 0x48, 0x48, 0x48, 0x48, 0x48, 0x48, 0x48, 0x9b, 0x48, 0x9b, 0x48, 0x48, 0x48, 0x48, 0x9b, 0x9b, 0x9b, 0x9b, 0x9b, 0x48, 0x48, 0x48, 0x9b, 0x9b, 0x9b, 0x9b, 0x9b, 0x48, 0x48, 0x48, 0x48, 0x48, 0x9b, 0x48, 0x48, 0x48, 0x48, 0x48, 0x48, 0x48, 0x9b, 0x48, 0x48, 0x48, 0x48, 0x48		 //tile:60 
, 0x48, 0x48, 0x48, 0x48, 0x48, 0x48, 0x48, 0x48, 0x48, 0x48, 0x48, 0x48, 0x48, 0x48, 0x48, 0x48, 0x48, 0x48, 0x48, 0x48, 0x48, 0x48, 0x48, 0x48, 0x48, 0x9b, 0x9b, 0x9b, 0x48, 0x48, 0x48, 0x48, 0x48, 0x48, 0x48, 0x9b, 0x48, 0x48, 0x48, 0x48, 0x48, 0x48, 0x48, 0x9b, 0x48, 0x48, 0x48, 0x48, 0x48, 0x48, 0x48, 0x9b, 0x48, 0x48, 0x48, 0x48, 0x48, 0x9b, 0x9b, 0x9b, 0x48, 0x48, 0x48, 0x48		 //tile:61 
, 0x48, 0x48, 0x48, 0x48, 0x48, 0x48, 0x48, 0x48, 0x48, 0x48, 0x48, 0x48, 0x48, 0x48, 0x48, 0x48, 0x48, 0x48, 0x48, 0x48, 0x48, 0x48, 0x48, 0x48, 0x48, 0x48, 0x9b, 0x48, 0x48, 0x48, 0x48, 0x48, 0x48, 0x9b, 0x48, 0x9b, 0x48, 0x48, 0x48, 0x48, 0x9b, 0x48, 0x48, 0x48, 0x9b, 0x48, 0x48, 0x48, 0x48, 0x48, 0x48, 0x48, 0x48, 0x48, 0x48, 0x48, 0x48, 0x48, 0x48, 0x48, 0x48, 0x48, 0x48, 0x48		 //tile:62 
, 0x48, 0x48, 0x48, 0x48, 0x48, 0x48, 0x48, 0x48, 0x48, 0x48, 0x48, 0x48, 0x48, 0x48, 0x48, 0x48, 0x48, 0x48, 0x48, 0x48, 0x48, 0x48, 0x48, 0x48, 0x48, 0x48, 0x48, 0x48, 0x48, 0x48, 0x48, 0x48, 0x48, 0x48, 0x48, 0x48, 0x48, 0x48, 0x48, 0x48, 0x48, 0x48, 0x48, 0x48, 0x48, 0x48, 0x48, 0x48, 0x48, 0x48, 0x48, 0x48, 0x48, 0x48, 0x48, 0x48, 0x9b, 0x9b, 0x9b, 0x9b, 0x9b, 0x48, 0x48, 0x48		 //tile:63 
};

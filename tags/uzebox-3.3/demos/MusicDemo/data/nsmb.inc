//*********************************//
// MIDI file: F:\work\uzebox\sources\rev4-beta\demos\MusicDemo\data\NSMB.mid
//*********************************//
const char song_nsmb[] PROGMEM ={
0x00,0xc0,0x03,0x00,0xb0,0x07,0x7f,0x00,0x90,0x4c,0x7f,0x00,0xb1,0x07,0x7f,0x00,0x91,0x3c,0x52,0x00,0xb2,0x07,0x7f,0x00,0x92,0x30,0x6c,0x00,0xc2,0x03,0x00,0xc1,
0x03,0x08,0x92,0x30,0x00,0x00,0x91,0x3c,0x00,0x00,0x90,0x4c,0x00,0x11,0x4c,0x7f,0x00,0x91,0x3c,0x52,0x00,0x92,0x30,0x6c,0x09,0x30,0x00,0x00,0x91,0x3c,0x00,0x00,
0x90,0x4c,0x00,0x00,0x48,0x7f,0x00,0x91,0x37,0x52,0x08,0x37,0x00,0x00,0x90,0x48,0x00,0x00,0x48,0x7f,0x00,0x91,0x37,0x52,0x00,0x92,0x30,0x6c,0x09,0x30,0x00,0x00,
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0x3c,0x00,0x00,0x90,0x40,0x00,0x00,0xff,0x2f,0x00 };

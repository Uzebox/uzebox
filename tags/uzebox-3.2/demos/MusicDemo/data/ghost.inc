//*********************************//
// MIDI file: F:\work\uzebox\sources\rev4-beta\demos\MusicDemo\data\ghost.mid
//*********************************//
const char song_ghost[] PROGMEM ={
0x00,0xff,0x06,0x01,0x53,0x00,0xc0,0x00,0x00,0xb0,0x07,0x50,0x00,0xc1,0x00,0x00,0xb1,0x07,0x50,0x00,0xc2,0x00,0x00,0x92,0x2c,0x7f,0x00,0xc3,0x07,0x08,0x92,0x2c,
0x00,0x00,0x2f,0x7f,0x09,0x2f,0x00,0x00,0x90,0x44,0x7f,0x00,0x91,0x3f,0x7f,0x00,0x92,0x33,0x7f,0x09,0x33,0x00,0x00,0x27,0x7f,0x09,0x27,0x00,0x00,0x2c,0x7f,0x09,
0x2c,0x00,0x00,0x33,0x7f,0x09,0x33,0x00,0x00,0x91,0x3f,0x00,0x00,0x90,0x44,0x00,0x00,0x43,0x7f,0x00,0x91,0x3f,0x7f,0x00,0x92,0x33,0x7f,0x11,0x33,0x00,0x00,0x91,
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0x92,0x2b,0x00,0x00,0x91,0x30,0x00,0x00,0x90,0x37,0x00,0x00,0xff,0x2f,0x00 };

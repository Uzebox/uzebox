//picture: sprites.raw
//Horizontal Tiles=6
//Vertical Tiles=2
//Tile Width=8
//Tile Height=8
#define SPRITES_TILESET_SIZE 8

const char sprites_tileset[] PROGMEM ={
 0xff, 0xff, 0xff, 0xff, 0xff, 0xff, 0xff, 0xff, 0xff, 0xad, 0xad, 0xad, 0xad, 0xad, 0xad, 0xad, 0xff, 0xad, 0xad, 0xff, 0x5b, 0xad, 0xad, 0xff, 0xff, 0xad, 0xad, 0xff, 0x5b, 0xad, 0xad, 0xff, 0xff, 0xad, 0xad, 0xff, 0x5b, 0xad, 0xad, 0xff, 0xff, 0xad, 0xad, 0xad, 0xad, 0xad, 0xad, 0xad, 0xff, 0x5b, 0x52, 0x52, 0x52, 0x52, 0x52, 0x52, 0x52, 0x00, 0x00, 0x00, 0x00, 0x00, 0x00, 0x00		 //tile:0 
, 0xff, 0xff, 0xff, 0xff, 0xff, 0xff, 0xff, 0x52, 0xad, 0xad, 0xad, 0xad, 0xad, 0xad, 0x5b, 0x00, 0x5b, 0xad, 0xad, 0xff, 0x5b, 0xad, 0x52, 0x00, 0x5b, 0xad, 0xad, 0xff, 0x5b, 0xad, 0x52, 0x00, 0x5b, 0xad, 0xad, 0xff, 0x5b, 0xad, 0x52, 0x00, 0xad, 0xad, 0xad, 0xad, 0xad, 0xad, 0x52, 0x00, 0x52, 0x52, 0x52, 0x52, 0x52, 0x52, 0x52, 0x00, 0x00, 0x00, 0x00, 0x00, 0x00, 0x00, 0x00, 0x00		 //tile:1 
, 0xfe, 0xff, 0xff, 0xff, 0xff, 0xff, 0x00, 0xfe, 0xfe, 0xff, 0xad, 0xad, 0xad, 0xad, 0x00, 0xfe, 0xfe, 0xff, 0xad, 0xff, 0xff, 0xad, 0x00, 0xfe, 0xfe, 0xff, 0xad, 0x52, 0x52, 0xad, 0x00, 0xfe, 0xfe, 0xff, 0xad, 0xad, 0xad, 0xad, 0x00, 0xfe, 0xfe, 0xff, 0xad, 0xff, 0xff, 0xad, 0x00, 0xfe, 0xfe, 0xff, 0xad, 0x52, 0x52, 0xad, 0x00, 0xfe, 0xfe, 0xff, 0x00, 0x00, 0x00, 0x00, 0x00, 0xfe		 //tile:2 
, 0x00, 0x00, 0xfe, 0xfe, 0xfe, 0xfe, 0xfe, 0xfe, 0x00, 0xff, 0x00, 0xfe, 0xfe, 0xfe, 0xfe, 0xfe, 0x00, 0xff, 0xff, 0x00, 0xfe, 0xfe, 0xfe, 0xfe, 0x00, 0xff, 0xff, 0xff, 0x00, 0xfe, 0xfe, 0xfe, 0x00, 0xff, 0xff, 0xff, 0xff, 0x00, 0xfe, 0xfe, 0x00, 0xff, 0xff, 0xff, 0xff, 0xff, 0x00, 0xfe, 0x00, 0xff, 0xff, 0xff, 0xff, 0xff, 0xff, 0x00, 0x00, 0xff, 0xff, 0xff, 0xff, 0x00, 0x00, 0xfe		 //tile:3 
, 0x00, 0xfe, 0xfe, 0xfe, 0xfe, 0xfe, 0xfe, 0xfe, 0x00, 0x00, 0xfe, 0xfe, 0xfe, 0xfe, 0xfe, 0xfe, 0x00, 0xff, 0x00, 0xfe, 0xfe, 0xfe, 0xfe, 0xfe, 0x00, 0xff, 0xff, 0x00, 0xfe, 0xfe, 0xfe, 0xfe, 0x00, 0xff, 0xff, 0xff, 0x00, 0xfe, 0xfe, 0xfe, 0x00, 0xff, 0xff, 0xff, 0xff, 0x00, 0xfe, 0xfe, 0x00, 0xff, 0xff, 0xff, 0xff, 0xff, 0x00, 0xfe, 0x00, 0xff, 0xff, 0xff, 0xff, 0xff, 0xff, 0x00		 //tile:4 
, 0xfe, 0xfe, 0xfe, 0xfe, 0xfe, 0xfe, 0xfe, 0xfe, 0xfe, 0xfe, 0xfe, 0xfe, 0xfe, 0xfe, 0xfe, 0xfe, 0xfe, 0xfe, 0xfe, 0xfe, 0xfe, 0xfe, 0xfe, 0xfe, 0xfe, 0xfe, 0xfe, 0xfe, 0xfe, 0xfe, 0xfe, 0xfe, 0xfe, 0xfe, 0xfe, 0xfe, 0xfe, 0xfe, 0xfe, 0xfe, 0xfe, 0xfe, 0xfe, 0xfe, 0xfe, 0xfe, 0xfe, 0xfe, 0xfe, 0xfe, 0xfe, 0xfe, 0xfe, 0xfe, 0xfe, 0xfe, 0xfe, 0xfe, 0xfe, 0xfe, 0xfe, 0xfe, 0xfe, 0xfe		 //tile:5 
, 0x00, 0xff, 0x00, 0x00, 0xff, 0x00, 0xfe, 0xfe, 0x00, 0x00, 0xfe, 0x00, 0xff, 0xff, 0x00, 0xfe, 0xfe, 0xfe, 0xfe, 0x00, 0x00, 0xff, 0x00, 0xfe, 0xfe, 0xfe, 0xfe, 0xfe, 0x00, 0x00, 0xfe, 0xfe, 0xfe, 0xfe, 0xfe, 0xfe, 0xfe, 0xfe, 0xfe, 0xfe, 0xfe, 0xfe, 0xfe, 0xfe, 0xfe, 0xfe, 0xfe, 0xfe, 0xfe, 0xfe, 0xfe, 0xfe, 0xfe, 0xfe, 0xfe, 0xfe, 0xfe, 0xfe, 0xfe, 0xfe, 0xfe, 0xfe, 0xfe, 0xfe		 //tile:6 
, 0x00, 0xff, 0xff, 0xff, 0xff, 0x00, 0x00, 0x00, 0x00, 0xff, 0xff, 0xff, 0xff, 0x00, 0xfe, 0xfe, 0x00, 0xff, 0x00, 0x00, 0xff, 0xff, 0x00, 0xfe, 0x00, 0x00, 0xfe, 0x00, 0xff, 0xff, 0x00, 0xfe, 0xfe, 0xfe, 0xfe, 0xfe, 0x00, 0xff, 0xff, 0x00, 0xfe, 0xfe, 0xfe, 0xfe, 0x00, 0xff, 0xff, 0x00, 0xfe, 0xfe, 0xfe, 0xfe, 0xfe, 0x00, 0x00, 0xfe, 0xfe, 0xfe, 0xfe, 0xfe, 0xfe, 0xfe, 0xfe, 0xfe		 //tile:7 
};

//picture: uzeboxlogo.raw
//Horizontal Tiles=6
//Vertical Tiles=7
//Tile Width=6
//Tile Height=8
const char uzeboxlogo[] PROGMEM ={
 0x00, 0x00, 0x00, 0x00, 0x00, 0x00, 0x00, 0x00, 0x00, 0x00, 0x00, 0x00, 0x00, 0x00, 0x00, 0x00, 0x00, 0x00, 0x00, 0x00, 0x00, 0x00, 0x00, 0x00, 0x00, 0x00, 0x00, 0x00, 0x00, 0x00, 0x00, 0x00, 0x00, 0x00, 0x00, 0x00, 0x00, 0x00, 0x00, 0x00, 0x00, 0x00, 0x00, 0x00, 0x00, 0x00, 0x00, 0x00		 //tile:0 
, 0x00, 0x00, 0x00, 0x00, 0x00, 0x00, 0x00, 0x00, 0x00, 0x00, 0x00, 0x00, 0x00, 0x00, 0x00, 0x00, 0x00, 0x00, 0x00, 0x00, 0x00, 0x00, 0x00, 0x00, 0x00, 0x00, 0x00, 0x00, 0x00, 0x00, 0x00, 0x00, 0x00, 0x00, 0x00, 0x49, 0x00, 0x00, 0x00, 0x49, 0x52, 0x52, 0x00, 0x00, 0x52, 0x52, 0x5c, 0x2d		 //tile:1 
, 0x00, 0x00, 0x00, 0x00, 0x00, 0x00, 0x00, 0x00, 0x00, 0x00, 0x00, 0x00, 0x00, 0x00, 0x00, 0x00, 0x00, 0x40, 0x00, 0x00, 0x00, 0x49, 0x4a, 0x52, 0x00, 0x49, 0x52, 0x52, 0x5b, 0x1c, 0x52, 0x53, 0x1c, 0x25, 0x24, 0x1b, 0x24, 0x25, 0x25, 0x1b, 0x0a, 0x0a, 0x2d, 0x1c, 0x12, 0x12, 0x0a, 0x0a		 //tile:2 
, 0x00, 0x00, 0x00, 0x00, 0x00, 0x00, 0x00, 0x00, 0x40, 0x49, 0x49, 0x49, 0x49, 0x49, 0x52, 0x5b, 0x5b, 0x5b, 0x52, 0x5b, 0x1c, 0x1c, 0x13, 0x12, 0x24, 0x1c, 0x12, 0x09, 0x09, 0x09, 0x12, 0x09, 0x09, 0x09, 0x09, 0x0a, 0x0a, 0x0a, 0x0a, 0x0a, 0x0a, 0x13, 0x12, 0x0a, 0x0a, 0x12, 0x13, 0x0a		 //tile:3 
, 0x00, 0x00, 0x00, 0x00, 0x00, 0x00, 0x92, 0x52, 0x52, 0x52, 0x52, 0x52, 0x13, 0x12, 0x13, 0x09, 0x00, 0x1c, 0x0a, 0x12, 0x12, 0x40, 0x1b, 0x65, 0x09, 0x0a, 0x00, 0x09, 0x24, 0x1b, 0x12, 0x00, 0x00, 0x25, 0x1c, 0x1c, 0x01, 0x00, 0x25, 0x24, 0x1c, 0x1c, 0x00, 0x24, 0x25, 0x24, 0x24, 0x24		 //tile:4 
, 0x00, 0x00, 0x00, 0x00, 0x00, 0x00, 0x52, 0x49, 0x49, 0x40, 0x00, 0x00, 0x1b, 0x13, 0x52, 0x49, 0x49, 0x00, 0x64, 0x1c, 0x1c, 0x5b, 0x4a, 0x48, 0x1c, 0x65, 0x1c, 0x25, 0x52, 0x49, 0x1c, 0x1c, 0x65, 0x24, 0x64, 0x49, 0x1c, 0x1c, 0x65, 0x25, 0x64, 0x49, 0x1c, 0x1c, 0x6d, 0x2e, 0x5c, 0x49		 //tile:5 
, 0x00, 0x00, 0x00, 0x00, 0x00, 0x00, 0x00, 0x00, 0x00, 0x00, 0x00, 0x49, 0x00, 0x00, 0x00, 0x00, 0x53, 0x52, 0x00, 0x00, 0x00, 0x53, 0x52, 0x25, 0x00, 0x00, 0x4a, 0x52, 0x25, 0x25, 0x00, 0x00, 0x5b, 0x25, 0x13, 0x00, 0x00, 0x5b, 0x53, 0x00, 0x0a, 0x1c, 0x09, 0x5b, 0x1c, 0x65, 0x7f, 0x37		 //tile:6 
, 0x40, 0x52, 0x52, 0x2e, 0x2e, 0x1c, 0x52, 0x5c, 0x2e, 0x25, 0x1b, 0x13, 0x24, 0x25, 0x1c, 0x1c, 0x12, 0x00, 0x25, 0x25, 0x12, 0x00, 0x00, 0x12, 0x1b, 0x00, 0x00, 0x13, 0x2e, 0x37, 0x00, 0x1b, 0x37, 0x37, 0x2e, 0x2e, 0x37, 0x37, 0x2e, 0x2e, 0x2e, 0x2e, 0x2e, 0x2e, 0x6e, 0x6e, 0x6e, 0x1c		 //tile:7 
, 0x13, 0x13, 0x12, 0x00, 0x09, 0x13, 0x12, 0x00, 0x00, 0x12, 0x13, 0x13, 0x00, 0x12, 0x25, 0x1c, 0x13, 0x13, 0x2e, 0x37, 0x1c, 0x13, 0x13, 0x13, 0x36, 0x1c, 0x13, 0x1b, 0x1b, 0x1b, 0x25, 0x13, 0x1c, 0x1c, 0x1b, 0x1b, 0x1b, 0x1c, 0x1c, 0x1c, 0x1c, 0x1c, 0x1c, 0x1c, 0x1c, 0x1c, 0x1c, 0x13		 //tile:8 
, 0x13, 0x12, 0x12, 0x13, 0x13, 0x00, 0x13, 0x13, 0x13, 0x1c, 0x00, 0x09, 0x13, 0x13, 0x1c, 0x01, 0x00, 0x37, 0x13, 0x1c, 0x13, 0x00, 0x2e, 0x2e, 0x1c, 0x1c, 0x00, 0x1c, 0x77, 0x2e, 0x25, 0x00, 0x13, 0x7f, 0x25, 0x1c, 0x01, 0x0a, 0x37, 0x24, 0x1c, 0x1c, 0x0a, 0x2e, 0x25, 0x25, 0x09, 0x00		 //tile:9 
, 0x13, 0x2e, 0x24, 0x25, 0x25, 0x25, 0x2e, 0x25, 0x25, 0x25, 0x25, 0x25, 0x25, 0x25, 0x2d, 0x2e, 0x25, 0x1b, 0x2e, 0x2e, 0x25, 0x1c, 0x13, 0x25, 0x25, 0x1c, 0x1c, 0x1c, 0x1c, 0x01, 0x1c, 0x1c, 0x13, 0x00, 0x01, 0x1c, 0x0a, 0x00, 0x01, 0x65, 0x77, 0x5c, 0x01, 0x6e, 0x7f, 0x6e, 0x52, 0x1b		 //tile:10 
, 0x25, 0x25, 0x6d, 0x1c, 0x52, 0x49, 0x25, 0x25, 0x1c, 0x13, 0x53, 0x00, 0x1c, 0x1c, 0x1c, 0x52, 0x4a, 0x00, 0x1b, 0x13, 0x5b, 0x5b, 0x00, 0x00, 0x09, 0x52, 0x5c, 0x00, 0x00, 0x00, 0x5b, 0x5c, 0x00, 0x00, 0x00, 0x00, 0x1b, 0x00, 0x00, 0x00, 0x00, 0x00, 0x00, 0x00, 0x00, 0x00, 0x00, 0x00		 //tile:11 
, 0x13, 0x5b, 0x7f, 0x77, 0x6e, 0x6e, 0x13, 0x65, 0x77, 0x76, 0x6e, 0x6e, 0x1b, 0x65, 0x77, 0x76, 0x76, 0x76, 0x1b, 0x5b, 0xbf, 0x76, 0xb6, 0x76, 0x09, 0x13, 0x6d, 0xbf, 0xb7, 0xb6, 0x00, 0x1b, 0x12, 0x5c, 0x76, 0xbf, 0x00, 0x00, 0x12, 0x1b, 0x12, 0x5b, 0x00, 0x00, 0x00, 0x00, 0x09, 0x0a		 //tile:12 
, 0x6e, 0x6e, 0x6e, 0x77, 0x24, 0x1c, 0x6e, 0x6e, 0x77, 0x25, 0x1c, 0x1c, 0x6e, 0x77, 0x6e, 0x1c, 0x1c, 0x1c, 0x76, 0x76, 0x1c, 0x1c, 0x24, 0x25, 0xb7, 0x65, 0x64, 0x6d, 0x6d, 0x1b, 0x76, 0x6d, 0x6d, 0x5b, 0x09, 0x12, 0x5b, 0x5c, 0x5b, 0x12, 0x5b, 0x64, 0x12, 0x13, 0x13, 0x1b, 0x12, 0x12		 //tile:13 
, 0x1c, 0x1c, 0x1c, 0x1c, 0x1c, 0x24, 0x1c, 0x1c, 0x24, 0x25, 0x25, 0x24, 0x24, 0x25, 0x25, 0x1b, 0x00, 0x00, 0x25, 0x13, 0x00, 0x00, 0x64, 0xbf, 0x00, 0x09, 0x6e, 0xbf, 0xbf, 0x6d, 0x6e, 0xbf, 0x6d, 0x5b, 0x12, 0x13, 0x5b, 0x12, 0x13, 0x12, 0x09, 0x00, 0x09, 0x01, 0x00, 0x00, 0x00, 0x00		 //tile:14 
, 0x2e, 0x1c, 0x09, 0x00, 0x09, 0x6e, 0x01, 0x00, 0x09, 0x76, 0x7f, 0x7f, 0x12, 0x77, 0x7f, 0x7f, 0x64, 0x12, 0xbf, 0x77, 0x5b, 0x12, 0x1b, 0x09, 0x5b, 0x12, 0x1b, 0x09, 0x00, 0x00, 0x1b, 0x09, 0x00, 0x00, 0x00, 0x00, 0x00, 0x00, 0x00, 0x00, 0x00, 0x00, 0x00, 0x00, 0x00, 0x00, 0x00, 0x00		 //tile:15 
, 0x7f, 0x7f, 0x53, 0x13, 0x13, 0x00, 0x64, 0x12, 0x1b, 0x01, 0x00, 0x00, 0x1b, 0x12, 0x00, 0x00, 0x00, 0x00, 0x00, 0x00, 0x00, 0x00, 0x00, 0x00, 0x00, 0x00, 0x00, 0x00, 0x00, 0x00, 0x00, 0x00, 0x00, 0x00, 0x00, 0x00, 0x00, 0x00, 0x00, 0x00, 0x00, 0x00, 0x00, 0x00, 0x00, 0x00, 0x00, 0x00		 //tile:16 
, 0x00, 0x00, 0x00, 0x00, 0x00, 0x00, 0x26, 0x00, 0x00, 0x00, 0x26, 0x00, 0x2f, 0x00, 0x00, 0x00, 0x2f, 0x00, 0x37, 0x00, 0x00, 0x00, 0x37, 0x00, 0xff, 0x00, 0x00, 0x00, 0xff, 0x00, 0xbf, 0x00, 0x00, 0x00, 0xbf, 0x00, 0x37, 0x00, 0x00, 0x37, 0x00, 0x00, 0x00, 0x26, 0x26, 0x00, 0x00, 0x00		 //tile:17 
, 0x00, 0x00, 0x00, 0x00, 0x00, 0x00, 0x26, 0x26, 0x26, 0x26, 0x26, 0x00, 0x00, 0x00, 0x00, 0x00, 0x2f, 0x00, 0x00, 0x00, 0x00, 0x37, 0x00, 0x00, 0x00, 0x00, 0xff, 0x00, 0x00, 0x00, 0x00, 0xbf, 0x00, 0x00, 0x00, 0x00, 0x37, 0x00, 0x00, 0x00, 0x00, 0x00, 0x26, 0x26, 0x26, 0x26, 0x26, 0x00		 //tile:18 
, 0x00, 0x00, 0x00, 0x00, 0x00, 0x00, 0x26, 0x26, 0x26, 0x26, 0x26, 0x00, 0x2f, 0x00, 0x00, 0x00, 0x00, 0x00, 0x37, 0x00, 0x00, 0x00, 0x00, 0x00, 0xff, 0xff, 0xff, 0xff, 0x00, 0x00, 0xbf, 0x00, 0x00, 0x00, 0x00, 0x00, 0x37, 0x00, 0x00, 0x00, 0x00, 0x00, 0x26, 0x26, 0x26, 0x26, 0x26, 0x00		 //tile:19 
, 0x00, 0x00, 0x00, 0x00, 0x00, 0x00, 0x26, 0x26, 0x26, 0x26, 0x00, 0x00, 0x2f, 0x00, 0x00, 0x00, 0x2f, 0x00, 0x37, 0x00, 0x00, 0x00, 0x37, 0x00, 0xff, 0xff, 0xff, 0xff, 0x00, 0x00, 0xbf, 0x00, 0x00, 0x00, 0xbf, 0x00, 0x37, 0x00, 0x00, 0x00, 0x37, 0x00, 0x26, 0x26, 0x26, 0x26, 0x00, 0x00		 //tile:20 
, 0x00, 0x00, 0x00, 0x00, 0x00, 0x00, 0x00, 0x00, 0x26, 0x26, 0x26, 0x00, 0x00, 0x2f, 0x00, 0x00, 0x2f, 0x00, 0x37, 0x00, 0x00, 0x00, 0x37, 0x00, 0xff, 0x00, 0x00, 0x00, 0xff, 0x00, 0xbf, 0x00, 0x00, 0x00, 0xbf, 0x00, 0x37, 0x00, 0x00, 0x37, 0x00, 0x00, 0x26, 0x26, 0x26, 0x00, 0x00, 0x00		 //tile:21 
, 0x00, 0x00, 0x00, 0x00, 0x00, 0x00, 0x26, 0x00, 0x00, 0x00, 0x26, 0x00, 0x2f, 0x00, 0x00, 0x00, 0x2f, 0x00, 0x00, 0x37, 0x00, 0x37, 0x00, 0x00, 0x00, 0x00, 0xff, 0x00, 0x00, 0x00, 0x00, 0xbf, 0x00, 0xbf, 0x00, 0x00, 0x37, 0x00, 0x00, 0x00, 0x37, 0x00, 0x26, 0x00, 0x00, 0x00, 0x26, 0x00		 //tile:22 
, 0x00, 0x00, 0x00, 0x00, 0x00, 0x00, 0x00, 0x00, 0x00, 0x00, 0x00, 0x00, 0x00, 0x00, 0x00, 0x00, 0x00, 0x00, 0x00, 0x00, 0x00, 0x00, 0x00, 0x00, 0x00, 0x00, 0x00, 0x00, 0x00, 0x00, 0x00, 0x00, 0x00, 0x00, 0x00, 0x9b, 0x00, 0x00, 0x00, 0x52, 0x9b, 0xa4, 0x00, 0x00, 0x5b, 0x9b, 0x6d, 0x77		 //tile:23 
, 0x00, 0x00, 0x00, 0x00, 0x00, 0x00, 0x00, 0x00, 0x00, 0x00, 0x00, 0x00, 0x00, 0x00, 0x00, 0x00, 0x00, 0x5b, 0x00, 0x00, 0x00, 0xe4, 0xf6, 0xff, 0x09, 0x9b, 0xed, 0xf6, 0xff, 0xbf, 0xa4, 0xad, 0xbf, 0xbf, 0xbf, 0xbf, 0x76, 0x7f, 0x7f, 0xb7, 0xb7, 0xbf, 0x7f, 0x76, 0x6e, 0xb7, 0xb7, 0xbf		 //tile:24 
, 0x00, 0x00, 0x00, 0x00, 0x00, 0x00, 0x00, 0x00, 0x5b, 0xb6, 0xf6, 0xf6, 0xf6, 0xff, 0xff, 0xff, 0xff, 0xbf, 0xff, 0xff, 0xff, 0xbf, 0xbf, 0xae, 0xff, 0xff, 0xff, 0xb7, 0xad, 0x65, 0xff, 0xff, 0xb7, 0xb6, 0xad, 0x65, 0xff, 0xff, 0xbf, 0xb7, 0xae, 0x6e, 0xff, 0xff, 0xbf, 0xb7, 0xb7, 0x65		 //tile:25 
, 0x00, 0x00, 0x00, 0x00, 0x00, 0x00, 0xf6, 0xf6, 0xed, 0xed, 0xad, 0xa4, 0xb6, 0x6d, 0x6d, 0x5c, 0x52, 0x6e, 0x65, 0x65, 0x65, 0x52, 0x65, 0x76, 0x5c, 0x5c, 0x52, 0x53, 0x6e, 0x24, 0x65, 0x52, 0x52, 0x6e, 0x25, 0x25, 0x5b, 0x52, 0x77, 0x2d, 0x25, 0x25, 0x52, 0x6e, 0x6e, 0x2d, 0x25, 0x25		 //tile:26 
, 0x00, 0x00, 0x00, 0x00, 0x00, 0x00, 0xa4, 0x9b, 0x9b, 0x49, 0x00, 0x00, 0x65, 0x64, 0xa4, 0x9b, 0x92, 0x00, 0x6d, 0x25, 0x25, 0x64, 0x93, 0x49, 0x65, 0x6e, 0x65, 0x2e, 0x9b, 0x52, 0x24, 0x25, 0x6d, 0x25, 0x65, 0x52, 0x25, 0x24, 0x6d, 0x2d, 0x65, 0x52, 0x25, 0x25, 0x6e, 0x2e, 0x64, 0x52		 //tile:27 
, 0x00, 0x00, 0x00, 0x00, 0x00, 0x00, 0x00, 0x00, 0x00, 0x00, 0x00, 0x4a, 0x00, 0x00, 0x00, 0x00, 0x5b, 0x9b, 0x00, 0x00, 0x00, 0x5b, 0x5b, 0x2d, 0x00, 0x00, 0x52, 0x5b, 0x2e, 0x2e, 0x00, 0x01, 0x5b, 0x2d, 0x1c, 0x01, 0x00, 0x5c, 0x5b, 0x01, 0x4a, 0x65, 0x4a, 0x5b, 0x1c, 0x6e, 0x7f, 0x77		 //tile:28 
, 0x49, 0x5b, 0x9b, 0x77, 0x77, 0x6d, 0x5b, 0x65, 0x77, 0x6e, 0x65, 0x65, 0x6d, 0x2d, 0x25, 0x25, 0x5c, 0x52, 0x2e, 0x25, 0x13, 0x09, 0x49, 0x64, 0x1c, 0x09, 0x09, 0x5c, 0x7f, 0x7f, 0x09, 0x1c, 0x7f, 0x7f, 0x77, 0x7f, 0x77, 0x7f, 0x77, 0x77, 0x7f, 0x7f, 0x77, 0x76, 0x77, 0x7f, 0x7f, 0x6e		 //tile:29 
, 0x65, 0x6e, 0x6e, 0xa4, 0xb6, 0xff, 0x65, 0x5b, 0xa4, 0xb7, 0xbf, 0xff, 0x52, 0x6d, 0xbf, 0xbf, 0xbf, 0xff, 0x7f, 0xbf, 0xbf, 0xbf, 0xbf, 0xff, 0xbf, 0xbf, 0xb7, 0xbf, 0xff, 0xff, 0x7f, 0xb7, 0xbf, 0xbf, 0xff, 0xff, 0x6e, 0xb7, 0xbf, 0xbf, 0xff, 0xff, 0x77, 0xbf, 0xbf, 0xbf, 0xff, 0xff		 //tile:30 
, 0xff, 0xff, 0xbf, 0xbf, 0xb7, 0x5b, 0xff, 0xff, 0xbf, 0xbf, 0xa4, 0x64, 0xff, 0xff, 0xbf, 0xad, 0xa4, 0x7f, 0xff, 0xff, 0xbf, 0xa4, 0xbf, 0x7f, 0xff, 0xbf, 0xad, 0xbf, 0xbf, 0xbf, 0xff, 0xb6, 0xbf, 0xbf, 0xbf, 0x77, 0xf7, 0xbf, 0xbf, 0xbf, 0x77, 0x77, 0xff, 0xbf, 0xbf, 0xbf, 0x64, 0x52		 //tile:31 
, 0x6d, 0x7f, 0x6e, 0x2e, 0x2d, 0x2d, 0x7f, 0x76, 0x6e, 0x6e, 0x6e, 0x2e, 0x77, 0x77, 0x77, 0x76, 0x2e, 0x1c, 0x7f, 0x77, 0x6e, 0x25, 0x1c, 0x25, 0x77, 0x65, 0x25, 0x25, 0x1c, 0x09, 0x6e, 0x6e, 0x1c, 0x09, 0x49, 0x25, 0x5b, 0x49, 0x4a, 0x6e, 0x7f, 0x64, 0x53, 0x77, 0xbf, 0x77, 0x5b, 0x5c		 //tile:32 
, 0x25, 0x6e, 0x6e, 0x25, 0x5b, 0x4a, 0x25, 0x65, 0x1c, 0x1b, 0x5b, 0x00, 0x25, 0x24, 0x24, 0x5b, 0x53, 0x00, 0x1c, 0x1b, 0x5b, 0x5c, 0x00, 0x00, 0x0a, 0x5b, 0x64, 0x00, 0x00, 0x00, 0x64, 0x64, 0x00, 0x00, 0x00, 0x00, 0x5c, 0x00, 0x00, 0x00, 0x00, 0x00, 0x00, 0x00, 0x00, 0x00, 0x00, 0x00		 //tile:33 
, 0x5b, 0x5c, 0x7f, 0xbf, 0x77, 0x76, 0x5c, 0x6d, 0x7f, 0xb7, 0x77, 0x77, 0x5c, 0x6d, 0x7f, 0xbf, 0x77, 0x77, 0x5c, 0x64, 0xbf, 0xbf, 0xbf, 0xbf, 0x0a, 0x5c, 0x6e, 0xbf, 0xbf, 0xbf, 0x00, 0x65, 0x64, 0x6d, 0xbf, 0xbf, 0x00, 0x00, 0x5b, 0x6d, 0x64, 0x6d, 0x00, 0x00, 0x00, 0x00, 0x12, 0x5b		 //tile:34 
, 0x77, 0x77, 0x77, 0x7f, 0x6e, 0x6e, 0x77, 0x77, 0x7f, 0x76, 0x6d, 0x76, 0x77, 0xbf, 0x77, 0x6d, 0x6e, 0x76, 0xbf, 0x7f, 0x6d, 0x6e, 0x76, 0x7f, 0xbf, 0x76, 0x76, 0xbf, 0xbf, 0x76, 0xbf, 0xbf, 0xbf, 0xb6, 0x64, 0xad, 0xad, 0xb6, 0xb6, 0xad, 0xbf, 0xff, 0x64, 0x6d, 0xad, 0xb6, 0xad, 0x64		 //tile:35 
, 0x77, 0xbf, 0xbf, 0xbf, 0xff, 0xff, 0x77, 0xbf, 0xbf, 0xbf, 0xff, 0xff, 0x7f, 0xbf, 0xbf, 0xbf, 0xff, 0xf6, 0xbf, 0xb7, 0xad, 0xf6, 0xff, 0xff, 0xa4, 0xad, 0xff, 0xff, 0xff, 0xff, 0xff, 0xff, 0xff, 0xff, 0xff, 0xff, 0xff, 0xff, 0xff, 0xf6, 0xa4, 0x00, 0x5b, 0x52, 0x00, 0x00, 0x00, 0x00		 //tile:36 
, 0xbf, 0xbf, 0xad, 0x5b, 0x64, 0xbf, 0xb6, 0xad, 0xad, 0xbf, 0xff, 0xbf, 0xff, 0xff, 0xff, 0xff, 0xbf, 0x64, 0xff, 0xff, 0xbf, 0xb6, 0x76, 0x5b, 0xff, 0xbf, 0xbf, 0x5b, 0x00, 0x00, 0xff, 0x5c, 0x00, 0x00, 0x00, 0x00, 0x00, 0x00, 0x00, 0x00, 0x00, 0x00, 0x00, 0x00, 0x00, 0x00, 0x00, 0x00		 //tile:37 
, 0xbf, 0xbf, 0x64, 0x5c, 0x5c, 0x00, 0x6e, 0x5c, 0x65, 0x49, 0x00, 0x00, 0x6d, 0x5b, 0x00, 0x00, 0x00, 0x00, 0x00, 0x00, 0x00, 0x00, 0x00, 0x00, 0x00, 0x00, 0x00, 0x00, 0x00, 0x00, 0x00, 0x00, 0x00, 0x00, 0x00, 0x00, 0x00, 0x00, 0x00, 0x00, 0x00, 0x00, 0x00, 0x00, 0x00, 0x00, 0x00, 0x00		 //tile:38 
};

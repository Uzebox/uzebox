const char map_main[] PROGMEM ={
30,27
,0x00,0x00,0x00,0x00,0x00,0x00,0x00,0x00,0x00,0x00,0x00,0x00,0x00,0x00,0x01,0x02,0x00,0x00,0x00,0x00
,0x00,0x00,0x00,0x00,0x00,0x00,0x00,0x00,0x00,0x00,0x00,0x00,0x03,0x04,0x05,0x06,0x07,0x08,0x09,0x0a
,0x0b,0x0c,0x0d,0x0e,0x0f,0x10,0x00,0x00,0x00,0x00,0x00,0x00,0x00,0x00,0x00,0x00,0x00,0x00,0x00,0x00
,0x00,0x00,0x11,0x12,0x13,0x14,0x15,0x16,0x17,0x18,0x19,0x1a,0x1b,0x1c,0x1d,0x1e,0x00,0x00,0x00,0x00
,0x00,0x00,0x00,0x00,0x00,0x00,0x00,0x00,0x00,0x00,0x00,0x00,0x1f,0x20,0x20,0x20,0x20,0x20,0x20,0x20
,0x20,0x20,0x20,0x20,0x20,0x20,0x20,0x20,0x20,0x20,0x20,0x20,0x20,0x20,0x20,0x20,0x20,0x21,0x00,0x00
,0x00,0x00,0x22,0x23,0x24,0x25,0x26,0x27,0x28,0x25,0x28,0x25,0x29,0x2a,0x24,0x2b,0x24,0x2b,0x28,0x25
,0x24,0x25,0x24,0x25,0x2c,0x2c,0x2c,0x2d,0x00,0x00,0x00,0x00,0x22,0x2e,0x29,0x2a,0x2f,0x27,0x30,0x31
,0x32,0x33,0x34,0x33,0x34,0x35,0x36,0x35,0x2c,0x2a,0x36,0x33,0x34,0x33,0x2c,0x2c,0x2c,0x2d,0x00,0x00
,0x00,0x00,0x22,0x37,0x38,0x39,0x3a,0x3b,0x38,0x3c,0x3d,0x39,0x2c,0x2a,0x3d,0x39,0x38,0x39,0x2c,0x2a
,0x38,0x39,0x3d,0x39,0x2c,0x2c,0x2c,0x2d,0x00,0x00,0x00,0x00,0x22,0x2c,0x2c,0x2c,0x2c,0x2c,0x2c,0x2c
,0x2c,0x2c,0x2c,0x2c,0x2c,0x2c,0x2c,0x2c,0x2c,0x2c,0x2c,0x2c,0x2c,0x2c,0x2c,0x2c,0x2c,0x2d,0x00,0x00
,0x00,0x00,0x3e,0x3f,0x3f,0x3f,0x3f,0x3f,0x3f,0x3f,0x3f,0x3f,0x3f,0x3f,0x3f,0x3f,0x3f,0x3f,0x3f,0x3f
,0x3f,0x3f,0x3f,0x3f,0x3f,0x3f,0x3f,0x40,0x00,0x00,0x00,0x00,0x41,0x42,0x42,0x42,0x42,0x42,0x42,0x42
,0x42,0x42,0x42,0x42,0x42,0x42,0x42,0x42,0x42,0x42,0x42,0x42,0x42,0x42,0x42,0x42,0x42,0x43,0x00,0x00
,0x00,0x00,0x00,0x00,0x00,0x00,0x00,0x00,0x00,0x00,0x00,0x00,0x00,0x00,0x00,0x00,0x00,0x00,0x00,0x00
,0x00,0x00,0x00,0x00,0x00,0x00,0x00,0x00,0x00,0x00,0x00,0x00,0x00,0x00,0x00,0x00,0x00,0x00,0x00,0x00
,0x00,0x00,0x00,0x00,0x00,0x00,0x00,0x00,0x00,0x00,0x00,0x00,0x00,0x00,0x00,0x00,0x00,0x00,0x00,0x00
,0x00,0x00,0x00,0x00,0x00,0x00,0x00,0x00,0x00,0x00,0x00,0x00,0x00,0x00,0x00,0x00,0x00,0x00,0x00,0x00
,0x00,0x00,0x00,0x00,0x00,0x00,0x00,0x00,0x00,0x00,0x00,0x00,0x44,0x45,0x45,0x45,0x45,0x45,0x45,0x45
,0x45,0x45,0x45,0x45,0x45,0x45,0x45,0x45,0x45,0x45,0x45,0x45,0x45,0x45,0x45,0x45,0x45,0x45,0x46,0x00
,0x00,0x47,0x48,0x48,0x48,0x48,0x48,0x48,0x48,0x48,0x48,0x48,0x48,0x48,0x48,0x48,0x48,0x48,0x48,0x48
,0x48,0x48,0x48,0x48,0x48,0x48,0x48,0x48,0x49,0x00,0x00,0x47,0x48,0x48,0x48,0x48,0x48,0x48,0x48,0x48
,0x48,0x48,0x48,0x48,0x48,0x48,0x48,0x48,0x48,0x48,0x48,0x48,0x48,0x48,0x48,0x48,0x48,0x48,0x49,0x00
,0x00,0x47,0x48,0x48,0x48,0x48,0x48,0x48,0x48,0x48,0x48,0x48,0x48,0x48,0x48,0x48,0x48,0x48,0x48,0x48
,0x48,0x48,0x48,0x48,0x48,0x48,0x48,0x48,0x49,0x00,0x00,0x47,0x48,0x48,0x48,0x48,0x48,0x48,0x48,0x48
,0x48,0x48,0x48,0x48,0x48,0x48,0x48,0x48,0x48,0x48,0x48,0x48,0x48,0x48,0x48,0x48,0x48,0x48,0x49,0x00
,0x00,0x47,0x48,0x48,0x48,0x48,0x48,0x48,0x48,0x48,0x48,0x48,0x48,0x48,0x48,0x48,0x48,0x48,0x48,0x48
,0x48,0x48,0x48,0x48,0x48,0x48,0x48,0x48,0x49,0x00,0x00,0x47,0x48,0x48,0x48,0x48,0x48,0x48,0x48,0x48
,0x48,0x48,0x48,0x48,0x48,0x48,0x48,0x48,0x48,0x48,0x48,0x48,0x48,0x48,0x48,0x48,0x48,0x48,0x49,0x00
,0x00,0x47,0x48,0x48,0x48,0x48,0x48,0x48,0x48,0x48,0x48,0x48,0x48,0x48,0x48,0x48,0x48,0x48,0x48,0x48
,0x48,0x48,0x48,0x48,0x48,0x48,0x48,0x48,0x49,0x00,0x00,0x47,0x48,0x48,0x48,0x48,0x48,0x48,0x48,0x48
,0x48,0x48,0x48,0x48,0x48,0x48,0x48,0x48,0x48,0x48,0x48,0x48,0x48,0x48,0x48,0x48,0x48,0x48,0x49,0x00
,0x00,0x47,0x48,0x48,0x48,0x48,0x48,0x48,0x48,0x48,0x48,0x48,0x48,0x48,0x48,0x48,0x48,0x48,0x48,0x48
,0x48,0x48,0x48,0x48,0x48,0x48,0x48,0x48,0x49,0x00,0x00,0x47,0x48,0x48,0x48,0x48,0x48,0x48,0x48,0x48
,0x48,0x48,0x48,0x48,0x48,0x48,0x48,0x48,0x48,0x48,0x48,0x48,0x48,0x48,0x48,0x48,0x48,0x48,0x49,0x00
,0x00,0x47,0x48,0x48,0x48,0x48,0x48,0x48,0x48,0x48,0x48,0x48,0x48,0x48,0x48,0x48,0x48,0x48,0x48,0x48
,0x48,0x48,0x48,0x48,0x48,0x48,0x48,0x48,0x49,0x00,0x00,0x4a,0x48,0x48,0x48,0x48,0x48,0x48,0x48,0x48
,0x48,0x48,0x48,0x48,0x48,0x48,0x48,0x48,0x48,0x48,0x48,0x48,0x48,0x48,0x48,0x48,0x48,0x4b,0x4c,0x00
,0x00,0x4d,0x4e,0x4f,0x4f,0x4f,0x4f,0x4f,0x4f,0x4f,0x4f,0x4f,0x4f,0x4f,0x4f,0x4f,0x4f,0x4f,0x4f,0x4f
,0x4f,0x4f,0x4f,0x4f,0x4f,0x4f,0x4f,0x50,0x00,0x00};
const char map_digitSep[] PROGMEM ={
1,3
,0x23,0x2e,0x37};
const char map_digit0[] PROGMEM ={
2,3
,0x24,0x25,0x29,0x2a,0x38,0x39};
const char map_digit1[] PROGMEM ={
2,3
,0x26,0x27,0x2f,0x27,0x3a,0x3b};
const char map_digit2[] PROGMEM ={
2,3
,0x28,0x25,0x30,0x31,0x38,0x3c};
const char map_digit3[] PROGMEM ={
2,3
,0x28,0x25,0x32,0x33,0x3d,0x39};
const char map_digit4[] PROGMEM ={
2,3
,0x29,0x2a,0x34,0x33,0x2c,0x2a};
const char map_digit5[] PROGMEM ={
2,3
,0x24,0x2b,0x34,0x35,0x3d,0x39};
const char map_digit6[] PROGMEM ={
2,3
,0x24,0x2b,0x36,0x35,0x38,0x39};
const char map_digit7[] PROGMEM ={
2,3
,0x28,0x25,0x2c,0x2a,0x2c,0x2a};
const char map_digit8[] PROGMEM ={
2,3
,0x24,0x25,0x36,0x33,0x38,0x39};
const char map_digit9[] PROGMEM ={
2,3
,0x24,0x25,0x34,0x33,0x3d,0x39};
const char map_digitBlank[] PROGMEM ={
2,3
,0x2c,0x2c,0x2c,0x2c,0x2c,0x2c};
const char map_btnPrevNormal[] PROGMEM ={
3,2
,0x51,0x52,0x53,0x64,0x65,0x66};
const char map_btnPrevPushed[] PROGMEM ={
3,2
,0x5a,0x5b,0x5c,0x6d,0x6e,0x6f};
const char map_btnPlayNormal[] PROGMEM ={
3,2
,0x51,0x54,0x53,0x64,0x67,0x66};
const char map_btnPlayPushed[] PROGMEM ={
3,2
,0x5d,0x5e,0x5c,0x70,0x71,0x6f};
const char map_btnPauseNormal[] PROGMEM ={
3,2
,0x51,0x55,0x53,0x64,0x68,0x66};
const char map_btnPausePushed[] PROGMEM ={
3,2
,0x5d,0x5f,0x5c,0x70,0x72,0x6f};
const char map_btnStopNormal[] PROGMEM ={
3,2
,0x51,0x56,0x53,0x64,0x69,0x66};
const char map_btnStopPushed[] PROGMEM ={
3,2
,0x5d,0x60,0x5c,0x70,0x73,0x6f};
const char map_btnNextNormal[] PROGMEM ={
3,2
,0x57,0x58,0x59,0x6a,0x6b,0x6c};
const char map_btnNextPushed[] PROGMEM ={
3,2
,0x61,0x62,0x63,0x74,0x75,0x76};

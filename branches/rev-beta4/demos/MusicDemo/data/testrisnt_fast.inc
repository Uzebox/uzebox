//*********************************//
// MIDI file: F:\work\uzebox\sources\rev4-beta\demos\MusicDemo\data\tetrisnt_fast.mid
//*********************************//
const char song_testrisnt_fast[] PROGMEM ={
0x00,0xff,0x06,0x01,0x53,0x00,0xc0,0x10,0x00,0xb0,0x07,0x7f,0x00,0xc1,0x10,0x00,0xb1,0x07,0x7f,0x00,0xc2,0x0b,0x00,0xb2,0x07,0x7f,0x00,0x92,0x2d,0x5a,0x00,0xb3,
0x07,0x7f,0x00,0x93,0x07,0x20,0x00,0xb4,0x07,0x7f,0x00,0xb5,0x07,0x7f,0x00,0xb6,0x07,0x7f,0x00,0xb7,0x07,0x7f,0x00,0xb8,0x07,0x7f,0x00,0xb3,0x07,0x7f,0x00,0xba,
0x07,0x7f,0x00,0xbb,0x07,0x7f,0x00,0xbc,0x07,0x7f,0x00,0xbd,0x07,0x7f,0x00,0xbe,0x07,0x7f,0x00,0xbf,0x07,0x7f,0x00,0x91,0x45,0x7f,0x05,0x93,0x07,0x20,0x07,0x90,
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0x00,0x93,0x0e,0x20,0x05,0x91,0x51,0x7f,0x05,0x93,0x07,0x20,0x0f,0xff,0x06,0x01,0x45,0x0a,0xff,0x2f,0x00 };

//*********************************//
// MIDI file: C:\Documents and Settings\Admin\My Documents\projet\atmel\uzebox2\music\mario.mid
//*********************************//
const char song_mario[] PROGMEM ={
0x00,0xc0,0x0c,0x00,0x90,0x40,0x50,0x00,0xc1,0x0c,0x00,0x91,0x36,0x50,0x00,0xc2,0x0d,0x00,0x92,0x26,0x7f,0x00,0x93,0x07,0x41,0x00,0xc3,0x07,0x00,0xc1,0x03,0x11,
0x90,0x40,0x50,0x00,0x91,0x36,0x50,0x00,0x92,0x26,0x7f,0x12,0x93,0x07,0x41,0x12,0x90,0x40,0x50,0x00,0x91,0x36,0x50,0x00,0x92,0x26,0x7f,0x00,0x93,0x07,0x41,0x23,
0x90,0x3c,0x50,0x00,0x91,0x36,0x50,0x00,0x92,0x26,0x7f,0x00,0x93,0x07,0x41,0x12,0x90,0x40,0x50,0x00,0x91,0x36,0x50,0x00,0x92,0x26,0x7f,0x00,0x93,0x07,0x41,0x23,
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0x0c,0xff,0x2f,0x00 };

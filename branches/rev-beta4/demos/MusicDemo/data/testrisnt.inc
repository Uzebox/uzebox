//*********************************//
// MIDI file: F:\work\uzebox\sources\rev4-beta\demos\Megatris\data\testrisnt__0.mid
//*********************************//
const char song_testrisnt[] PROGMEM ={
0x00,0xc0,0x11,0x00,0xb0,0x07,0x7f,0x00,0xc1,0x03,0x00,0xb1,0x07,0x7f,0x00,0xc2,0x0b,0x00,0xb2,0x07,0x7f,0x00,0x92,0x32,0x69,0x00,0xc3,0x07,0x00,0xb3,0x07,0x7f,
0x00,0x93,0x0d,0x32,0x00,0x90,0x3e,0x7f,0x0a,0x92,0x32,0x69,0x00,0x93,0x07,0x3e,0x02,0x90,0x3e,0x7f,0x04,0x92,0x32,0x69,0x00,0x93,0x07,0x3e,0x01,0x90,0x3e,0x7f,
0x05,0x92,0x2d,0x69,0x00,0x93,0x07,0x3e,0x01,0x90,0x39,0x7f,0x0b,0x92,0x2d,0x69,0x00,0x93,0x07,0x3e,0x00,0x90,0x39,0x7f,0x0b,0x92,0x32,0x69,0x00,0x93,0x0d,0x32,
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0x2f,0x00 };

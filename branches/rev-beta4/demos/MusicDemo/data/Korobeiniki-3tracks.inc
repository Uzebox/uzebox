//*********************************//
// MIDI file: F:\work\uzebox\sources\rev4-beta\demos\Megatris\data\Korobeiniki-3tracks.mid
//*********************************//
const char song_korobeiniki[] PROGMEM ={
0x00,0xff,0x06,0x01,0x53,0x00,0xc0,0x00,0x00,0x90,0x4c,0x6b,0x00,0xc2,0x00,0x00,0xb2,0x07,0x6e,0x00,0x92,0x28,0x6b,0x00,0xc1,0x00,0x00,0x91,0x47,0x6b,0x0b,0x92,
0x34,0x6b,0x0c,0x90,0x47,0x6b,0x00,0x92,0x28,0x6b,0x00,0x91,0x44,0x6b,0x0b,0x90,0x48,0x6b,0x00,0x92,0x34,0x6b,0x00,0x91,0x45,0x6b,0x0c,0x90,0x4a,0x6b,0x00,0x92,
0x28,0x6b,0x00,0x91,0x47,0x6b,0x0b,0x90,0x4c,0x6b,0x00,0x92,0x34,0x6b,0x00,0x91,0x44,0x6b,0x06,0x90,0x4a,0x6b,0x06,0x48,0x6b,0x00,0x92,0x28,0x6b,0x00,0x91,0x45,
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0x0b,0x34,0x6b,0x0c,0x2c,0x6b,0x0c,0x34,0x6b,0x0b,0xff,0x06,0x01,0x45,0x00,0xff,0x2f,0x00 };

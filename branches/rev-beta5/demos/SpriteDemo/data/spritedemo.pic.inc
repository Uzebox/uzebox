//picture: arkanoid-tiles.raw
//Horizontal Tiles=22
//Vertical Tiles=35
//Tile Width=6
//Tile Height=8
#define SPRITEDEMO_TILESET_SIZE 94

const char spritedemo_tileset[] PROGMEM ={
 0x00, 0x00, 0x00, 0x00, 0x00, 0x00, 0x00, 0x00, 0x00, 0x00, 0x00, 0x00, 0x00, 0x00, 0x00, 0x00, 0x00, 0x00, 0x00, 0x00, 0x00, 0x00, 0x00, 0x00, 0x00, 0x00, 0x00, 0x00, 0x00, 0x00, 0x00, 0x00, 0x00, 0x00, 0x00, 0x00, 0x00, 0x00, 0x00, 0x00, 0x00, 0x00, 0x00, 0x00, 0x00, 0x00, 0x00, 0x00		 //tile:0 
, 0x49, 0x49, 0x49, 0x49, 0x49, 0x49, 0x49, 0x99, 0x49, 0x99, 0x49, 0x99, 0x49, 0x49, 0x49, 0x49, 0x49, 0x49, 0x49, 0xe2, 0x99, 0x49, 0xe2, 0x99, 0x49, 0x49, 0x49, 0x49, 0x49, 0x49, 0x49, 0xe2, 0xe2, 0xe2, 0xe2, 0xe2, 0x49, 0xe2, 0x99, 0x99, 0x99, 0x99, 0x49, 0x49, 0x49, 0x49, 0x49, 0x49		 //tile:1 
, 0x49, 0x49, 0x49, 0x49, 0x49, 0x49, 0x49, 0xe2, 0xe2, 0xe2, 0xe2, 0xe2, 0x49, 0xe2, 0x99, 0x99, 0x99, 0x99, 0x49, 0x49, 0x49, 0x49, 0x49, 0x49, 0x49, 0xe2, 0x99, 0x49, 0xe2, 0x99, 0x49, 0x49, 0x49, 0x49, 0x49, 0x49, 0x49, 0x99, 0x49, 0x99, 0x49, 0x99, 0x49, 0x49, 0x49, 0x49, 0x49, 0x49		 //tile:2 
, 0x00, 0x00, 0x00, 0x00, 0x00, 0x00, 0x00, 0x49, 0x49, 0x49, 0x00, 0x49, 0x00, 0x49, 0x00, 0x49, 0x00, 0x00, 0x00, 0x49, 0x00, 0x49, 0x49, 0x49, 0x00, 0x49, 0x00, 0x49, 0x00, 0x00, 0x00, 0x49, 0x49, 0x49, 0x00, 0x00, 0x00, 0x00, 0x00, 0x00, 0x00, 0x00, 0x00, 0x49, 0x49, 0x49, 0x00, 0x00		 //tile:3 
, 0x00, 0x00, 0x00, 0x00, 0x00, 0x00, 0x49, 0x49, 0x00, 0x49, 0x49, 0x00, 0x00, 0x00, 0x00, 0x00, 0x00, 0x00, 0x49, 0x49, 0x49, 0x49, 0x49, 0x49, 0x00, 0x00, 0x00, 0x00, 0x00, 0x00, 0x00, 0x00, 0x00, 0x00, 0x00, 0x00, 0x00, 0x00, 0x00, 0x51, 0x51, 0x51, 0x00, 0x00, 0x00, 0x51, 0x00, 0x51		 //tile:4 
, 0x00, 0x00, 0x00, 0x00, 0x00, 0x00, 0x00, 0x00, 0x00, 0x00, 0x51, 0x51, 0x00, 0x00, 0x00, 0x00, 0x51, 0x00, 0x49, 0x00, 0x00, 0x51, 0x00, 0x00, 0x49, 0x00, 0x00, 0x51, 0x00, 0x00, 0x00, 0x49, 0x00, 0x00, 0x51, 0x00, 0x00, 0x49, 0x00, 0x00, 0x51, 0x51, 0x00, 0x00, 0x49, 0x00, 0x00, 0x00		 //tile:5 
, 0x51, 0x51, 0x51, 0x00, 0x00, 0x00, 0x00, 0x00, 0x00, 0x51, 0x51, 0x00, 0x00, 0x00, 0x00, 0x00, 0x51, 0x00, 0x00, 0x00, 0x00, 0x00, 0x00, 0x51, 0x00, 0x00, 0x00, 0x00, 0x00, 0x51, 0x00, 0x00, 0x00, 0x00, 0x51, 0x00, 0x00, 0x00, 0x00, 0x51, 0x51, 0x00, 0x51, 0x51, 0x51, 0x00, 0x00, 0x00		 //tile:6 
, 0x00, 0x00, 0x00, 0x00, 0x00, 0x00, 0x00, 0x00, 0x00, 0x00, 0x00, 0x00, 0x00, 0x00, 0x00, 0x00, 0x00, 0x00, 0x00, 0x00, 0x51, 0x51, 0x51, 0x00, 0x00, 0x00, 0x51, 0x00, 0x51, 0x00, 0x00, 0x51, 0x00, 0x00, 0x51, 0x00, 0x00, 0x51, 0x00, 0x51, 0x00, 0x00, 0x51, 0x00, 0x00, 0x51, 0x00, 0x51		 //tile:7 
, 0x00, 0x49, 0x00, 0x49, 0x00, 0x00, 0x00, 0x49, 0x00, 0x49, 0x00, 0x00, 0x00, 0x49, 0x00, 0x49, 0x00, 0x00, 0x00, 0x49, 0x49, 0x49, 0x00, 0x00, 0x00, 0x00, 0x00, 0x00, 0x00, 0x00, 0x00, 0x49, 0x49, 0x49, 0x00, 0x00, 0x00, 0x00, 0x00, 0x00, 0x00, 0x00, 0x00, 0x51, 0x51, 0x51, 0x51, 0x51		 //tile:8 
, 0x00, 0x00, 0x00, 0x51, 0x00, 0x00, 0x00, 0x00, 0x00, 0x51, 0x00, 0x00, 0x00, 0x00, 0x00, 0x51, 0x00, 0x00, 0x00, 0x00, 0x00, 0x51, 0x00, 0x00, 0x00, 0x00, 0x00, 0x51, 0x00, 0x00, 0x00, 0x00, 0x00, 0x51, 0x00, 0x00, 0x00, 0x00, 0x00, 0x51, 0x00, 0x00, 0x51, 0x51, 0x51, 0x51, 0x00, 0x00		 //tile:9 
, 0x51, 0x00, 0x00, 0x49, 0x49, 0x00, 0x00, 0x51, 0x00, 0x00, 0x00, 0x49, 0x00, 0x00, 0x51, 0x51, 0x00, 0x00, 0x00, 0x00, 0x00, 0x00, 0x51, 0x51, 0x00, 0x00, 0x00, 0x00, 0x00, 0x51, 0x00, 0x00, 0x00, 0x00, 0x00, 0x51, 0x00, 0x00, 0x00, 0x00, 0x00, 0x51, 0x00, 0x00, 0x00, 0x00, 0x00, 0x51		 //tile:10 
, 0x00, 0x00, 0x00, 0x00, 0x51, 0x51, 0x00, 0x51, 0x51, 0x51, 0x00, 0x00, 0x00, 0x51, 0x00, 0x00, 0x00, 0x51, 0x00, 0x51, 0x51, 0x51, 0x51, 0x00, 0x00, 0x00, 0x00, 0x00, 0x00, 0x00, 0x00, 0x51, 0x51, 0x51, 0x00, 0x51, 0x00, 0x51, 0x00, 0x51, 0x00, 0x51, 0x00, 0x51, 0x00, 0x51, 0x51, 0x51		 //tile:11 
, 0x00, 0x00, 0x51, 0x00, 0x00, 0x51, 0x00, 0x51, 0x00, 0x00, 0x51, 0x51, 0x51, 0x00, 0x00, 0x51, 0x00, 0x51, 0x00, 0x00, 0x00, 0x51, 0x00, 0x51, 0x00, 0x51, 0x00, 0x51, 0x00, 0x51, 0x51, 0x51, 0x00, 0x51, 0x00, 0x51, 0x00, 0x51, 0x00, 0x51, 0x00, 0x51, 0x00, 0x51, 0x51, 0x51, 0x00, 0x51		 //tile:12 
, 0x00, 0x51, 0x00, 0x00, 0x00, 0x00, 0x00, 0x51, 0x00, 0x00, 0x00, 0x00, 0x00, 0x51, 0x00, 0x00, 0x00, 0x00, 0x00, 0x51, 0x00, 0x00, 0x00, 0x00, 0x00, 0x51, 0x00, 0x00, 0x00, 0x00, 0x00, 0x51, 0x00, 0x00, 0x00, 0x00, 0x00, 0x51, 0x00, 0x00, 0x00, 0x00, 0x00, 0x51, 0x00, 0x00, 0x00, 0x00		 //tile:13 
, 0x00, 0x00, 0x00, 0x00, 0x00, 0x00, 0x00, 0x51, 0x51, 0x51, 0x51, 0x51, 0x00, 0x51, 0x00, 0x00, 0x00, 0x51, 0x00, 0x51, 0x51, 0x51, 0x51, 0x51, 0x00, 0x00, 0x00, 0x51, 0x00, 0x51, 0x00, 0x00, 0x00, 0x51, 0x00, 0x51, 0x00, 0x00, 0x00, 0x51, 0x00, 0x51, 0x00, 0x00, 0x00, 0x51, 0x00, 0x51		 //tile:14 
, 0x00, 0x00, 0x00, 0x00, 0x00, 0x00, 0x00, 0x00, 0x00, 0x00, 0x00, 0x51, 0x00, 0x00, 0x00, 0x00, 0x00, 0x51, 0x00, 0x00, 0x00, 0x00, 0x00, 0x51, 0x00, 0x00, 0x00, 0x00, 0x00, 0x51, 0x00, 0x00, 0x00, 0x00, 0x00, 0x51, 0x00, 0x00, 0x00, 0x00, 0x00, 0x51, 0x00, 0x00, 0x00, 0x00, 0x00, 0x51		 //tile:15 
, 0x00, 0x51, 0x00, 0x00, 0x00, 0x00, 0x51, 0x51, 0x51, 0x51, 0x00, 0x00, 0x00, 0x00, 0x00, 0x51, 0x00, 0x00, 0x51, 0x51, 0x51, 0x51, 0x00, 0x00, 0x00, 0x00, 0x00, 0x00, 0x00, 0x51, 0x51, 0x51, 0x51, 0x51, 0x00, 0x51, 0x00, 0x00, 0x00, 0x00, 0x00, 0x51, 0x00, 0x00, 0x00, 0x00, 0x00, 0x00		 //tile:16 
, 0x00, 0x00, 0x00, 0x00, 0x00, 0x51, 0x00, 0x00, 0x00, 0x00, 0x00, 0x51, 0x00, 0x00, 0x00, 0x00, 0x00, 0x51, 0x00, 0x00, 0x00, 0x00, 0x00, 0x51, 0x00, 0x00, 0x00, 0x00, 0x00, 0x51, 0x00, 0x00, 0x00, 0x00, 0x00, 0x51, 0x51, 0x51, 0x51, 0x51, 0x51, 0x51, 0x00, 0x00, 0x00, 0x00, 0x00, 0x51		 //tile:17 
, 0x00, 0x51, 0x00, 0x00, 0x00, 0x00, 0x00, 0x51, 0x00, 0x00, 0x00, 0x00, 0x00, 0x51, 0x00, 0x00, 0x00, 0x00, 0x00, 0x51, 0x00, 0x00, 0x00, 0x00, 0x00, 0x51, 0x00, 0x00, 0x00, 0x00, 0x00, 0x51, 0x00, 0x00, 0x00, 0x00, 0x00, 0x51, 0x00, 0x00, 0x00, 0x00, 0x00, 0x51, 0x51, 0x51, 0x51, 0x51		 //tile:18 
, 0x00, 0x00, 0x00, 0x51, 0x00, 0x51, 0x00, 0x00, 0x00, 0x51, 0x00, 0x51, 0x00, 0x00, 0x00, 0x51, 0x00, 0x00, 0x00, 0x00, 0x00, 0x51, 0x00, 0x49, 0x00, 0x00, 0x00, 0x51, 0x00, 0x49, 0x00, 0x00, 0x00, 0x51, 0x00, 0x49, 0x00, 0x00, 0x00, 0x51, 0x00, 0x00, 0x51, 0x51, 0x51, 0x51, 0x00, 0x00		 //tile:19 
, 0x00, 0x00, 0x00, 0x00, 0x00, 0x51, 0x51, 0x51, 0x51, 0x51, 0x51, 0x51, 0x00, 0x00, 0x00, 0x00, 0x00, 0x00, 0x00, 0x49, 0x00, 0x49, 0x49, 0x49, 0x00, 0x49, 0x00, 0x49, 0x00, 0x00, 0x49, 0x49, 0x00, 0x49, 0x49, 0x49, 0x00, 0x00, 0x00, 0x00, 0x00, 0x00, 0x00, 0x00, 0x00, 0x00, 0x00, 0x00		 //tile:20 
, 0x00, 0x00, 0x00, 0x00, 0x00, 0x00, 0x00, 0x00, 0x00, 0x00, 0x00, 0x00, 0x00, 0x00, 0x00, 0x00, 0x00, 0x51, 0x00, 0x00, 0x00, 0x00, 0x00, 0x00, 0x00, 0x00, 0x00, 0x00, 0x00, 0x00, 0x00, 0x00, 0x00, 0x00, 0x00, 0x51, 0x00, 0x00, 0x00, 0x00, 0x00, 0x00, 0x00, 0x00, 0x00, 0x00, 0x00, 0x00		 //tile:21 
, 0x00, 0x00, 0x00, 0x00, 0x00, 0x51, 0x00, 0x00, 0x00, 0x00, 0x00, 0x51, 0x51, 0x51, 0x51, 0x51, 0x51, 0x51, 0x00, 0x00, 0x00, 0x00, 0x00, 0x51, 0x00, 0x00, 0x00, 0x00, 0x00, 0x51, 0x51, 0x51, 0x51, 0x51, 0x51, 0x51, 0x00, 0x00, 0x00, 0x00, 0x00, 0x00, 0x00, 0x00, 0x00, 0x00, 0x00, 0x00		 //tile:22 
, 0x5b, 0x5b, 0x5b, 0x5b, 0x5b, 0x5b, 0x00, 0x00, 0x00, 0x00, 0x00, 0x00, 0x00, 0x00, 0x00, 0x00, 0x00, 0x00, 0x00, 0x00, 0x00, 0x00, 0x00, 0x00, 0x00, 0x00, 0x00, 0x00, 0x00, 0x00, 0x00, 0x00, 0x00, 0x00, 0x00, 0x00, 0x00, 0x00, 0x00, 0x00, 0x00, 0x00, 0x00, 0x00, 0x00, 0x00, 0x00, 0x00		 //tile:23 
, 0x5b, 0x5b, 0x5b, 0x5b, 0x5b, 0x5b, 0x00, 0x00, 0x00, 0x00, 0x00, 0x00, 0x00, 0x00, 0x00, 0x00, 0x00, 0x00, 0x00, 0x00, 0x00, 0x00, 0x00, 0x00, 0x00, 0x00, 0x00, 0x00, 0x00, 0x00, 0x00, 0x00, 0x00, 0x00, 0x00, 0x00, 0x00, 0x00, 0x00, 0x00, 0x00, 0x5b, 0x00, 0x00, 0x00, 0x5b, 0xf6, 0xff		 //tile:24 
, 0x5b, 0x5b, 0x5b, 0x5b, 0x5b, 0x5b, 0x00, 0x00, 0x00, 0x00, 0x00, 0x00, 0x00, 0x00, 0x00, 0x00, 0x00, 0x00, 0x00, 0x00, 0x00, 0x00, 0x00, 0x09, 0x00, 0x00, 0x00, 0x49, 0xad, 0xff, 0x00, 0x52, 0xad, 0xff, 0xff, 0xfe, 0xf6, 0xff, 0xff, 0xfe, 0xfe, 0xff, 0xf6, 0xf6, 0xf6, 0xf6, 0xf6, 0xfe		 //tile:25 
, 0x5b, 0x5b, 0x5b, 0x5b, 0x5b, 0x5b, 0x00, 0x00, 0x00, 0x09, 0x5b, 0x09, 0x00, 0x09, 0xad, 0xff, 0x6d, 0x13, 0xad, 0xff, 0xff, 0xad, 0x1c, 0x00, 0xff, 0xff, 0xad, 0x1d, 0x01, 0x00, 0xff, 0xb6, 0x1d, 0x0a, 0x00, 0x00, 0xf6, 0x5c, 0x0a, 0x00, 0x00, 0x00, 0x65, 0x13, 0x00, 0x00, 0x00, 0x00		 //tile:26 
, 0x00, 0x00, 0x00, 0x00, 0x00, 0x00, 0x00, 0x00, 0x00, 0x00, 0x00, 0x00, 0x00, 0x00, 0x00, 0x00, 0x00, 0x00, 0x00, 0x00, 0x00, 0x00, 0x00, 0x09, 0x00, 0x00, 0x00, 0x00, 0x00, 0x52, 0x00, 0x00, 0x00, 0x00, 0x00, 0xa4, 0x00, 0x00, 0x00, 0x00, 0x00, 0xa4, 0x00, 0x00, 0x00, 0x00, 0x00, 0xa4		 //tile:27 
, 0x00, 0x00, 0x00, 0x00, 0x00, 0x00, 0x00, 0x00, 0x00, 0x00, 0x00, 0x00, 0x52, 0x52, 0x52, 0x53, 0x09, 0x00, 0xad, 0xad, 0xad, 0xb5, 0x5c, 0x00, 0xa4, 0x5b, 0xa4, 0xa3, 0x5c, 0x01, 0xa4, 0xa4, 0xa4, 0xa3, 0x1c, 0x00, 0xa4, 0xa4, 0xad, 0x64, 0x13, 0x00, 0xa4, 0xa4, 0xa4, 0x5c, 0x0a, 0x00		 //tile:28 
, 0x00, 0x00, 0x00, 0x00, 0x00, 0x00, 0x00, 0x00, 0x00, 0x00, 0x00, 0x00, 0x00, 0x00, 0x00, 0x00, 0x00, 0x00, 0x00, 0x00, 0x00, 0x00, 0x00, 0x09, 0x00, 0x00, 0x00, 0x00, 0x00, 0x52, 0x00, 0x00, 0x00, 0x00, 0x00, 0xa4, 0x00, 0x00, 0x00, 0x00, 0x00, 0xad, 0x00, 0x00, 0x00, 0x00, 0x00, 0xad		 //tile:29 
, 0x00, 0x00, 0x00, 0x00, 0x00, 0x00, 0x00, 0x00, 0x00, 0x00, 0x00, 0x00, 0x52, 0x52, 0x52, 0x52, 0x00, 0x00, 0xf6, 0xf6, 0xf6, 0xf6, 0x5b, 0x00, 0xad, 0xa4, 0xac, 0xa4, 0x1c, 0x00, 0xad, 0xad, 0xad, 0xa4, 0x13, 0x00, 0xb6, 0xad, 0xb6, 0x64, 0x0a, 0x00, 0xa4, 0xa4, 0xac, 0x5b, 0xad, 0xb5		 //tile:30 
, 0x00, 0x00, 0x00, 0x00, 0x00, 0x00, 0x00, 0x00, 0x00, 0x00, 0x00, 0x00, 0x00, 0x00, 0x00, 0x00, 0x00, 0x00, 0x00, 0x00, 0x00, 0x00, 0x00, 0x00, 0x00, 0x00, 0x00, 0x00, 0x5b, 0xb6, 0x00, 0x00, 0x9b, 0xf6, 0xf6, 0xad, 0xa4, 0xf6, 0xf6, 0xad, 0xad, 0xad, 0xb5, 0xad, 0xad, 0xad, 0xa4, 0x5c		 //tile:31 
, 0x00, 0x00, 0x00, 0x00, 0x00, 0x00, 0x00, 0x00, 0x00, 0x00, 0x09, 0xa4, 0x00, 0x00, 0x52, 0xad, 0xf6, 0xf6, 0x5a, 0xad, 0xff, 0xf6, 0xad, 0xad, 0xf6, 0xad, 0xad, 0xad, 0xad, 0xad, 0xad, 0xad, 0xad, 0xad, 0xad, 0xad, 0xac, 0x5b, 0xa4, 0xad, 0xad, 0xad, 0x13, 0x5d, 0xf6, 0xad, 0xad, 0xad		 //tile:32 
, 0x00, 0x5b, 0xf6, 0xf6, 0xf6, 0xb6, 0xf6, 0xf6, 0xad, 0xad, 0xad, 0xb6, 0xb6, 0xb6, 0xb6, 0xb6, 0xb6, 0xb6, 0xb6, 0xb6, 0xb6, 0xb6, 0xb6, 0xb6, 0xad, 0xad, 0xad, 0xad, 0xad, 0xad, 0xad, 0xad, 0xad, 0xad, 0xad, 0xad, 0xad, 0xad, 0xad, 0xad, 0xad, 0xf6, 0xad, 0xad, 0xad, 0xb6, 0xf6, 0xf5		 //tile:33 
, 0xb6, 0xb6, 0xb6, 0xf6, 0xf6, 0xa4, 0xb6, 0xb6, 0xf6, 0xf6, 0xad, 0x1c, 0xf6, 0xf6, 0xf6, 0xf5, 0x1c, 0x01, 0xf6, 0xf6, 0xf6, 0x5c, 0x0b, 0x00, 0xb5, 0xf6, 0x5c, 0x13, 0x00, 0x00, 0xf6, 0xa4, 0x14, 0x00, 0x00, 0x00, 0xad, 0x1c, 0x01, 0x00, 0x00, 0x00, 0x5c, 0x0a, 0x00, 0x00, 0x00, 0x52		 //tile:34 
, 0x14, 0x00, 0x00, 0x00, 0x00, 0x00, 0x00, 0x00, 0x00, 0x00, 0x00, 0x00, 0x00, 0x51, 0x49, 0x49, 0x51, 0x52, 0x5b, 0xff, 0xff, 0xff, 0xff, 0xff, 0xad, 0xf6, 0xf6, 0xf6, 0xf6, 0xf6, 0xb5, 0xf6, 0xf6, 0xf6, 0xf6, 0xf6, 0xf6, 0xf6, 0xf6, 0xf6, 0x64, 0x5c, 0xff, 0xf6, 0xf6, 0xf6, 0x13, 0x01		 //tile:35 
, 0x00, 0x00, 0x00, 0x00, 0x00, 0x00, 0x00, 0x00, 0x00, 0x00, 0x00, 0x00, 0x52, 0x52, 0x52, 0x52, 0x52, 0x52, 0xff, 0xff, 0xff, 0xff, 0xff, 0xff, 0xfe, 0xff, 0xff, 0xff, 0xff, 0xff, 0xf6, 0xfe, 0xfe, 0xff, 0xff, 0xff, 0x5c, 0x5c, 0x5c, 0x64, 0x64, 0x64, 0x00, 0x00, 0x00, 0x00, 0x00, 0x00		 //tile:36 
, 0x00, 0x00, 0x00, 0x00, 0x00, 0x00, 0x00, 0x00, 0x00, 0x00, 0x00, 0x00, 0x52, 0x52, 0x52, 0x52, 0x52, 0x00, 0xff, 0xff, 0xff, 0xff, 0xff, 0x09, 0xff, 0xff, 0xff, 0xff, 0xae, 0x13, 0xff, 0xff, 0xff, 0xff, 0x65, 0x01, 0x64, 0x64, 0x65, 0x65, 0x1c, 0x00, 0x01, 0x01, 0x01, 0x01, 0x01, 0x00		 //tile:37 
, 0x00, 0x00, 0x00, 0x00, 0x00, 0x00, 0x00, 0x00, 0x00, 0x00, 0x00, 0x00, 0x00, 0x00, 0x52, 0x52, 0x52, 0x52, 0x00, 0x00, 0xff, 0xff, 0xff, 0xff, 0x00, 0x52, 0xff, 0xf6, 0xf6, 0xf6, 0x00, 0xa4, 0xff, 0xf6, 0xf6, 0xf6, 0x00, 0xad, 0xf6, 0xf6, 0xf6, 0xad, 0x00, 0xb5, 0xb6, 0xb5, 0xb5, 0x5c		 //tile:38 
, 0x00, 0x00, 0x00, 0x00, 0x00, 0x00, 0x00, 0x00, 0x00, 0x00, 0x00, 0x00, 0x52, 0x52, 0x52, 0x52, 0x52, 0x52, 0xff, 0xff, 0xff, 0xff, 0xff, 0xff, 0xf6, 0xf6, 0xf6, 0xf6, 0xf6, 0xf6, 0xf6, 0xf6, 0xf6, 0xf5, 0xad, 0xad, 0x5b, 0x5c, 0x5c, 0x5c, 0x5c, 0x5c, 0x02, 0x00, 0x00, 0x00, 0x00, 0x00		 //tile:39 
, 0x00, 0x00, 0x00, 0x00, 0x00, 0x00, 0x00, 0x00, 0x00, 0x00, 0x00, 0x00, 0x52, 0x52, 0x52, 0x52, 0x00, 0x00, 0xff, 0xff, 0xff, 0xff, 0xad, 0x00, 0xf6, 0xf6, 0xf6, 0xf6, 0xf6, 0xad, 0xad, 0xad, 0xad, 0xad, 0xad, 0xad, 0x5c, 0xad, 0xad, 0xad, 0xad, 0x64, 0x09, 0xad, 0xad, 0xad, 0xad, 0x5b		 //tile:40 
, 0x00, 0x00, 0x00, 0x00, 0x00, 0x00, 0x00, 0x00, 0x00, 0x00, 0x00, 0x00, 0x00, 0x00, 0x00, 0x09, 0x52, 0x52, 0x00, 0x00, 0x00, 0xad, 0xff, 0xf6, 0x00, 0x00, 0x00, 0xad, 0xad, 0xad, 0x13, 0x00, 0x00, 0xad, 0xad, 0xac, 0x0a, 0x00, 0x52, 0xad, 0xa4, 0xa4, 0x01, 0x00, 0x5b, 0xad, 0xa4, 0xa4		 //tile:41 
, 0x00, 0x00, 0x00, 0x00, 0x00, 0x00, 0x00, 0x00, 0x00, 0x00, 0x00, 0x00, 0x52, 0x52, 0x52, 0x52, 0x52, 0x52, 0xf6, 0xf6, 0xf6, 0xf6, 0xf6, 0xb6, 0xad, 0xad, 0xad, 0xad, 0xa4, 0xa4, 0xa4, 0xa4, 0xa4, 0xa4, 0xa4, 0xa4, 0xa4, 0x5b, 0x5b, 0x5b, 0x5b, 0x5b, 0xa4, 0x13, 0x01, 0x01, 0x01, 0x01		 //tile:42 
, 0x00, 0x00, 0x00, 0x00, 0x00, 0x00, 0x00, 0x00, 0x00, 0x00, 0x00, 0x00, 0x52, 0x52, 0x52, 0x52, 0x52, 0x52, 0xad, 0xad, 0xad, 0xad, 0xad, 0xad, 0xa4, 0xa4, 0xa4, 0xa4, 0xa4, 0xa4, 0xa4, 0xa4, 0xa4, 0xa4, 0xa4, 0xa4, 0x5b, 0x53, 0x5b, 0xa4, 0x9b, 0x9b, 0x01, 0x01, 0xa4, 0xa4, 0xa4, 0xa4		 //tile:43 
, 0x00, 0x00, 0x00, 0x00, 0x00, 0x00, 0x00, 0x00, 0x00, 0x00, 0x00, 0x00, 0x52, 0x52, 0x00, 0x00, 0x09, 0x52, 0xad, 0xa4, 0x0a, 0x00, 0x5b, 0xad, 0xa4, 0x5b, 0x0a, 0x00, 0x5b, 0x5b, 0xa4, 0x5c, 0x01, 0x00, 0x49, 0xa4, 0x5b, 0x1c, 0x00, 0x00, 0x00, 0x5b, 0x5b, 0x13, 0x00, 0x00, 0x00, 0x09		 //tile:44 
, 0x00, 0x00, 0x00, 0x00, 0x00, 0x00, 0x00, 0x00, 0x00, 0x00, 0x00, 0x00, 0x52, 0x52, 0x52, 0x00, 0x00, 0x00, 0xad, 0xad, 0xad, 0x52, 0x00, 0x00, 0x5b, 0x5b, 0x5b, 0x5b, 0x09, 0x00, 0x5b, 0x5b, 0x5b, 0x5b, 0x52, 0x00, 0x9b, 0x5b, 0x5b, 0x5b, 0x5b, 0x09, 0x9b, 0x5b, 0x5b, 0x5b, 0x5b, 0x5b		 //tile:45 
, 0x00, 0x00, 0x00, 0x00, 0x00, 0x00, 0x00, 0x00, 0x00, 0x00, 0x00, 0x00, 0x00, 0x00, 0x00, 0x00, 0x52, 0x52, 0x00, 0x00, 0x00, 0x52, 0xad, 0xa4, 0x00, 0x00, 0x52, 0xad, 0x52, 0x52, 0x00, 0x52, 0xad, 0x52, 0x5a, 0x5a, 0x52, 0xad, 0x52, 0x5a, 0x5b, 0x5a, 0xa4, 0x5b, 0x5a, 0x5a, 0x5a, 0x52		 //tile:46 
, 0x00, 0x00, 0x00, 0x00, 0x00, 0x00, 0x00, 0x00, 0x00, 0x00, 0x00, 0x00, 0x52, 0x52, 0x52, 0x00, 0x00, 0x00, 0xa4, 0xa4, 0x5b, 0x0a, 0x00, 0x00, 0x52, 0x52, 0x52, 0x14, 0x00, 0x00, 0x52, 0x52, 0x1c, 0x0a, 0x00, 0x00, 0x52, 0x1c, 0x14, 0x00, 0x00, 0x00, 0x1d, 0x13, 0x00, 0x00, 0x00, 0x00		 //tile:47 
, 0x00, 0x00, 0x00, 0x00, 0x49, 0xa4, 0x00, 0x00, 0x00, 0x00, 0x52, 0xad, 0x00, 0x00, 0x00, 0x00, 0x5b, 0xa4, 0x00, 0x00, 0x00, 0x00, 0xa4, 0xa4, 0x00, 0x00, 0x00, 0x09, 0xad, 0xa4, 0x00, 0x00, 0x00, 0x49, 0xa4, 0x5b, 0x00, 0x00, 0x00, 0x5b, 0xa4, 0x9b, 0x00, 0x00, 0x00, 0xa4, 0xa4, 0xa4		 //tile:48 
, 0x5b, 0xa4, 0xa3, 0x5c, 0x09, 0x00, 0xa4, 0xa4, 0xa4, 0x13, 0x00, 0x00, 0x5b, 0x9b, 0x5b, 0x13, 0x00, 0x00, 0xa4, 0xa4, 0x5b, 0x13, 0x00, 0x00, 0xa4, 0xa4, 0x5b, 0x0a, 0x00, 0x00, 0xa4, 0xa3, 0x13, 0x00, 0x00, 0x00, 0xa4, 0x5b, 0x13, 0x00, 0x00, 0x00, 0xa4, 0xa4, 0xa5, 0x9b, 0x9b, 0x9b		 //tile:49 
, 0x00, 0x00, 0x00, 0x00, 0x52, 0xad, 0x00, 0x00, 0x00, 0x00, 0x5b, 0xad, 0x00, 0x00, 0x00, 0x00, 0x5b, 0xa4, 0x00, 0x00, 0x00, 0x00, 0xa4, 0xa4, 0x00, 0x00, 0x00, 0x09, 0xad, 0xad, 0x00, 0x00, 0x00, 0x52, 0xad, 0xa4, 0x00, 0x00, 0x00, 0x5b, 0xad, 0xad, 0x9b, 0x9b, 0xa4, 0xad, 0xad, 0xad		 //tile:50 
, 0xa4, 0xa4, 0xa4, 0xad, 0xad, 0xad, 0xad, 0xad, 0xad, 0xad, 0xad, 0xad, 0xa4, 0xa4, 0xa4, 0xa3, 0x5b, 0x1c, 0xa4, 0xa4, 0x5b, 0x13, 0x14, 0x0a, 0xad, 0xad, 0x5c, 0x0b, 0x00, 0x00, 0xa4, 0xa4, 0x13, 0x00, 0x00, 0x00, 0xad, 0xa4, 0x13, 0x00, 0x00, 0x00, 0xad, 0x64, 0x0a, 0x00, 0x00, 0x00		 //tile:51 
, 0xad, 0xad, 0xa4, 0x5c, 0x14, 0x0a, 0xa4, 0x5c, 0x1c, 0x0a, 0x00, 0x00, 0x14, 0x0a, 0x00, 0x00, 0x00, 0x9b, 0x00, 0x00, 0x00, 0x00, 0x52, 0xf6, 0x00, 0x00, 0x00, 0x09, 0xf6, 0xad, 0x00, 0x00, 0x00, 0xad, 0xad, 0xa4, 0x00, 0x00, 0xa4, 0xf6, 0xad, 0xad, 0x00, 0x5b, 0xb6, 0xa4, 0xa4, 0xa4		 //tile:52 
, 0x0a, 0xf6, 0xad, 0xad, 0xad, 0xad, 0xad, 0xad, 0xad, 0xad, 0xad, 0xad, 0xad, 0xad, 0xad, 0xad, 0xad, 0xad, 0xa4, 0xad, 0xac, 0xad, 0xad, 0xad, 0xad, 0xad, 0xad, 0xad, 0xad, 0xad, 0xa4, 0xa4, 0xa4, 0xa4, 0xa4, 0xa4, 0xad, 0xad, 0xad, 0xad, 0xad, 0xad, 0xa4, 0xa4, 0xa4, 0xa4, 0xad, 0xa4		 //tile:53 
, 0xad, 0xad, 0xb6, 0xb6, 0xf6, 0x5c, 0xad, 0xad, 0xad, 0xb5, 0xa4, 0x14, 0xad, 0xad, 0xb6, 0xac, 0x14, 0x01, 0xad, 0xad, 0xad, 0x1c, 0x0a, 0x00, 0xad, 0xad, 0x5c, 0x0b, 0x00, 0x00, 0xad, 0x5b, 0x14, 0x00, 0x00, 0x00, 0xa4, 0x13, 0x00, 0x00, 0x51, 0xad, 0x13, 0x0a, 0x52, 0xad, 0xf6, 0xf6		 //tile:54 
, 0x13, 0x00, 0x00, 0x00, 0x00, 0xa4, 0x00, 0x00, 0x00, 0x00, 0x00, 0xad, 0x00, 0x00, 0x00, 0x00, 0x00, 0xf6, 0x00, 0x00, 0x00, 0x00, 0x52, 0xff, 0x00, 0x00, 0x00, 0xa4, 0xf6, 0xf6, 0x09, 0xad, 0xf6, 0xf6, 0xf6, 0xb6, 0xff, 0xf6, 0xf6, 0xf6, 0xf6, 0xf6, 0xb6, 0xf6, 0xad, 0xad, 0xf6, 0xf6		 //tile:55 
, 0xff, 0xf6, 0xf6, 0xad, 0x0a, 0x00, 0xf6, 0xf6, 0xf6, 0xad, 0xad, 0xad, 0xf6, 0xf6, 0xf6, 0xf6, 0xf6, 0xf6, 0xf6, 0xf6, 0xf6, 0xf6, 0xfe, 0xfe, 0xf6, 0xf6, 0xf6, 0xad, 0xad, 0xad, 0xf6, 0xf6, 0xad, 0x0b, 0x0a, 0x0a, 0xf6, 0xf6, 0xa5, 0x01, 0x00, 0x00, 0xf6, 0xf6, 0xad, 0x64, 0x5b, 0x5b		 //tile:56 
, 0x00, 0x00, 0x00, 0x00, 0x00, 0x00, 0xad, 0xad, 0xad, 0xad, 0xad, 0x5b, 0xf6, 0xfe, 0xff, 0xff, 0xff, 0x64, 0xff, 0xff, 0xff, 0xff, 0xff, 0x5c, 0xad, 0xad, 0xad, 0xad, 0xad, 0x1c, 0x0a, 0x0b, 0x0b, 0x13, 0x13, 0x0a, 0x00, 0x00, 0x00, 0x00, 0x00, 0x00, 0x5b, 0x5b, 0x5b, 0x9b, 0xa3, 0xa4		 //tile:57 
, 0x00, 0x00, 0x00, 0x00, 0x00, 0x00, 0x00, 0x00, 0x00, 0x00, 0x00, 0x00, 0x01, 0x00, 0x00, 0x00, 0x00, 0x00, 0x00, 0x00, 0x00, 0x00, 0x00, 0x00, 0x00, 0x00, 0x00, 0x00, 0x00, 0x00, 0x00, 0x00, 0x00, 0x00, 0x00, 0x52, 0x00, 0x00, 0x00, 0x00, 0x00, 0x5b, 0xa4, 0xa4, 0x00, 0x00, 0x00, 0xad		 //tile:58 
, 0x09, 0xff, 0xf6, 0xf6, 0xf6, 0x5c, 0x5b, 0xff, 0xf6, 0xf6, 0xb6, 0xad, 0xa4, 0xff, 0xf6, 0xf6, 0xb6, 0xf6, 0xad, 0xf6, 0xb6, 0xb6, 0xb6, 0xb6, 0xff, 0xf6, 0xf6, 0xf6, 0xad, 0xa4, 0xff, 0xf6, 0xf6, 0xf6, 0x13, 0x0b, 0xff, 0xf6, 0xf6, 0xad, 0x0b, 0x00, 0xff, 0xf6, 0xf6, 0xb6, 0xa5, 0x5b		 //tile:59 
, 0x00, 0x00, 0x00, 0x00, 0x00, 0x00, 0xad, 0xa4, 0xa4, 0xa4, 0xa4, 0xa4, 0xf6, 0xf6, 0xb6, 0xb6, 0xb6, 0xb6, 0xb5, 0xad, 0xad, 0xad, 0xad, 0xad, 0xa4, 0xa4, 0xa4, 0xa4, 0xa4, 0xa4, 0x0a, 0x0a, 0x0a, 0x0a, 0x0a, 0x64, 0x00, 0x00, 0x00, 0x00, 0x00, 0x5b, 0x5b, 0x5b, 0x5b, 0x5b, 0x5b, 0xb6		 //tile:60 
, 0x49, 0xb6, 0xad, 0xad, 0xa4, 0x1c, 0xad, 0xad, 0xad, 0x5b, 0x1c, 0x0a, 0xad, 0xad, 0x5b, 0x13, 0x00, 0x00, 0xad, 0xad, 0xad, 0x00, 0x00, 0x00, 0xad, 0xad, 0xb5, 0xad, 0x00, 0x00, 0xf6, 0xad, 0xad, 0xad, 0x12, 0x00, 0xb6, 0xad, 0xad, 0xa4, 0x13, 0x00, 0xf6, 0xf6, 0xf6, 0xa5, 0x0a, 0x00		 //tile:61 
, 0x00, 0x00, 0xa4, 0xad, 0xa4, 0xa4, 0x00, 0x00, 0xad, 0xa4, 0xa4, 0xa4, 0x00, 0x09, 0xb6, 0xad, 0xad, 0xad, 0x00, 0x52, 0xb5, 0xad, 0xad, 0xad, 0x00, 0x5b, 0xad, 0xad, 0xad, 0xa4, 0x00, 0xad, 0xad, 0xad, 0xad, 0x64, 0x00, 0xad, 0xad, 0xad, 0xad, 0x5b, 0x49, 0xad, 0xad, 0xad, 0xa4, 0xa5		 //tile:62 
, 0x64, 0x13, 0x00, 0x00, 0x00, 0x00, 0x5c, 0x0a, 0x00, 0x00, 0x00, 0x00, 0x5b, 0x01, 0x00, 0x00, 0x00, 0x00, 0x13, 0x00, 0x00, 0x00, 0x00, 0x00, 0x13, 0x00, 0x00, 0x00, 0x00, 0x00, 0x0a, 0x00, 0x00, 0x00, 0x00, 0x00, 0x01, 0x00, 0x00, 0x00, 0x00, 0x00, 0x64, 0x5b, 0x5b, 0x5b, 0x5b, 0x5b		 //tile:63 
, 0x00, 0x00, 0xa4, 0xa3, 0x5b, 0x5b, 0x00, 0x00, 0xa4, 0xa4, 0x9b, 0x9b, 0x00, 0x52, 0xad, 0xa4, 0xa4, 0xa3, 0x00, 0x5b, 0xad, 0xa4, 0xad, 0xa4, 0x00, 0x5b, 0xa4, 0xa4, 0xa4, 0x5b, 0x00, 0xa4, 0xa4, 0xa4, 0xa3, 0x5b, 0x09, 0xad, 0xa4, 0xa4, 0xa4, 0x5b, 0xa4, 0xa4, 0x5b, 0x5b, 0x5b, 0x13		 //tile:64 
, 0x5b, 0x0a, 0x00, 0x00, 0x00, 0x00, 0x5c, 0x0a, 0x00, 0x00, 0x00, 0x00, 0x1b, 0x01, 0x00, 0x00, 0x00, 0x00, 0x13, 0x00, 0x00, 0x00, 0x00, 0x00, 0x13, 0x00, 0x00, 0x00, 0x00, 0x00, 0x0a, 0x00, 0x00, 0x00, 0x00, 0xa4, 0x01, 0x00, 0x00, 0x00, 0xad, 0xa4, 0x00, 0x00, 0x00, 0xad, 0xa4, 0x5b		 //tile:65 
, 0x49, 0x5b, 0x52, 0x52, 0x52, 0x52, 0x00, 0x5b, 0x5b, 0x5b, 0x5b, 0x5b, 0x00, 0x09, 0x5b, 0x5b, 0x5b, 0x52, 0x00, 0x5b, 0xa4, 0x5b, 0x5b, 0x5b, 0xa4, 0xa4, 0x52, 0x52, 0x52, 0x52, 0xa4, 0x52, 0x52, 0x52, 0x52, 0x52, 0x5b, 0x5b, 0x5b, 0x5b, 0x5b, 0x5b, 0x5b, 0x5b, 0x5a, 0x13, 0x13, 0x5b		 //tile:66 
, 0x52, 0x52, 0x52, 0x52, 0x49, 0x1c, 0x5b, 0x5b, 0x5a, 0x52, 0x1d, 0x13, 0x52, 0x52, 0x52, 0x1d, 0x0a, 0x00, 0x5b, 0x5b, 0x5b, 0x09, 0x00, 0x00, 0x52, 0x52, 0x52, 0x00, 0x00, 0x00, 0x52, 0x52, 0x52, 0x52, 0x00, 0x00, 0x5b, 0x5b, 0x5b, 0x5b, 0x49, 0x00, 0x5b, 0x5b, 0x5b, 0x5b, 0x5b, 0x00		 //tile:67 
, 0x13, 0x00, 0x00, 0x00, 0x00, 0x00, 0x00, 0x00, 0x00, 0x00, 0x00, 0x00, 0x00, 0x00, 0x00, 0x00, 0x00, 0x00, 0x00, 0x00, 0x00, 0x00, 0x00, 0x00, 0x00, 0x00, 0x00, 0x00, 0x00, 0x00, 0x00, 0x00, 0x00, 0x00, 0x00, 0x00, 0x00, 0x00, 0x00, 0x00, 0x00, 0x00, 0x00, 0x00, 0x00, 0x00, 0x00, 0x00		 //tile:68 
, 0x00, 0x00, 0x00, 0xa4, 0xa4, 0xa4, 0x00, 0x00, 0x49, 0xa4, 0x5b, 0x9b, 0x00, 0x00, 0x49, 0xa3, 0x5b, 0x5b, 0x00, 0x00, 0x00, 0x1b, 0x1c, 0x1c, 0x00, 0x00, 0x00, 0x01, 0x01, 0x01, 0x00, 0x00, 0x00, 0x00, 0x00, 0x00, 0x00, 0x00, 0x00, 0x00, 0x00, 0x00, 0x00, 0x00, 0x00, 0x00, 0x00, 0x00		 //tile:69 
, 0xa4, 0xa4, 0xa4, 0xad, 0xad, 0xad, 0xa3, 0x9b, 0x9b, 0xa4, 0xa4, 0xa4, 0x5b, 0x5b, 0x5b, 0x5b, 0x5b, 0x9b, 0x1b, 0x1b, 0x1b, 0x1b, 0x1b, 0x1b, 0x00, 0x00, 0x00, 0x00, 0x00, 0x00, 0x00, 0x00, 0x00, 0x00, 0x00, 0x00, 0x00, 0x00, 0x00, 0x00, 0x00, 0x00, 0x00, 0x00, 0x00, 0x00, 0x00, 0x00		 //tile:70 
, 0xad, 0xad, 0xad, 0xac, 0xa4, 0xac, 0xa4, 0xa4, 0xa4, 0xa4, 0xa4, 0xa4, 0x9b, 0x9b, 0xa3, 0xa4, 0xa4, 0xa4, 0x13, 0x13, 0x13, 0x13, 0x13, 0x13, 0x00, 0x00, 0x00, 0x00, 0x00, 0x00, 0x00, 0x00, 0x00, 0x00, 0x00, 0x00, 0x00, 0x00, 0x00, 0x00, 0x00, 0x00, 0x00, 0x00, 0x00, 0x00, 0x00, 0x00		 //tile:71 
, 0xad, 0x5c, 0x09, 0x00, 0x00, 0x00, 0xa4, 0x5c, 0x00, 0x00, 0x00, 0x00, 0xa3, 0x13, 0x00, 0x00, 0x00, 0xad, 0x13, 0x13, 0x00, 0x00, 0x5b, 0xad, 0x00, 0x00, 0x00, 0x52, 0xb6, 0xa4, 0x00, 0x00, 0x00, 0xf6, 0xad, 0xad, 0x00, 0x00, 0xad, 0xad, 0xa4, 0xa4, 0x00, 0x5b, 0xad, 0xa4, 0xa4, 0xa4		 //tile:72 
, 0x09, 0xf6, 0xad, 0xad, 0xad, 0xad, 0xad, 0xad, 0xac, 0xad, 0xad, 0xad, 0xad, 0xac, 0xad, 0xad, 0xad, 0xad, 0xa4, 0xac, 0xad, 0xad, 0xac, 0xad, 0xa4, 0xa4, 0xa4, 0xa4, 0xa4, 0xa4, 0xad, 0xad, 0xad, 0xad, 0xad, 0xad, 0xad, 0xad, 0xad, 0xad, 0xad, 0xac, 0xa4, 0xa4, 0xa4, 0xa4, 0x5b, 0x1c		 //tile:73 
, 0xad, 0xad, 0xad, 0xad, 0xad, 0x5b, 0xad, 0xad, 0xad, 0xad, 0xad, 0xad, 0xad, 0xad, 0xad, 0xad, 0xb6, 0xf6, 0xad, 0xad, 0xad, 0xad, 0xad, 0xad, 0xac, 0xad, 0xad, 0xad, 0xa4, 0x5c, 0xad, 0xad, 0xa4, 0x5c, 0x1c, 0x0b, 0x64, 0x5c, 0x14, 0x0a, 0x00, 0x00, 0x14, 0x0a, 0x00, 0x00, 0x00, 0x00		 //tile:74 
, 0x65, 0xb5, 0xfe, 0xf6, 0xf6, 0xf6, 0xf6, 0xb6, 0xb6, 0xf6, 0xad, 0x64, 0xf6, 0xf6, 0xb5, 0x65, 0x1c, 0x14, 0xa4, 0x5c, 0x1c, 0x13, 0x01, 0x00, 0x1c, 0x13, 0x01, 0x00, 0x00, 0x00, 0x00, 0x00, 0x00, 0x00, 0x00, 0x00, 0x00, 0x00, 0x00, 0x00, 0x00, 0x00, 0x00, 0x00, 0x00, 0x00, 0x00, 0x00		 //tile:75 
, 0xf6, 0xad, 0x1c, 0x5c, 0xf6, 0xf6, 0x1c, 0x14, 0x01, 0xa4, 0xff, 0xf6, 0x09, 0x00, 0x00, 0xad, 0xff, 0xf6, 0x00, 0x00, 0x00, 0x09, 0x1c, 0x1b, 0x00, 0x00, 0x00, 0x00, 0x00, 0x00, 0x00, 0x00, 0x00, 0x00, 0x00, 0x00, 0x00, 0x00, 0x00, 0x00, 0x00, 0x00, 0x00, 0x00, 0x00, 0x00, 0x00, 0x00		 //tile:76 
, 0xf6, 0xf6, 0xf6, 0xff, 0xff, 0xff, 0xf6, 0xf6, 0xf6, 0xf6, 0xf6, 0xf6, 0xf6, 0xf6, 0xf6, 0xf6, 0xf6, 0xf6, 0x13, 0x13, 0x13, 0x13, 0x13, 0x13, 0x00, 0x00, 0x00, 0x00, 0x00, 0x00, 0x00, 0x00, 0x00, 0x00, 0x00, 0x00, 0x00, 0x00, 0x00, 0x00, 0x00, 0x00, 0x00, 0x00, 0x00, 0x00, 0x00, 0x00		 //tile:77 
, 0xff, 0xff, 0xff, 0xff, 0xff, 0xff, 0xff, 0xff, 0xff, 0xff, 0xff, 0xff, 0xf6, 0xf6, 0xf6, 0xf6, 0xf6, 0xfe, 0x13, 0x1b, 0x1b, 0x1c, 0x1c, 0x1c, 0x00, 0x00, 0x00, 0x00, 0x00, 0x00, 0x00, 0x00, 0x00, 0x00, 0x00, 0x00, 0x00, 0x00, 0x00, 0x00, 0x00, 0x00, 0x00, 0x00, 0x00, 0x00, 0x00, 0x00		 //tile:78 
, 0xff, 0xff, 0x13, 0x00, 0x00, 0xfe, 0xff, 0xf6, 0x14, 0x00, 0x09, 0xff, 0xff, 0xad, 0x0a, 0x00, 0x49, 0xff, 0x1c, 0x1c, 0x09, 0x00, 0x00, 0x1c, 0x00, 0x00, 0x00, 0x00, 0x00, 0x00, 0x00, 0x00, 0x00, 0x00, 0x00, 0x00, 0x00, 0x00, 0x00, 0x00, 0x00, 0x00, 0x00, 0x00, 0x00, 0x00, 0x00, 0x00		 //tile:79 
, 0xf6, 0xf6, 0xf6, 0xf6, 0xf6, 0xff, 0xff, 0xff, 0xf6, 0xf6, 0xf6, 0xf6, 0xf6, 0xf6, 0xf6, 0xb5, 0xad, 0xad, 0x1c, 0x1b, 0x13, 0x13, 0x13, 0x13, 0x00, 0x00, 0x00, 0x00, 0x00, 0x00, 0x00, 0x00, 0x00, 0x00, 0x00, 0x00, 0x00, 0x00, 0x00, 0x00, 0x00, 0x00, 0x00, 0x00, 0x00, 0x00, 0x00, 0x00		 //tile:80 
, 0xff, 0xff, 0xff, 0xff, 0xff, 0xf6, 0xf6, 0xf6, 0xf6, 0xf6, 0xb6, 0xb6, 0xad, 0xad, 0xad, 0xad, 0xad, 0xad, 0x13, 0x13, 0x13, 0x13, 0x13, 0x13, 0x00, 0x00, 0x00, 0x00, 0x00, 0x00, 0x00, 0x00, 0x00, 0x00, 0x00, 0x00, 0x00, 0x00, 0x00, 0x00, 0x00, 0x00, 0x00, 0x00, 0x00, 0x00, 0x00, 0x00		 //tile:81 
, 0xf6, 0xf6, 0xf6, 0x64, 0x09, 0x00, 0xf6, 0xf5, 0xa4, 0x1c, 0x00, 0x00, 0xad, 0x5c, 0x1c, 0x0a, 0x00, 0x00, 0x1c, 0x14, 0x01, 0x00, 0x00, 0x00, 0x00, 0x00, 0x00, 0x00, 0x00, 0x00, 0x00, 0x00, 0x00, 0x00, 0x00, 0x00, 0x00, 0x00, 0x00, 0x00, 0x00, 0x00, 0x00, 0x00, 0x00, 0x00, 0x00, 0x00		 //tile:82 
, 0x5b, 0xf6, 0xad, 0xad, 0xad, 0xad, 0xad, 0xad, 0xad, 0xad, 0xad, 0xa4, 0xad, 0xad, 0xac, 0xac, 0xa4, 0xa4, 0x12, 0x1c, 0x1c, 0x1c, 0x1b, 0x1b, 0x00, 0x00, 0x00, 0x00, 0x00, 0x00, 0x00, 0x00, 0x00, 0x00, 0x00, 0x00, 0x00, 0x00, 0x00, 0x00, 0x00, 0x00, 0x00, 0x00, 0x00, 0x00, 0x00, 0x00		 //tile:83 
, 0xad, 0xad, 0xad, 0xad, 0xad, 0xad, 0xad, 0xac, 0xa4, 0xa4, 0xa4, 0xa4, 0xa4, 0xa4, 0xa4, 0xa4, 0xa4, 0xa4, 0x1b, 0x1b, 0x1c, 0x1b, 0x1b, 0x1b, 0x00, 0x00, 0x00, 0x00, 0x00, 0x00, 0x00, 0x00, 0x00, 0x00, 0x00, 0x00, 0x00, 0x00, 0x00, 0x00, 0x00, 0x00, 0x00, 0x00, 0x00, 0x00, 0x00, 0x00		 //tile:84 
, 0xad, 0xa4, 0xa4, 0xa4, 0xa4, 0x14, 0xa4, 0xa4, 0xa4, 0xa4, 0x5b, 0x13, 0xa4, 0xa4, 0xa4, 0xa4, 0x5b, 0x09, 0x1b, 0x1b, 0x13, 0x13, 0x1c, 0x01, 0x00, 0x00, 0x00, 0x00, 0x00, 0x00, 0x00, 0x00, 0x00, 0x00, 0x00, 0x00, 0x00, 0x00, 0x00, 0x00, 0x00, 0x00, 0x00, 0x00, 0x00, 0x00, 0x00, 0x00		 //tile:85 
, 0x00, 0x08, 0xad, 0xa4, 0xa4, 0xa4, 0x00, 0xa4, 0xad, 0xa4, 0xa4, 0xa4, 0x00, 0x5b, 0x9b, 0x9b, 0x9b, 0x5b, 0x00, 0x0a, 0x1c, 0x13, 0x13, 0x1c, 0x00, 0x00, 0x01, 0x01, 0x01, 0x01, 0x00, 0x00, 0x00, 0x00, 0x00, 0x00, 0x00, 0x00, 0x00, 0x00, 0x00, 0x00, 0x00, 0x00, 0x00, 0x00, 0x00, 0x00		 //tile:86 
, 0xa4, 0x9b, 0x5b, 0x1d, 0x01, 0x52, 0x9b, 0x5c, 0x1c, 0x00, 0x00, 0x00, 0x5c, 0x1c, 0x00, 0x00, 0x00, 0x00, 0x1c, 0x00, 0x00, 0x00, 0x00, 0x00, 0x00, 0x00, 0x00, 0x00, 0x00, 0x00, 0x00, 0x00, 0x00, 0x00, 0x00, 0x00, 0x00, 0x00, 0x00, 0x00, 0x00, 0x00, 0x00, 0x00, 0x00, 0x00, 0x00, 0x00		 //tile:87 
, 0x5b, 0x5b, 0x5b, 0x5b, 0x5b, 0x52, 0x5b, 0x5b, 0x5b, 0x5b, 0x5b, 0x52, 0x49, 0x5b, 0x52, 0x52, 0x52, 0x53, 0x00, 0x13, 0x13, 0x13, 0x13, 0x1c, 0x00, 0x00, 0x01, 0x01, 0x01, 0x01, 0x00, 0x00, 0x00, 0x00, 0x00, 0x00, 0x00, 0x00, 0x00, 0x00, 0x00, 0x00, 0x00, 0x00, 0x00, 0x00, 0x00, 0x00		 //tile:88 
, 0x00, 0x00, 0x00, 0x00, 0x00, 0x00, 0x0a, 0x00, 0x00, 0x00, 0x00, 0x00, 0x13, 0x00, 0x00, 0x00, 0x00, 0x00, 0x0a, 0x00, 0x00, 0x00, 0x00, 0x00, 0x00, 0x00, 0x00, 0x00, 0x00, 0x00, 0x00, 0x00, 0x00, 0x00, 0x00, 0x00, 0x00, 0x00, 0x00, 0x00, 0x00, 0x00, 0x00, 0x00, 0x00, 0x00, 0x00, 0x00		 //tile:89 
, 0x00, 0x00, 0x00, 0x00, 0x00, 0x00, 0x00, 0x00, 0x00, 0x00, 0x00, 0x00, 0x00, 0x00, 0x00, 0x00, 0x00, 0x00, 0x00, 0x00, 0x00, 0x00, 0x00, 0x00, 0x00, 0x00, 0x00, 0x00, 0x00, 0x00, 0x00, 0x00, 0x00, 0x00, 0x00, 0x00, 0x00, 0x00, 0x00, 0x00, 0x00, 0x00, 0x5b, 0x5b, 0x5b, 0x5b, 0x5b, 0x5b		 //tile:90 
, 0x00, 0x00, 0x00, 0x00, 0x00, 0x00, 0x00, 0x00, 0x00, 0x00, 0x00, 0x09, 0x00, 0x00, 0x00, 0x00, 0x00, 0xad, 0x00, 0x00, 0x00, 0x00, 0xad, 0xf6, 0x00, 0x00, 0x00, 0x9b, 0xad, 0x5b, 0x00, 0x00, 0x49, 0xad, 0x5d, 0x1d, 0x00, 0x00, 0x00, 0x13, 0x0a, 0x00, 0x5b, 0x5b, 0x5b, 0x5b, 0x5b, 0x5b		 //tile:91 
, 0x52, 0xf6, 0xa4, 0xac, 0xac, 0xad, 0xf6, 0xad, 0xad, 0xad, 0xad, 0xa4, 0xad, 0xad, 0xad, 0xa4, 0x5c, 0x1c, 0xa4, 0xa4, 0x5c, 0x1c, 0x13, 0x00, 0x5c, 0x1c, 0x13, 0x00, 0x00, 0x00, 0x13, 0x00, 0x00, 0x00, 0x00, 0x00, 0x00, 0x00, 0x00, 0x00, 0x00, 0x00, 0x5b, 0x5b, 0x5b, 0x5b, 0x5b, 0x5b		 //tile:92 
, 0xad, 0xa4, 0x5c, 0x1c, 0x14, 0x0a, 0x5c, 0x1c, 0x14, 0x09, 0x00, 0x00, 0x13, 0x01, 0x00, 0x00, 0x00, 0x00, 0x00, 0x00, 0x00, 0x00, 0x00, 0x00, 0x00, 0x00, 0x00, 0x00, 0x00, 0x00, 0x00, 0x00, 0x00, 0x00, 0x00, 0x00, 0x00, 0x00, 0x00, 0x00, 0x00, 0x00, 0x5b, 0x5b, 0x5b, 0x5b, 0x5b, 0x5b		 //tile:93 
};

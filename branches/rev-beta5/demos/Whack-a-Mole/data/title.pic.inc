//picture: title.raw
//Horizontal Tiles=23
//Vertical Tiles=3
//Tile Width=8
//Tile Height=8
#define TITLE_TILESET_SIZE 64

const char title_tileset[] PROGMEM ={
 0x00, 0x00, 0x00, 0x00, 0x00, 0x00, 0x00, 0x00, 0x00, 0x00, 0x00, 0x00, 0x00, 0x00, 0x00, 0x00, 0x00, 0x00, 0x00, 0x00, 0x00, 0x00, 0x00, 0x00, 0x00, 0x00, 0x00, 0x00, 0x00, 0x00, 0x00, 0x00, 0x00, 0x00, 0x00, 0x00, 0x00, 0x00, 0x00, 0x00, 0x00, 0x00, 0x00, 0x00, 0x00, 0x00, 0x00, 0x00, 0x00, 0x00, 0x00, 0x00, 0x00, 0x00, 0x00, 0x00, 0x00, 0x00, 0x00, 0x00, 0x00, 0x00, 0x00, 0x00		 //tile:0 
, 0x00, 0x00, 0x00, 0x00, 0x00, 0x00, 0x00, 0x00, 0x09, 0x0b, 0x0b, 0x15, 0x1f, 0x1f, 0x0b, 0x00, 0x09, 0x1f, 0x1f, 0x1f, 0x1f, 0x1f, 0x15, 0x00, 0x00, 0x1e, 0x27, 0x27, 0x27, 0x27, 0x27, 0x00, 0x00, 0x14, 0x27, 0x27, 0x27, 0x27, 0x27, 0x13, 0x00, 0x09, 0x27, 0x27, 0x27, 0x27, 0x27, 0x1d, 0x00, 0x00, 0x2f, 0x2f, 0x2f, 0x2f, 0x2f, 0x2f, 0x00, 0x00, 0x1c, 0x2f, 0x2f, 0x2f, 0x2f, 0x2f		 //tile:1 
, 0x00, 0x00, 0x00, 0x00, 0x00, 0x00, 0x00, 0x00, 0x00, 0x00, 0x00, 0x00, 0x00, 0x0b, 0x00, 0x00, 0x00, 0x00, 0x00, 0x00, 0x09, 0x1f, 0x13, 0x00, 0x00, 0x00, 0x00, 0x00, 0x1e, 0x27, 0x1f, 0x00, 0x00, 0x00, 0x00, 0x13, 0x27, 0x27, 0x27, 0x13, 0x00, 0x00, 0x09, 0x27, 0x27, 0x27, 0x27, 0x27, 0x00, 0x00, 0x1c, 0x2f, 0x2f, 0x2f, 0x2f, 0x2f, 0x1b, 0x0a, 0x2f, 0x2f, 0x2f, 0x2f, 0x2f, 0x2f		 //tile:2 
, 0x00, 0x00, 0x00, 0x00, 0x00, 0x00, 0x00, 0x00, 0x00, 0x00, 0x00, 0x16, 0x1f, 0x15, 0x0b, 0x0b, 0x00, 0x00, 0x09, 0x1f, 0x1f, 0x1f, 0x1f, 0x1f, 0x00, 0x00, 0x13, 0x27, 0x27, 0x27, 0x27, 0x27, 0x00, 0x00, 0x1e, 0x27, 0x27, 0x27, 0x27, 0x27, 0x00, 0x09, 0x27, 0x27, 0x27, 0x27, 0x27, 0x27, 0x13, 0x13, 0x2f, 0x2f, 0x2f, 0x2f, 0x2f, 0x2f, 0x2f, 0x2e, 0x2f, 0x2f, 0x2f, 0x2f, 0x2f, 0x2f		 //tile:3 
, 0x00, 0x00, 0x00, 0x00, 0x00, 0x00, 0x00, 0x00, 0x0b, 0x0b, 0x00, 0x00, 0x00, 0x00, 0x00, 0x00, 0x1f, 0x1e, 0x00, 0x00, 0x00, 0x00, 0x00, 0x00, 0x27, 0x27, 0x27, 0x27, 0x13, 0x00, 0x00, 0x00, 0x27, 0x27, 0x27, 0x27, 0x13, 0x00, 0x00, 0x00, 0x27, 0x27, 0x27, 0x27, 0x13, 0x00, 0x00, 0x00, 0x2f, 0x2f, 0x2f, 0x2f, 0x13, 0x00, 0x00, 0x00, 0x2f, 0x2f, 0x2f, 0x2f, 0x1b, 0x00, 0x00, 0x00		 //tile:4 
, 0x00, 0x00, 0x00, 0x00, 0x00, 0x00, 0x00, 0x00, 0x00, 0x00, 0x00, 0x00, 0x00, 0x00, 0x00, 0x00, 0x00, 0x00, 0x00, 0x00, 0x00, 0x00, 0x00, 0x00, 0x01, 0x13, 0x14, 0x27, 0x27, 0x27, 0x0a, 0x00, 0x0a, 0x27, 0x27, 0x27, 0x27, 0x27, 0x09, 0x00, 0x0a, 0x27, 0x27, 0x27, 0x27, 0x27, 0x09, 0x00, 0x13, 0x2f, 0x2f, 0x2f, 0x2f, 0x2f, 0x09, 0x00, 0x13, 0x2f, 0x2f, 0x2f, 0x2f, 0x2f, 0x00, 0x00		 //tile:5 
, 0x00, 0x00, 0x00, 0x00, 0x00, 0x00, 0x00, 0x00, 0x00, 0x00, 0x00, 0x00, 0x00, 0x00, 0x00, 0x00, 0x00, 0x00, 0x00, 0x00, 0x14, 0x00, 0x00, 0x00, 0x00, 0x00, 0x00, 0x0a, 0x27, 0x14, 0x00, 0x00, 0x00, 0x00, 0x00, 0x1d, 0x27, 0x27, 0x09, 0x00, 0x00, 0x00, 0x09, 0x27, 0x27, 0x27, 0x26, 0x00, 0x00, 0x00, 0x1c, 0x2f, 0x2f, 0x2f, 0x2f, 0x1c, 0x00, 0x09, 0x2f, 0x2f, 0x2f, 0x2f, 0x2f, 0x2f		 //tile:6 
, 0x00, 0x00, 0x00, 0x00, 0x00, 0x00, 0x00, 0x00, 0x00, 0x00, 0x00, 0x00, 0x00, 0x00, 0x00, 0x00, 0x00, 0x00, 0x00, 0x00, 0x00, 0x00, 0x00, 0x00, 0x00, 0x00, 0x00, 0x00, 0x00, 0x00, 0x00, 0x00, 0x00, 0x00, 0x00, 0x00, 0x00, 0x00, 0x00, 0x00, 0x00, 0x00, 0x00, 0x00, 0x00, 0x00, 0x00, 0x1c, 0x00, 0x00, 0x00, 0x00, 0x00, 0x00, 0x00, 0x2f, 0x09, 0x00, 0x00, 0x00, 0x00, 0x00, 0x12, 0x2f		 //tile:7 
, 0x00, 0x00, 0x00, 0x00, 0x00, 0x00, 0x00, 0x00, 0x00, 0x00, 0x00, 0x00, 0x00, 0x00, 0x00, 0x00, 0x00, 0x00, 0x13, 0x1e, 0x1f, 0x1f, 0x1f, 0x13, 0x09, 0x1e, 0x27, 0x27, 0x27, 0x27, 0x27, 0x27, 0x1e, 0x27, 0x27, 0x27, 0x27, 0x27, 0x27, 0x27, 0x27, 0x27, 0x27, 0x27, 0x27, 0x27, 0x27, 0x27, 0x2f, 0x2f, 0x2f, 0x2f, 0x2f, 0x2f, 0x2f, 0x2f, 0x2f, 0x2f, 0x2f, 0x2f, 0x1b, 0x00, 0x09, 0x25		 //tile:8 
, 0x00, 0x00, 0x00, 0x00, 0x00, 0x00, 0x00, 0x00, 0x00, 0x00, 0x00, 0x00, 0x00, 0x00, 0x00, 0x00, 0x09, 0x00, 0x1f, 0x15, 0x13, 0x13, 0x0a, 0x00, 0x27, 0x00, 0x27, 0x27, 0x27, 0x27, 0x27, 0x13, 0x27, 0x00, 0x27, 0x27, 0x27, 0x27, 0x27, 0x13, 0x26, 0x00, 0x27, 0x27, 0x27, 0x27, 0x27, 0x13, 0x25, 0x00, 0x2f, 0x2f, 0x2f, 0x2f, 0x2f, 0x13, 0x1c, 0x00, 0x2f, 0x2f, 0x2f, 0x2f, 0x2f, 0x2f		 //tile:9 
, 0x00, 0x00, 0x00, 0x00, 0x00, 0x00, 0x00, 0x00, 0x00, 0x00, 0x00, 0x00, 0x00, 0x00, 0x00, 0x00, 0x00, 0x00, 0x00, 0x00, 0x00, 0x00, 0x00, 0x00, 0x00, 0x00, 0x00, 0x1d, 0x1e, 0x13, 0x01, 0x00, 0x00, 0x00, 0x1d, 0x27, 0x27, 0x27, 0x27, 0x27, 0x00, 0x1d, 0x27, 0x27, 0x27, 0x27, 0x27, 0x14, 0x25, 0x2f, 0x2f, 0x2f, 0x2f, 0x2f, 0x25, 0x00, 0x2f, 0x2f, 0x2f, 0x2f, 0x2f, 0x26, 0x00, 0x00		 //tile:10 
, 0x00, 0x00, 0x00, 0x00, 0x00, 0x00, 0x00, 0x00, 0x00, 0x00, 0x00, 0x00, 0x00, 0x00, 0x00, 0x00, 0x00, 0x00, 0x00, 0x00, 0x00, 0x00, 0x00, 0x00, 0x00, 0x00, 0x00, 0x00, 0x00, 0x00, 0x00, 0x00, 0x09, 0x00, 0x00, 0x00, 0x00, 0x00, 0x00, 0x00, 0x00, 0x00, 0x00, 0x00, 0x00, 0x00, 0x00, 0x00, 0x00, 0x00, 0x00, 0x00, 0x00, 0x00, 0x00, 0x00, 0x00, 0x00, 0x00, 0x00, 0x00, 0x00, 0x00, 0x00		 //tile:11 
, 0x00, 0x00, 0x00, 0x00, 0x00, 0x00, 0x00, 0x00, 0x00, 0x00, 0x00, 0x00, 0x00, 0x09, 0x0b, 0x00, 0x00, 0x00, 0x00, 0x00, 0x00, 0x1e, 0x1e, 0x00, 0x00, 0x00, 0x00, 0x00, 0x14, 0x27, 0x27, 0x0b, 0x00, 0x00, 0x00, 0x0a, 0x27, 0x27, 0x27, 0x1e, 0x00, 0x00, 0x00, 0x26, 0x27, 0x27, 0x27, 0x27, 0x00, 0x00, 0x1c, 0x2f, 0x2f, 0x2f, 0x2f, 0x2f, 0x00, 0x12, 0x2f, 0x2f, 0x2f, 0x2f, 0x2f, 0x2f		 //tile:12 
, 0x00, 0x00, 0x00, 0x00, 0x00, 0x00, 0x00, 0x00, 0x00, 0x00, 0x00, 0x00, 0x00, 0x00, 0x00, 0x00, 0x00, 0x00, 0x00, 0x00, 0x00, 0x00, 0x00, 0x00, 0x00, 0x00, 0x00, 0x00, 0x00, 0x00, 0x00, 0x00, 0x00, 0x00, 0x00, 0x00, 0x00, 0x00, 0x00, 0x00, 0x13, 0x00, 0x00, 0x00, 0x00, 0x00, 0x00, 0x00, 0x26, 0x00, 0x00, 0x00, 0x00, 0x00, 0x00, 0x00, 0x2f, 0x13, 0x00, 0x00, 0x00, 0x00, 0x00, 0x00		 //tile:13 
, 0x00, 0x00, 0x00, 0x00, 0x00, 0x00, 0x00, 0x0b, 0x00, 0x00, 0x00, 0x00, 0x00, 0x00, 0x00, 0x1f, 0x00, 0x00, 0x00, 0x00, 0x00, 0x00, 0x13, 0x1f, 0x00, 0x00, 0x00, 0x00, 0x00, 0x00, 0x1e, 0x27, 0x00, 0x00, 0x00, 0x00, 0x00, 0x09, 0x27, 0x27, 0x00, 0x00, 0x00, 0x00, 0x00, 0x14, 0x27, 0x27, 0x00, 0x00, 0x00, 0x00, 0x00, 0x2f, 0x2f, 0x2f, 0x00, 0x00, 0x00, 0x00, 0x12, 0x2f, 0x2f, 0x2f		 //tile:14 
, 0x00, 0x00, 0x00, 0x00, 0x00, 0x00, 0x00, 0x00, 0x00, 0x00, 0x00, 0x00, 0x00, 0x00, 0x00, 0x00, 0x13, 0x00, 0x00, 0x00, 0x00, 0x00, 0x00, 0x00, 0x1d, 0x00, 0x00, 0x00, 0x00, 0x00, 0x00, 0x00, 0x27, 0x09, 0x00, 0x00, 0x00, 0x00, 0x00, 0x09, 0x27, 0x13, 0x00, 0x00, 0x00, 0x00, 0x00, 0x26, 0x2f, 0x26, 0x00, 0x00, 0x00, 0x00, 0x13, 0x2f, 0x2f, 0x2f, 0x0a, 0x00, 0x00, 0x00, 0x2f, 0x2f		 //tile:15 
, 0x00, 0x00, 0x00, 0x00, 0x00, 0x00, 0x00, 0x00, 0x00, 0x0b, 0x0a, 0x00, 0x00, 0x00, 0x00, 0x00, 0x00, 0x1f, 0x14, 0x00, 0x00, 0x00, 0x00, 0x00, 0x14, 0x27, 0x1e, 0x00, 0x00, 0x00, 0x00, 0x00, 0x27, 0x27, 0x27, 0x09, 0x00, 0x00, 0x00, 0x1e, 0x27, 0x27, 0x27, 0x13, 0x00, 0x00, 0x13, 0x27, 0x2f, 0x2f, 0x2f, 0x1d, 0x00, 0x00, 0x2f, 0x2f, 0x2f, 0x2f, 0x2f, 0x2f, 0x00, 0x12, 0x2f, 0x2f		 //tile:16 
, 0x00, 0x00, 0x00, 0x00, 0x00, 0x00, 0x00, 0x00, 0x00, 0x00, 0x00, 0x00, 0x00, 0x00, 0x00, 0x00, 0x00, 0x0a, 0x15, 0x1f, 0x1f, 0x1f, 0x1e, 0x13, 0x1d, 0x27, 0x27, 0x27, 0x27, 0x27, 0x27, 0x27, 0x27, 0x27, 0x27, 0x27, 0x27, 0x27, 0x27, 0x27, 0x27, 0x27, 0x27, 0x27, 0x27, 0x27, 0x27, 0x27, 0x2f, 0x2f, 0x2f, 0x26, 0x00, 0x26, 0x2f, 0x2f, 0x2f, 0x2f, 0x2f, 0x12, 0x00, 0x1b, 0x2f, 0x2f		 //tile:17 
, 0x00, 0x00, 0x00, 0x00, 0x00, 0x00, 0x00, 0x00, 0x00, 0x00, 0x00, 0x00, 0x00, 0x00, 0x00, 0x00, 0x00, 0x00, 0x00, 0x00, 0x00, 0x00, 0x00, 0x00, 0x1e, 0x01, 0x00, 0x27, 0x27, 0x27, 0x27, 0x27, 0x27, 0x1e, 0x00, 0x27, 0x27, 0x27, 0x27, 0x27, 0x27, 0x27, 0x13, 0x26, 0x27, 0x27, 0x27, 0x27, 0x2f, 0x2f, 0x26, 0x26, 0x2f, 0x2f, 0x2f, 0x2f, 0x2f, 0x2f, 0x2f, 0x25, 0x2f, 0x2f, 0x2f, 0x2f		 //tile:18 
, 0x00, 0x00, 0x00, 0x00, 0x00, 0x00, 0x00, 0x00, 0x00, 0x00, 0x00, 0x00, 0x00, 0x00, 0x00, 0x00, 0x00, 0x00, 0x00, 0x00, 0x00, 0x1f, 0x1f, 0x1e, 0x27, 0x1d, 0x00, 0x00, 0x00, 0x27, 0x27, 0x27, 0x27, 0x1d, 0x00, 0x00, 0x00, 0x27, 0x27, 0x27, 0x27, 0x1d, 0x00, 0x00, 0x00, 0x27, 0x27, 0x27, 0x2f, 0x25, 0x00, 0x00, 0x00, 0x2f, 0x2f, 0x2f, 0x2f, 0x25, 0x00, 0x00, 0x00, 0x2f, 0x2f, 0x2f		 //tile:19 
, 0x00, 0x00, 0x00, 0x00, 0x00, 0x00, 0x00, 0x00, 0x00, 0x00, 0x00, 0x00, 0x00, 0x00, 0x00, 0x00, 0x13, 0x13, 0x13, 0x13, 0x13, 0x00, 0x00, 0x00, 0x27, 0x27, 0x27, 0x27, 0x27, 0x27, 0x27, 0x0b, 0x27, 0x27, 0x27, 0x27, 0x27, 0x27, 0x27, 0x0a, 0x27, 0x27, 0x27, 0x27, 0x27, 0x27, 0x27, 0x09, 0x2f, 0x2f, 0x25, 0x1d, 0x2f, 0x2f, 0x2f, 0x00, 0x2f, 0x2f, 0x1b, 0x00, 0x00, 0x00, 0x00, 0x00		 //tile:20 
, 0x00, 0x00, 0x12, 0x37, 0x37, 0x37, 0x37, 0x37, 0x00, 0x00, 0x00, 0x37, 0x37, 0x37, 0x37, 0x37, 0x00, 0x00, 0x00, 0x24, 0x3f, 0x3f, 0x3f, 0x3f, 0x00, 0x00, 0x00, 0x12, 0x3f, 0x3f, 0x3f, 0x3f, 0x00, 0x00, 0x00, 0x00, 0x3f, 0x3f, 0x3f, 0x3f, 0x00, 0x00, 0x00, 0x00, 0x2d, 0x3f, 0x3f, 0x3f, 0x00, 0x00, 0x00, 0x00, 0x12, 0x3f, 0x3f, 0x3f, 0x00, 0x00, 0x00, 0x00, 0x00, 0x37, 0x37, 0x37		 //tile:21 
, 0x25, 0x2e, 0x37, 0x37, 0x37, 0x37, 0x37, 0x37, 0x37, 0x37, 0x37, 0x37, 0x37, 0x37, 0x37, 0x37, 0x3f, 0x3f, 0x3f, 0x3f, 0x3f, 0x3f, 0x3f, 0x3f, 0x3f, 0x3f, 0x3f, 0x3f, 0x3f, 0x3f, 0x3f, 0x3f, 0x3f, 0x3f, 0x3f, 0x3f, 0x3f, 0x3f, 0x3f, 0x3f, 0x3f, 0x3f, 0x3f, 0x3f, 0x3f, 0x3f, 0x3f, 0x3f, 0x3f, 0x3f, 0x3f, 0x3f, 0x25, 0x24, 0x3f, 0x3f, 0x37, 0x37, 0x37, 0x37, 0x00, 0x09, 0x37, 0x37		 //tile:22 
, 0x37, 0x37, 0x37, 0x37, 0x37, 0x37, 0x37, 0x37, 0x37, 0x37, 0x37, 0x37, 0x37, 0x37, 0x37, 0x37, 0x3f, 0x3f, 0x3f, 0x3f, 0x3f, 0x3f, 0x25, 0x3f, 0x3f, 0x3f, 0x3f, 0x3f, 0x3f, 0x3f, 0x12, 0x3f, 0x3f, 0x3f, 0x3f, 0x3f, 0x3f, 0x3f, 0x00, 0x3f, 0x3f, 0x3f, 0x3f, 0x3f, 0x3f, 0x1b, 0x00, 0x3f, 0x3f, 0x3f, 0x3f, 0x3f, 0x3f, 0x09, 0x00, 0x3f, 0x37, 0x37, 0x37, 0x37, 0x2d, 0x00, 0x00, 0x37		 //tile:23 
, 0x37, 0x37, 0x37, 0x37, 0x1b, 0x00, 0x00, 0x00, 0x37, 0x37, 0x37, 0x37, 0x37, 0x37, 0x37, 0x37, 0x3f, 0x3f, 0x3f, 0x3f, 0x3f, 0x3f, 0x3f, 0x3f, 0x3f, 0x3f, 0x3f, 0x3f, 0x3f, 0x3f, 0x3f, 0x3f, 0x3f, 0x3f, 0x3f, 0x3f, 0x3f, 0x3f, 0x3f, 0x3f, 0x3f, 0x3f, 0x3f, 0x3f, 0x1b, 0x00, 0x00, 0x00, 0x3f, 0x3f, 0x3f, 0x3f, 0x1b, 0x00, 0x00, 0x00, 0x37, 0x37, 0x37, 0x37, 0x1b, 0x00, 0x00, 0x00		 //tile:24 
, 0x1b, 0x37, 0x37, 0x37, 0x37, 0x37, 0x00, 0x00, 0x37, 0x37, 0x37, 0x37, 0x37, 0x37, 0x00, 0x00, 0x3f, 0x3f, 0x3f, 0x3f, 0x3f, 0x3f, 0x00, 0x00, 0x3f, 0x3f, 0x3f, 0x3f, 0x3f, 0x36, 0x00, 0x09, 0x3f, 0x3f, 0x3f, 0x3f, 0x3f, 0x36, 0x00, 0x24, 0x1b, 0x3f, 0x3f, 0x3f, 0x3f, 0x36, 0x09, 0x3f, 0x24, 0x3f, 0x3f, 0x3f, 0x3f, 0x36, 0x24, 0x3f, 0x24, 0x37, 0x37, 0x37, 0x37, 0x2d, 0x37, 0x37		 //tile:25 
, 0x00, 0x24, 0x37, 0x37, 0x37, 0x37, 0x37, 0x37, 0x09, 0x37, 0x37, 0x37, 0x37, 0x37, 0x37, 0x37, 0x24, 0x3f, 0x3f, 0x3f, 0x3f, 0x37, 0x3f, 0x3f, 0x3f, 0x3f, 0x3f, 0x3f, 0x2d, 0x1b, 0x3f, 0x3f, 0x3f, 0x3f, 0x3f, 0x3f, 0x1b, 0x00, 0x3f, 0x3f, 0x3f, 0x3f, 0x3f, 0x3f, 0x09, 0x00, 0x1b, 0x3f, 0x3f, 0x3f, 0x3f, 0x2e, 0x00, 0x00, 0x00, 0x37, 0x37, 0x37, 0x37, 0x37, 0x37, 0x37, 0x37, 0x37		 //tile:26 
, 0x2e, 0x00, 0x00, 0x00, 0x00, 0x00, 0x1c, 0x37, 0x37, 0x1c, 0x00, 0x00, 0x00, 0x00, 0x2d, 0x37, 0x3f, 0x3f, 0x12, 0x00, 0x00, 0x00, 0x36, 0x3f, 0x3f, 0x3f, 0x36, 0x00, 0x00, 0x00, 0x3f, 0x3f, 0x3f, 0x3f, 0x3f, 0x24, 0x00, 0x00, 0x3f, 0x3f, 0x3f, 0x3f, 0x3f, 0x3f, 0x12, 0x00, 0x3f, 0x3f, 0x3f, 0x3f, 0x3f, 0x3f, 0x36, 0x00, 0x3f, 0x3f, 0x37, 0x37, 0x37, 0x37, 0x37, 0x1c, 0x36, 0x37		 //tile:27 
, 0x37, 0x37, 0x37, 0x2f, 0x00, 0x00, 0x00, 0x00, 0x37, 0x37, 0x37, 0x2d, 0x00, 0x00, 0x00, 0x00, 0x3f, 0x3f, 0x3f, 0x24, 0x00, 0x00, 0x00, 0x00, 0x3f, 0x3f, 0x3f, 0x1b, 0x00, 0x00, 0x00, 0x00, 0x3f, 0x3f, 0x3f, 0x1b, 0x00, 0x00, 0x00, 0x00, 0x3f, 0x3f, 0x3f, 0x1b, 0x00, 0x00, 0x00, 0x00, 0x3f, 0x3f, 0x3f, 0x1b, 0x00, 0x00, 0x00, 0x00, 0x37, 0x37, 0x37, 0x1c, 0x00, 0x00, 0x00, 0x00		 //tile:28 
, 0x09, 0x00, 0x37, 0x37, 0x37, 0x37, 0x37, 0x37, 0x00, 0x00, 0x37, 0x37, 0x37, 0x37, 0x37, 0x37, 0x00, 0x00, 0x3f, 0x3f, 0x3f, 0x3f, 0x3f, 0x3f, 0x00, 0x00, 0x3f, 0x3f, 0x3f, 0x3f, 0x3f, 0x3f, 0x00, 0x00, 0x36, 0x3f, 0x3f, 0x3f, 0x3f, 0x3f, 0x00, 0x00, 0x36, 0x3f, 0x3f, 0x3f, 0x3f, 0x3f, 0x00, 0x00, 0x36, 0x3f, 0x3f, 0x3f, 0x3f, 0x3f, 0x00, 0x00, 0x36, 0x37, 0x37, 0x37, 0x37, 0x37		 //tile:29 
, 0x37, 0x37, 0x37, 0x37, 0x2f, 0x09, 0x00, 0x00, 0x37, 0x37, 0x37, 0x37, 0x09, 0x00, 0x00, 0x00, 0x3f, 0x3f, 0x3f, 0x12, 0x00, 0x00, 0x00, 0x2d, 0x3f, 0x3f, 0x1b, 0x00, 0x00, 0x00, 0x00, 0x36, 0x3f, 0x36, 0x00, 0x00, 0x00, 0x00, 0x00, 0x36, 0x3f, 0x3f, 0x2d, 0x00, 0x00, 0x00, 0x00, 0x3f, 0x3f, 0x3f, 0x3f, 0x2d, 0x00, 0x00, 0x00, 0x00, 0x37, 0x37, 0x37, 0x37, 0x2e, 0x00, 0x00, 0x00		 //tile:30 
, 0x00, 0x00, 0x00, 0x00, 0x00, 0x00, 0x00, 0x00, 0x00, 0x00, 0x00, 0x00, 0x00, 0x00, 0x00, 0x00, 0x3f, 0x3f, 0x3f, 0x3f, 0x3f, 0x3f, 0x3f, 0x3f, 0x3f, 0x3f, 0x3f, 0x3f, 0x3f, 0x3f, 0x3f, 0x3f, 0x3f, 0x3f, 0x3f, 0x3f, 0x3f, 0x3f, 0x3f, 0x3f, 0x3f, 0x3f, 0x3f, 0x3f, 0x3f, 0x3f, 0x3f, 0x3f, 0x00, 0x00, 0x00, 0x00, 0x00, 0x00, 0x00, 0x00, 0x00, 0x00, 0x00, 0x00, 0x00, 0x00, 0x00, 0x00		 //tile:31 
, 0x00, 0x00, 0x00, 0x00, 0x00, 0x00, 0x00, 0x00, 0x00, 0x00, 0x00, 0x00, 0x00, 0x00, 0x00, 0x00, 0x3f, 0x3f, 0x37, 0x00, 0x00, 0x00, 0x00, 0x12, 0x3f, 0x3f, 0x36, 0x00, 0x00, 0x00, 0x00, 0x36, 0x3f, 0x3f, 0x24, 0x00, 0x00, 0x00, 0x2d, 0x3f, 0x3f, 0x3f, 0x1b, 0x00, 0x00, 0x12, 0x3f, 0x3f, 0x00, 0x00, 0x00, 0x00, 0x00, 0x37, 0x3f, 0x3f, 0x00, 0x00, 0x00, 0x00, 0x25, 0x37, 0x37, 0x37		 //tile:32 
, 0x00, 0x2e, 0x37, 0x37, 0x37, 0x37, 0x37, 0x37, 0x24, 0x37, 0x37, 0x37, 0x37, 0x37, 0x37, 0x37, 0x3f, 0x3f, 0x3f, 0x3f, 0x3f, 0x1b, 0x3f, 0x3f, 0x3f, 0x3f, 0x3f, 0x3f, 0x36, 0x00, 0x36, 0x3f, 0x3f, 0x3f, 0x3f, 0x3f, 0x1b, 0x00, 0x24, 0x3f, 0x3f, 0x3f, 0x3f, 0x36, 0x00, 0x00, 0x12, 0x3f, 0x3f, 0x3f, 0x3f, 0x2d, 0x1b, 0x1b, 0x1b, 0x3f, 0x37, 0x37, 0x37, 0x37, 0x37, 0x37, 0x37, 0x37		 //tile:33 
, 0x37, 0x2e, 0x00, 0x00, 0x00, 0x00, 0x00, 0x00, 0x37, 0x37, 0x1b, 0x00, 0x00, 0x00, 0x00, 0x00, 0x3f, 0x3f, 0x36, 0x00, 0x00, 0x00, 0x2d, 0x3f, 0x3f, 0x3f, 0x3f, 0x1b, 0x00, 0x00, 0x36, 0x3f, 0x3f, 0x3f, 0x3f, 0x36, 0x00, 0x00, 0x36, 0x3f, 0x3f, 0x3f, 0x3f, 0x3f, 0x1b, 0x00, 0x3f, 0x3f, 0x3f, 0x3f, 0x3f, 0x3f, 0x36, 0x00, 0x00, 0x00, 0x37, 0x37, 0x37, 0x37, 0x37, 0x1b, 0x00, 0x00		 //tile:34 
, 0x00, 0x00, 0x00, 0x00, 0x25, 0x37, 0x37, 0x37, 0x00, 0x00, 0x00, 0x00, 0x37, 0x37, 0x37, 0x37, 0x3f, 0x37, 0x00, 0x1b, 0x3f, 0x3f, 0x3f, 0x3f, 0x3f, 0x36, 0x00, 0x36, 0x3f, 0x3f, 0x3f, 0x3f, 0x3f, 0x24, 0x09, 0x3f, 0x3f, 0x3f, 0x3f, 0x3f, 0x3f, 0x1b, 0x24, 0x3f, 0x3f, 0x3f, 0x3f, 0x3f, 0x00, 0x00, 0x37, 0x3f, 0x3f, 0x3f, 0x3f, 0x3f, 0x00, 0x12, 0x37, 0x37, 0x37, 0x37, 0x37, 0x2d		 //tile:35 
, 0x37, 0x37, 0x24, 0x00, 0x00, 0x24, 0x37, 0x37, 0x37, 0x37, 0x37, 0x00, 0x09, 0x37, 0x37, 0x37, 0x3f, 0x3f, 0x3f, 0x12, 0x2e, 0x3f, 0x3f, 0x3f, 0x3f, 0x3f, 0x3f, 0x37, 0x3f, 0x3f, 0x3f, 0x3f, 0x3f, 0x3f, 0x3f, 0x3f, 0x3f, 0x3f, 0x3f, 0x3f, 0x3f, 0x3f, 0x3f, 0x3f, 0x3f, 0x3f, 0x3f, 0x3f, 0x3f, 0x3f, 0x3f, 0x3f, 0x3f, 0x3f, 0x3f, 0x2e, 0x37, 0x37, 0x37, 0x37, 0x37, 0x37, 0x37, 0x09		 //tile:36 
, 0x37, 0x37, 0x37, 0x37, 0x12, 0x1c, 0x37, 0x37, 0x37, 0x37, 0x37, 0x37, 0x24, 0x2e, 0x37, 0x37, 0x3f, 0x3f, 0x3f, 0x3f, 0x37, 0x36, 0x3f, 0x3f, 0x3f, 0x3f, 0x3f, 0x3f, 0x3f, 0x3f, 0x3f, 0x3f, 0x3f, 0x3f, 0x3f, 0x3f, 0x3f, 0x3f, 0x3f, 0x3f, 0x3f, 0x3f, 0x3f, 0x3f, 0x3f, 0x3f, 0x3f, 0x3f, 0x37, 0x3f, 0x3f, 0x3f, 0x3f, 0x3f, 0x3f, 0x3f, 0x25, 0x37, 0x37, 0x37, 0x37, 0x37, 0x37, 0x37		 //tile:37 
, 0x37, 0x37, 0x2f, 0x00, 0x00, 0x12, 0x37, 0x37, 0x37, 0x37, 0x2d, 0x00, 0x00, 0x09, 0x37, 0x37, 0x3f, 0x3f, 0x24, 0x00, 0x00, 0x09, 0x3f, 0x3f, 0x3f, 0x3f, 0x1b, 0x00, 0x00, 0x09, 0x3f, 0x3f, 0x3f, 0x3f, 0x1b, 0x00, 0x00, 0x09, 0x3f, 0x3f, 0x3f, 0x3f, 0x1b, 0x00, 0x00, 0x12, 0x3f, 0x3f, 0x3f, 0x3f, 0x1b, 0x00, 0x00, 0x1b, 0x3f, 0x3f, 0x37, 0x37, 0x1c, 0x00, 0x00, 0x1b, 0x37, 0x37		 //tile:38 
, 0x37, 0x37, 0x37, 0x37, 0x37, 0x37, 0x37, 0x37, 0x37, 0x37, 0x37, 0x37, 0x37, 0x37, 0x37, 0x37, 0x3f, 0x3f, 0x3f, 0x3f, 0x3f, 0x3f, 0x3f, 0x3f, 0x3f, 0x3f, 0x3f, 0x36, 0x3f, 0x3f, 0x3f, 0x3f, 0x3f, 0x3f, 0x3f, 0x2d, 0x3f, 0x3f, 0x3f, 0x3f, 0x3f, 0x3f, 0x3f, 0x1b, 0x3f, 0x3f, 0x3f, 0x3f, 0x3f, 0x3f, 0x3f, 0x1b, 0x3f, 0x3f, 0x3f, 0x3f, 0x37, 0x37, 0x37, 0x1b, 0x37, 0x37, 0x37, 0x37		 //tile:39 
, 0x37, 0x25, 0x00, 0x00, 0x00, 0x37, 0x37, 0x37, 0x37, 0x2d, 0x00, 0x00, 0x00, 0x37, 0x37, 0x37, 0x3f, 0x24, 0x00, 0x00, 0x00, 0x3f, 0x3f, 0x3f, 0x3f, 0x24, 0x00, 0x00, 0x00, 0x3f, 0x3f, 0x3f, 0x3f, 0x24, 0x00, 0x00, 0x00, 0x3f, 0x3f, 0x3f, 0x3f, 0x24, 0x00, 0x00, 0x00, 0x3f, 0x3f, 0x3f, 0x3f, 0x24, 0x00, 0x00, 0x00, 0x3f, 0x3f, 0x3f, 0x37, 0x24, 0x00, 0x00, 0x00, 0x37, 0x37, 0x37		 //tile:40 
, 0x37, 0x37, 0x1b, 0x00, 0x00, 0x00, 0x00, 0x00, 0x37, 0x37, 0x1b, 0x00, 0x00, 0x00, 0x00, 0x00, 0x3f, 0x3f, 0x3f, 0x3f, 0x3f, 0x2d, 0x00, 0x00, 0x3f, 0x3f, 0x3f, 0x3f, 0x3f, 0x2d, 0x00, 0x00, 0x3f, 0x3f, 0x3f, 0x3f, 0x3f, 0x2d, 0x00, 0x00, 0x3f, 0x3f, 0x3f, 0x3f, 0x3f, 0x2d, 0x00, 0x00, 0x3f, 0x3f, 0x1b, 0x00, 0x00, 0x00, 0x00, 0x00, 0x37, 0x37, 0x1b, 0x00, 0x00, 0x00, 0x00, 0x00		 //tile:41 
, 0x00, 0x00, 0x00, 0x00, 0x00, 0x25, 0x37, 0x37, 0x00, 0x00, 0x00, 0x00, 0x00, 0x1b, 0x37, 0x37, 0x00, 0x00, 0x00, 0x00, 0x00, 0x00, 0x2f, 0x2f, 0x00, 0x00, 0x00, 0x00, 0x00, 0x00, 0x1d, 0x2f, 0x00, 0x00, 0x00, 0x00, 0x00, 0x00, 0x13, 0x27, 0x00, 0x00, 0x00, 0x00, 0x00, 0x00, 0x01, 0x1e, 0x00, 0x00, 0x00, 0x00, 0x00, 0x00, 0x00, 0x00, 0x00, 0x00, 0x00, 0x00, 0x00, 0x00, 0x00, 0x00		 //tile:42 
, 0x37, 0x37, 0x37, 0x12, 0x00, 0x00, 0x24, 0x37, 0x37, 0x37, 0x1c, 0x00, 0x00, 0x00, 0x09, 0x37, 0x2f, 0x26, 0x00, 0x00, 0x00, 0x00, 0x00, 0x1c, 0x2f, 0x09, 0x00, 0x00, 0x00, 0x00, 0x00, 0x00, 0x13, 0x00, 0x00, 0x00, 0x00, 0x00, 0x00, 0x00, 0x00, 0x00, 0x00, 0x00, 0x00, 0x00, 0x00, 0x00, 0x00, 0x00, 0x00, 0x00, 0x00, 0x00, 0x00, 0x00, 0x00, 0x00, 0x00, 0x00, 0x00, 0x00, 0x00, 0x00		 //tile:43 
, 0x37, 0x37, 0x37, 0x37, 0x12, 0x00, 0x00, 0x37, 0x37, 0x37, 0x37, 0x2f, 0x00, 0x00, 0x00, 0x37, 0x2f, 0x2f, 0x2f, 0x13, 0x00, 0x00, 0x00, 0x2f, 0x27, 0x2f, 0x2f, 0x09, 0x00, 0x00, 0x00, 0x2f, 0x13, 0x27, 0x1d, 0x00, 0x00, 0x00, 0x00, 0x27, 0x00, 0x1f, 0x0b, 0x00, 0x00, 0x00, 0x00, 0x00, 0x00, 0x13, 0x00, 0x00, 0x00, 0x00, 0x00, 0x00, 0x00, 0x00, 0x00, 0x00, 0x00, 0x00, 0x00, 0x00		 //tile:44 
, 0x37, 0x37, 0x37, 0x37, 0x1b, 0x00, 0x00, 0x00, 0x37, 0x37, 0x37, 0x37, 0x1b, 0x00, 0x00, 0x00, 0x2f, 0x2f, 0x2f, 0x2f, 0x13, 0x00, 0x00, 0x00, 0x2f, 0x2f, 0x2f, 0x2f, 0x13, 0x00, 0x00, 0x00, 0x27, 0x27, 0x27, 0x27, 0x13, 0x00, 0x00, 0x00, 0x00, 0x00, 0x13, 0x13, 0x0a, 0x00, 0x00, 0x00, 0x00, 0x00, 0x00, 0x00, 0x00, 0x00, 0x00, 0x00, 0x00, 0x00, 0x00, 0x00, 0x00, 0x00, 0x00, 0x00		 //tile:45 
, 0x24, 0x37, 0x37, 0x37, 0x37, 0x25, 0x37, 0x37, 0x25, 0x37, 0x37, 0x37, 0x37, 0x37, 0x37, 0x37, 0x25, 0x2f, 0x2f, 0x2f, 0x2f, 0x2f, 0x2f, 0x2f, 0x1d, 0x2f, 0x2f, 0x2f, 0x2f, 0x2f, 0x2f, 0x2f, 0x1e, 0x27, 0x27, 0x27, 0x27, 0x27, 0x27, 0x27, 0x13, 0x13, 0x1e, 0x27, 0x27, 0x27, 0x13, 0x15, 0x00, 0x00, 0x00, 0x00, 0x00, 0x00, 0x00, 0x00, 0x00, 0x00, 0x00, 0x00, 0x00, 0x00, 0x00, 0x00		 //tile:46 
, 0x37, 0x37, 0x37, 0x37, 0x37, 0x37, 0x37, 0x37, 0x37, 0x37, 0x37, 0x37, 0x37, 0x37, 0x37, 0x37, 0x2f, 0x2f, 0x1c, 0x00, 0x00, 0x00, 0x00, 0x00, 0x2f, 0x2f, 0x0a, 0x00, 0x00, 0x00, 0x00, 0x00, 0x27, 0x27, 0x00, 0x00, 0x00, 0x00, 0x00, 0x00, 0x27, 0x14, 0x00, 0x00, 0x00, 0x00, 0x00, 0x00, 0x00, 0x00, 0x00, 0x00, 0x00, 0x00, 0x00, 0x00, 0x00, 0x00, 0x00, 0x00, 0x00, 0x00, 0x00, 0x00		 //tile:47 
, 0x37, 0x37, 0x37, 0x37, 0x37, 0x37, 0x37, 0x37, 0x37, 0x37, 0x37, 0x37, 0x37, 0x37, 0x37, 0x37, 0x09, 0x2f, 0x2f, 0x2f, 0x2f, 0x2f, 0x2f, 0x2f, 0x00, 0x1c, 0x2f, 0x2f, 0x2f, 0x2f, 0x2f, 0x2f, 0x00, 0x09, 0x27, 0x27, 0x27, 0x27, 0x27, 0x27, 0x00, 0x00, 0x14, 0x27, 0x14, 0x13, 0x13, 0x01, 0x00, 0x00, 0x00, 0x00, 0x00, 0x00, 0x00, 0x00, 0x00, 0x00, 0x00, 0x00, 0x00, 0x00, 0x00, 0x00		 //tile:48 
, 0x37, 0x37, 0x37, 0x25, 0x00, 0x00, 0x00, 0x09, 0x37, 0x37, 0x37, 0x37, 0x09, 0x09, 0x1c, 0x37, 0x2f, 0x2f, 0x2f, 0x2f, 0x2f, 0x2f, 0x2f, 0x2f, 0x2f, 0x2f, 0x2f, 0x2f, 0x2f, 0x2f, 0x2f, 0x2f, 0x27, 0x27, 0x27, 0x27, 0x27, 0x27, 0x27, 0x27, 0x00, 0x0a, 0x15, 0x27, 0x27, 0x27, 0x1e, 0x13, 0x00, 0x00, 0x00, 0x00, 0x00, 0x00, 0x00, 0x00, 0x00, 0x00, 0x00, 0x00, 0x00, 0x00, 0x00, 0x00		 //tile:49 
, 0x09, 0x00, 0x2e, 0x37, 0x37, 0x37, 0x37, 0x37, 0x25, 0x00, 0x2e, 0x37, 0x37, 0x37, 0x37, 0x2e, 0x2f, 0x13, 0x26, 0x2f, 0x2f, 0x2f, 0x2f, 0x26, 0x2f, 0x27, 0x2f, 0x2f, 0x2f, 0x2f, 0x2f, 0x27, 0x27, 0x1d, 0x27, 0x27, 0x27, 0x27, 0x27, 0x27, 0x01, 0x00, 0x1e, 0x27, 0x1d, 0x13, 0x13, 0x13, 0x00, 0x00, 0x00, 0x00, 0x00, 0x00, 0x00, 0x00, 0x00, 0x00, 0x00, 0x00, 0x00, 0x00, 0x00, 0x00		 //tile:50 
, 0x37, 0x37, 0x37, 0x37, 0x37, 0x2e, 0x09, 0x00, 0x25, 0x37, 0x37, 0x37, 0x37, 0x37, 0x2f, 0x09, 0x00, 0x25, 0x2f, 0x2f, 0x2f, 0x2f, 0x2f, 0x2f, 0x00, 0x00, 0x26, 0x2f, 0x2f, 0x2f, 0x2f, 0x2f, 0x00, 0x00, 0x00, 0x1e, 0x27, 0x27, 0x27, 0x27, 0x00, 0x00, 0x00, 0x00, 0x1e, 0x1e, 0x13, 0x13, 0x00, 0x00, 0x00, 0x00, 0x00, 0x00, 0x00, 0x00, 0x00, 0x00, 0x00, 0x00, 0x00, 0x00, 0x00, 0x00		 //tile:51 
, 0x00, 0x00, 0x00, 0x00, 0x00, 0x00, 0x00, 0x00, 0x00, 0x00, 0x00, 0x00, 0x00, 0x00, 0x00, 0x00, 0x0a, 0x00, 0x00, 0x00, 0x00, 0x00, 0x00, 0x00, 0x2f, 0x12, 0x00, 0x00, 0x00, 0x00, 0x00, 0x00, 0x27, 0x27, 0x0a, 0x00, 0x00, 0x00, 0x00, 0x00, 0x00, 0x00, 0x00, 0x00, 0x00, 0x00, 0x00, 0x00, 0x00, 0x00, 0x00, 0x00, 0x00, 0x00, 0x00, 0x00, 0x00, 0x00, 0x00, 0x00, 0x00, 0x00, 0x00, 0x00		 //tile:52 
, 0x00, 0x00, 0x00, 0x12, 0x37, 0x37, 0x37, 0x37, 0x00, 0x00, 0x09, 0x2f, 0x37, 0x37, 0x37, 0x37, 0x00, 0x00, 0x1d, 0x2f, 0x2f, 0x2f, 0x2f, 0x2f, 0x00, 0x13, 0x2f, 0x2f, 0x2f, 0x2f, 0x2f, 0x2f, 0x09, 0x27, 0x27, 0x27, 0x27, 0x27, 0x27, 0x27, 0x00, 0x00, 0x00, 0x13, 0x13, 0x13, 0x1f, 0x1e, 0x00, 0x00, 0x00, 0x00, 0x00, 0x00, 0x00, 0x00, 0x00, 0x00, 0x00, 0x00, 0x00, 0x00, 0x00, 0x00		 //tile:53 
, 0x37, 0x37, 0x37, 0x37, 0x37, 0x37, 0x37, 0x37, 0x37, 0x37, 0x37, 0x37, 0x25, 0x1b, 0x1b, 0x1b, 0x2f, 0x13, 0x00, 0x00, 0x00, 0x00, 0x00, 0x00, 0x26, 0x00, 0x00, 0x00, 0x00, 0x00, 0x00, 0x00, 0x13, 0x00, 0x00, 0x00, 0x00, 0x00, 0x00, 0x00, 0x00, 0x00, 0x00, 0x00, 0x00, 0x00, 0x00, 0x00, 0x00, 0x00, 0x00, 0x00, 0x00, 0x00, 0x00, 0x00, 0x00, 0x00, 0x00, 0x00, 0x00, 0x00, 0x00, 0x00		 //tile:54 
, 0x37, 0x37, 0x37, 0x37, 0x37, 0x2e, 0x00, 0x00, 0x2f, 0x37, 0x37, 0x37, 0x37, 0x37, 0x13, 0x00, 0x1d, 0x2f, 0x2f, 0x2f, 0x2f, 0x2f, 0x26, 0x00, 0x13, 0x2f, 0x2f, 0x2f, 0x2f, 0x2f, 0x2f, 0x13, 0x00, 0x27, 0x27, 0x27, 0x27, 0x27, 0x27, 0x1e, 0x00, 0x1d, 0x27, 0x1e, 0x13, 0x13, 0x13, 0x00, 0x00, 0x00, 0x00, 0x00, 0x00, 0x00, 0x00, 0x00, 0x00, 0x00, 0x00, 0x00, 0x00, 0x00, 0x00, 0x00		 //tile:55 
, 0x00, 0x00, 0x00, 0x00, 0x00, 0x00, 0x00, 0x00, 0x00, 0x00, 0x00, 0x00, 0x00, 0x00, 0x00, 0x00, 0x00, 0x00, 0x00, 0x00, 0x00, 0x00, 0x00, 0x00, 0x00, 0x00, 0x00, 0x00, 0x00, 0x00, 0x00, 0x00, 0x00, 0x00, 0x00, 0x00, 0x00, 0x00, 0x00, 0x09, 0x00, 0x00, 0x00, 0x00, 0x00, 0x00, 0x00, 0x00, 0x00, 0x00, 0x00, 0x00, 0x00, 0x00, 0x00, 0x00, 0x00, 0x00, 0x00, 0x00, 0x00, 0x00, 0x00, 0x00		 //tile:56 
, 0x00, 0x25, 0x37, 0x37, 0x37, 0x37, 0x37, 0x12, 0x00, 0x37, 0x37, 0x37, 0x37, 0x37, 0x2e, 0x00, 0x13, 0x2f, 0x2f, 0x2f, 0x2f, 0x2f, 0x13, 0x00, 0x26, 0x2f, 0x2f, 0x2f, 0x2f, 0x2f, 0x09, 0x00, 0x27, 0x27, 0x27, 0x27, 0x27, 0x1d, 0x00, 0x00, 0x00, 0x00, 0x00, 0x13, 0x13, 0x0a, 0x00, 0x00, 0x00, 0x00, 0x00, 0x00, 0x00, 0x00, 0x00, 0x00, 0x00, 0x00, 0x00, 0x00, 0x00, 0x00, 0x00, 0x00		 //tile:57 
, 0x24, 0x37, 0x37, 0x37, 0x37, 0x37, 0x1c, 0x00, 0x0a, 0x37, 0x37, 0x37, 0x37, 0x2e, 0x00, 0x00, 0x00, 0x25, 0x2f, 0x2f, 0x2f, 0x0a, 0x00, 0x00, 0x00, 0x0a, 0x2f, 0x2f, 0x14, 0x00, 0x00, 0x00, 0x00, 0x00, 0x1d, 0x1e, 0x00, 0x00, 0x00, 0x00, 0x00, 0x00, 0x0a, 0x0a, 0x00, 0x00, 0x00, 0x00, 0x00, 0x00, 0x00, 0x00, 0x00, 0x00, 0x00, 0x00, 0x00, 0x00, 0x00, 0x00, 0x00, 0x00, 0x00, 0x00		 //tile:58 
, 0x12, 0x37, 0x37, 0x37, 0x37, 0x37, 0x37, 0x37, 0x00, 0x2f, 0x37, 0x37, 0x37, 0x37, 0x37, 0x37, 0x00, 0x1d, 0x2f, 0x2f, 0x2f, 0x2f, 0x2f, 0x2f, 0x00, 0x13, 0x2f, 0x2f, 0x2f, 0x2f, 0x2f, 0x2f, 0x00, 0x00, 0x27, 0x27, 0x27, 0x27, 0x27, 0x27, 0x00, 0x00, 0x15, 0x27, 0x1f, 0x13, 0x13, 0x13, 0x00, 0x00, 0x00, 0x00, 0x00, 0x00, 0x00, 0x00, 0x00, 0x00, 0x00, 0x00, 0x00, 0x00, 0x00, 0x00		 //tile:59 
, 0x37, 0x37, 0x2e, 0x00, 0x00, 0x25, 0x37, 0x37, 0x37, 0x37, 0x37, 0x00, 0x09, 0x2f, 0x37, 0x37, 0x2f, 0x2f, 0x2f, 0x25, 0x26, 0x2f, 0x2f, 0x2f, 0x2f, 0x2f, 0x2f, 0x2f, 0x2f, 0x2f, 0x2f, 0x2f, 0x27, 0x27, 0x27, 0x27, 0x27, 0x27, 0x27, 0x27, 0x0a, 0x14, 0x27, 0x27, 0x27, 0x1f, 0x13, 0x01, 0x00, 0x00, 0x00, 0x00, 0x00, 0x00, 0x00, 0x00, 0x00, 0x00, 0x00, 0x00, 0x00, 0x00, 0x00, 0x00		 //tile:60 
, 0x37, 0x37, 0x2e, 0x13, 0x37, 0x37, 0x37, 0x37, 0x37, 0x37, 0x1b, 0x13, 0x37, 0x37, 0x37, 0x37, 0x2f, 0x2f, 0x00, 0x0a, 0x2f, 0x2f, 0x2f, 0x2f, 0x2f, 0x12, 0x00, 0x0a, 0x2f, 0x2f, 0x2f, 0x2f, 0x13, 0x00, 0x00, 0x0a, 0x27, 0x27, 0x27, 0x27, 0x00, 0x00, 0x00, 0x01, 0x27, 0x27, 0x27, 0x27, 0x00, 0x00, 0x00, 0x00, 0x00, 0x00, 0x00, 0x00, 0x00, 0x00, 0x00, 0x00, 0x00, 0x00, 0x00, 0x00		 //tile:61 
, 0x37, 0x24, 0x00, 0x00, 0x00, 0x37, 0x37, 0x37, 0x37, 0x26, 0x2f, 0x37, 0x37, 0x37, 0x37, 0x37, 0x2f, 0x2f, 0x2f, 0x2f, 0x2f, 0x2f, 0x2f, 0x2f, 0x2f, 0x2f, 0x2f, 0x2f, 0x2f, 0x2f, 0x2f, 0x2f, 0x27, 0x27, 0x27, 0x27, 0x27, 0x27, 0x27, 0x27, 0x1e, 0x13, 0x13, 0x13, 0x13, 0x13, 0x00, 0x00, 0x00, 0x00, 0x00, 0x00, 0x00, 0x00, 0x00, 0x00, 0x00, 0x00, 0x00, 0x00, 0x00, 0x00, 0x00, 0x00		 //tile:62 
, 0x37, 0x37, 0x1b, 0x00, 0x00, 0x00, 0x00, 0x00, 0x37, 0x37, 0x25, 0x1b, 0x1b, 0x00, 0x00, 0x00, 0x2f, 0x2f, 0x2f, 0x2f, 0x2f, 0x2f, 0x2f, 0x25, 0x2f, 0x2f, 0x2f, 0x2f, 0x2f, 0x2f, 0x2f, 0x14, 0x27, 0x27, 0x27, 0x27, 0x27, 0x27, 0x27, 0x13, 0x0a, 0x13, 0x13, 0x13, 0x14, 0x27, 0x27, 0x09, 0x00, 0x00, 0x00, 0x00, 0x00, 0x00, 0x00, 0x00, 0x00, 0x00, 0x00, 0x00, 0x00, 0x00, 0x00, 0x00		 //tile:63 
};
